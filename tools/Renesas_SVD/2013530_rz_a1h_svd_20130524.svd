# RZA1H register map
File version: 1.00
for test
Registers are 32-bit, read-write, no defined reset value unless marked. A register's access mark holds for its fields unless they carry their own. Offsets are from the block's base; lines under a group give offsets from that group; [hi:lo] are bit positions; {n}, {i} and the like mark numbered series; 'fields as' and 'values as' point back to an identical list; <NAME> marks a mode.

## Memory map
0x3FEFA000 SPIBSC0 size 0x8000
0x3FEFB000 SPIBSC1 size 0x8000
0x3FFFC000 BSC size 0x8000
0x3FFFF000 L2C size 0x8000
0xE8005000 ROMDEC size 0x8000
0xE8005800 ADC size 0x8000
{0xE8007000+0x800*n} SCIF{n} size 0x8000 (n=0..7)
0xE800B000 SCIM0 size 0x8000
0xE800B800 SCIM1 size 0x8000
0xE800C800 RSPI0 size 0x8000
0xE800D000 RSPI1 size 0x8000
0xE800D800 RSPI2 size 0x8000
0xE800E000 RSPI3 size 0x8000
0xE800E800 RSPI4 size 0x8000
0xE8010000 USB200 size 0x8000
0xE8012000 SPDIF size 0x8000
0xE8014000 IRDA size 0x8000
0xE8017000 JCU size 0x8000
0xE8030000 UAHV size 0x8000
0xE8034000 MLB size 0x8000
0xE803A000 RSCAN0 size 0x8000
0xE804C800 MMC size 0x8000
0xE8200000 DMAC size 0x8000
0xE8201000 INTC size 0x8000
0xE8203000 ETHER size 0x8000
0xE8205000 PFV0 size 0x8000
0xE8205800 PFV1 size 0x8000
0xE8207000 USB201 size 0x8000
0xE8208000 SCUX size 0x8000
0xE820B000 SSIF0 size 0x8000
0xE820B800 SSIF1 size 0x8000
0xE820C000 SSIF2 size 0x8000
0xE820C800 SSIF3 size 0x8000
0xE820D000 SSIF4 size 0x8000
0xE820D800 SSIF5 size 0x8000
0xE8210000 CEU size 0x8000
0xFCFE0000 WDT size 0x8000
0xFCFE0010 CPG size 0x8000
0xFCFE3004 GPIO size 0x8000
0xFCFE9001 LIN0 size 0x8000
0xFCFE9801 LIN1 size 0x8000
0xFCFEC000 OSTM0 size 0x8000
0xFCFEC400 OSTM1 size 0x8000
0xFCFEE000 RIIC0 size 0x8000
0xFCFEE400 RIIC1 size 0x8000
0xFCFEE800 RIIC2 size 0x8000
0xFCFEEC00 RIIC3 size 0x8000
0xFCFEF000 IEB size 0x8000
0xFCFF0000 MTU2 size 0x8000
0xFCFF1000 RTC size 0x8000
0xFCFF4000 FLCTL size 0x8000
0xFCFF4800 SDG0 size 0x8000
0xFCFF4A00 SDG1 size 0x8000
0xFCFF4C00 SDG2 size 0x8000
0xFCFF4E00 SDG3 size 0x8000
0xFCFF50E0 PWM size 0x8000
0xFCFF7400 VDC50 size 0x8000
0xFCFF7A30 LVDS size 0x8000
0xFCFF9400 VDC51 size 0x8000
0xFCFFA008 DVDEC1 size 0x8000
0xFCFFA800 DISC0 size 0x8000
0xFCFFB000 DISC1 size 0x8000
0xFCFFB808 DVDEC0 size 0x8000

## ADC
Base 0xE8005800
0x00 ADDRA 16-bit
0x02 ADDRB 16-bit
0x04 ADDRC 16-bit
0x06 ADDRD 16-bit
0x08 ADDRE 16-bit
0x0A ADDRF 16-bit
0x0C ADDRG 16-bit
0x0E ADDRH 16-bit
0x20 ADCMPHA 16-bit
0x22 ADCMPLA 16-bit
0x24 ADCMPHB 16-bit
0x26 ADCMPLB 16-bit
0x28 ADCMPHC 16-bit
0x2A ADCMPLC 16-bit
0x2C ADCMPHD 16-bit
0x2E ADCMPLD 16-bit
0x30 ADCMPHE 16-bit
0x32 ADCMPLE 16-bit
0x34 ADCMPHF 16-bit
0x36 ADCMPLF 16-bit
0x38 ADCMPHG 16-bit
0x3A ADCMPLG 16-bit
0x3C ADCMPHH 16-bit
0x3E ADCMPLH 16-bit
0x60 ADCSR 16-bit
0x62 ADCMPER 16-bit
0x64 ADCMPSR 16-bit

## BSC
Base 0x3FFFC000
0x00 CMNCR
{0x4+4i} CS{i}BCR (i=0..5)
{0x28+4i} CS{i}WCR (i=0..5)
0x4C SDCR
0x50 RTCSR
0x54 RTCNT
0x58 RTCOR
{0x60+4i} TOSCOR{i} (i=0..5)
0x80 TOSTR
0x84 TOENR

## CEU
Base 0xE8210000
0x00 CAPSR
0x04 CAPCR
0x08 CAMCR
0x0C CMCYR
0x10 CAMOR_A
0x14 CAPWR_A
0x18 CAIFR
0x28 CRCNTR
0x2C CRCMPR
0x30 CFLCR_A
0x34 CFSZR_A
0x38 CDWDR_A
0x3C CDAYR_A
0x40 CDACR_A
0x44 CDBYR_A
0x48 CDBCR_A
0x4C CBDSR_A
0x5C CFWCR
0x60 CLFCR_A
0x64 CDOCR_A
0x70 CEIER
0x74 CETCR
0x7C CSTSR
0x84 CDSSR
0x90 CDAYR2_A
0x94 CDACR2_A
0x98 CDBYR2_A
0x9C CDBCR2_A
0x1010 CAMOR_B
0x1014 CAPWR_B
0x1030 CFLCR_B
0x1034 CFSZR_B
0x1038 CDWDR_B
0x103C CDAYR_B
0x1040 CDACR_B
0x1044 CDBYR_B
0x1048 CDBCR_B
0x104C CBDSR_B
0x1060 CLFCR_B
0x1064 CDOCR_B
0x1090 CDAYR2_B
0x1094 CDACR2_B
0x1098 CDBYR2_B
0x109C CDBCR2_B
0x2010 CAMOR_M
0x2014 CAPWR_M
0x2030 CFLCR_M
0x2034 CFSZR_M
0x2038 CDWDR_M
0x203C CDAYR_M
0x2040 CDACR_M
0x2044 CDBYR_M
0x2048 CDBCR_M
0x204C CBDSR_M
0x2060 CLFCR_M
0x2064 CDOCR_M
0x2090 CDAYR2_M
0x2094 CDACR2_M
0x2098 CDBYR2_M
0x209C CDBCR2_M

## CPG
Base 0xFCFE0010
0x00 FRQCR 16-bit
0x04 FRQCR2 16-bit
0x08 CPUSTS 8-bit
0x10 STBCR1 8-bit
0x14 STBCR2 8-bit
0x20 STBREQ1 8-bit
0x24 STBREQ2 8-bit
0x30 STBACK1 8-bit
0x34 STBACK2 8-bit
{0x3EC+4i} SYSCR{i} 8-bit (i=1..3)
{0x404+4i} STBCR{i} 8-bit (i=3..12)
{0x44C+4i} SWRSTCR{i} 8-bit (i=1..4)
0x117F0 RRAMKP 8-bit
0x117F2 DSCTR 8-bit
0x117F4 DSSSR 16-bit
0x117F6 DSESR 16-bit
0x117F8 DSFR 16-bit
0x11800 XTALCTR 8-bit
