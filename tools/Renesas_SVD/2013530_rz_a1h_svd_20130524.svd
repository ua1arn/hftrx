# RZA1H register map
File version: 1.00
Registers are 32-bit, read-write, no defined reset value unless marked. A register's access mark holds for its fields unless they carry their own. Offsets are from the block's base; [hi:lo] are bit positions; {n}, {i} and the like mark numbered series.

## LVDS
Base 0xFCFF7A30
0x00 LVDS_UPDATE
0x04 LVDSFCL
0x20 LCLKSELR
0x24 LPLLSETR
0x28 LPLLMONR

## MLB
Base 0xE8034000
0x00 DCCR
0x04 SSCR
0x08 SDCR
0x0C SMCR
0x1C VCCR
0x20 SBCR
0x24 ABCR
0x28 CBCR
0x2C IBCR
0x30 CICR
{0x40+0x10*i} CECR{i} (i=0..30)
{0x44+0x10*i} CSCR{i} (i=0..30)
{0x48+0x10*i} CCBCR{i} (i=0..30)
{0x4C+0x10*i} CNBCR{i} (i=0..30)
{0x280+4i} LCBCR{i} (i=0..30)

## MMC
Base 0xE804C800
0x00 CE_CMD_SET
0x08 CE_ARG
0x0C CE_ARG_CMD12
0x10 CE_CMD_CTRL
0x14 CE_BLOCK_SET
0x18 CE_CLK_CTRL
0x1C CE_BUF_ACC
0x20 CE_RESP3
0x24 CE_RESP2
0x28 CE_RESP1
0x2C CE_RESP0
0x30 CE_RESP_CMD12
0x34 CE_DATA
0x40 CE_INT
0x44 CE_INT_EN
0x48 CE_HOST_STS1
0x4C CE_HOST_STS2
0x5C CE_DMA_MODE
0x70 CE_DETECT
0x74 CE_ADD_MODE
0x7C CE_VERSION

## MTU2
Base 0xFCFF0000
0x00 TCR_2 8-bit
0x01 TMDR_2 8-bit
0x02 TIORH_2 8-bit
0x04 TIER_2 8-bit
0x05 TSR_2 8-bit
0x06 TCNT_2 16-bit
0x08 TGRA_2 16-bit
0x0A TGRB_2 16-bit
0x200 TCR_3 8-bit
0x201 TCR_4 8-bit
0x202 TMDR_3 8-bit
0x203 TMDR_4 8-bit
0x204 TIORH_3 8-bit
0x205 TIORL_3 8-bit
0x206 TIORH_4 8-bit
0x207 TIORL_4 8-bit
0x208 TIER_3 8-bit
0x209 TIER_4 8-bit
0x20A TOER 8-bit
0x20D TGCR 8-bit
0x20E TOCR1 8-bit
0x20F TOCR2 8-bit
0x210 TCNT_3 16-bit
0x212 TCNT_4 16-bit
0x214 TCDR 16-bit
0x216 TDDR 16-bit
0x218 TGRA_3 16-bit
0x21A TGRB_3 16-bit
0x21C TGRA_4 16-bit
0x21E TGRB_4 16-bit
0x220 TCNTS 16-bit
0x222 TCBR 16-bit
0x224 TGRC_3 16-bit
0x226 TGRD_3 16-bit
0x228 TGRC_4 16-bit
0x22A TGRD_4 16-bit
0x22C TSR_3 8-bit
0x22D TSR_4 8-bit
0x230 TITCR 8-bit
0x231 TITCNT 8-bit
0x232 TBTER 8-bit
0x234 TDER 8-bit
0x236 TOLBR 8-bit
0x238 TBTM_3 8-bit
0x239 TBTM_4 8-bit
0x240 TADCR 16-bit
0x244 TADCORA_4 16-bit
0x246 TADCORB_4 16-bit
0x248 TADCOBRA_4 16-bit
0x24A TADCOBRB_4 16-bit
0x260 TWCR 8-bit
0x280 TSTR 8-bit
0x281 TSYR 8-bit
0x284 TRWER 8-bit
0x300 TCR_0 8-bit
0x301 TMDR_0 8-bit
0x302 TIORH_0 8-bit
0x303 TIORL_0 8-bit
0x304 TIER_0 8-bit
0x305 TSR_0 8-bit
0x306 TCNT_0 16-bit
0x308 TGRA_0 16-bit
0x30A TGRB_0 16-bit
0x30C TGRC_0 16-bit
0x30E TGRD_0 16-bit
0x320 TGRE_0 16-bit
0x322 TGRF_0 16-bit
0x324 TIER2_0 8-bit
0x325 TSR2_0 8-bit
0x326 TBTM_0 8-bit
0x380 TCR_1 8-bit
0x381 TMDR_1 8-bit
0x382 TIOR_1 8-bit
0x384 TIER_1 8-bit
0x385 TSR_1 8-bit
0x386 TCNT_1 16-bit
0x388 TGRA_1 16-bit
0x38A TGRB_1 16-bit
0x390 TICCR 8-bit

## OSTM0
Base 0xFCFEC000
0x00 OSTM0CMP
0x04 OSTM0CNT
0x10 OSTM0TE 8-bit
0x14 OSTM0TS 8-bit
0x18 OSTM0TT 8-bit
0x20 OSTM0CTL 8-bit

## OSTM1
Base 0xFCFEC400
Registers as OSTM0 (with OSTM0 read as OSTM1).

## PFV0
Base 0xE8205000
Same registers: PFV1 0xE8205800
0x00 PFVCR
0x04 PFVICR
0x08 PFVISR
{0x20+4i} PFVID{i} (i=0..7)
{0x40+4i} PFVOD{i} (i=0..7)
0x64 PFVIFSR
0x68 PFVOFSR
0x6C PFVACR
0x70 PFV_MTX_MODE
0x74 PFV_MTX_YG_ADJ0
0x78 PFV_MTX_YG_ADJ1
0x7C PFV_MTX_CBB_ADJ0
0x80 PFV_MTX_CBB_ADJ1
0x84 PFV_MTX_CRR_ADJ0
0x88 PFV_MTX_CRR_ADJ1
0x8C PFVSZR

## PWM
Base 0xFCFF50E0
0x00 PWCR_1 16-bit
0x04 PWPR_1 16-bit
0x06 PWCYR_1 16-bit
0x08 PWBFR_1A 16-bit
0x0A PWBFR_1C 16-bit
0x0C PWBFR_1E 16-bit
0x0E PWBFR_1G 16-bit
0x10 PWCR_2 16-bit
0x14 PWPR_2 16-bit
0x16 PWCYR_2 16-bit
0x18 PWBFR_2A 16-bit
0x1A PWBFR_2C 16-bit
0x1C PWBFR_2E 16-bit
0x1E PWBFR_2G 16-bit

## RIIC0
Base 0xFCFEE000
0x00 RIIC0CR1
0x04 RIIC0CR2
{0x4+4i} RIIC0MR{i} (i=1..3)
0x14 RIIC0FER
0x18 RIIC0SER
0x1C RIIC0IER
0x20 RIIC0SR1
0x24 RIIC0SR2
{0x28+4i} RIIC0SAR{i} (i=0..2)
0x34 RIIC0BRL
0x38 RIIC0BRH
0x3C RIIC0DRT
0x40 RIIC0DRR

## RIIC1
Base 0xFCFEE400
Registers as RIIC0 (with RIIC0 read as RIIC1).

## RIIC2
Base 0xFCFEE800
Registers as RIIC0 (with RIIC0 read as RIIC2).

## RIIC3
Base 0xFCFEEC00
Registers as RIIC0 (with RIIC0 read as RIIC3).
