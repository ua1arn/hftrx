# RZA1H register map
File version: 1.00
Registers are 32-bit, read-write, no defined reset value unless marked. A register's access mark holds for its fields unless they carry their own. Offsets are from the block's base; [hi:lo] are bit positions; {n}, {i} and the like mark numbered series.

## GPIO
Base 0xFCFE3004
0x00 P1 16-bit
0x04 P2 16-bit
0x08 P3 16-bit
0x0C P4 16-bit
0x10 P5 16-bit
0x14 P6 16-bit
0x18 P7 16-bit
0x1C P8 16-bit
0x20 P9 16-bit
0x24 P10 16-bit
0x28 P11 16-bit
{0xFC+4i} PSR{i} (i=1..11)
{0x1FC+4i} PPR{i} 16-bit (i=0..11)
{0x2FC+4i} PM{i} 16-bit (i=1..11)
{0x3FC+4i} PMC{i} 16-bit (i=0..11)
{0x4FC+4i} PFC{i} 16-bit (i=1..11)
{0x5FC+4i} PFCE{i} 16-bit (i=1..11)
{0x6FC+4i} PNOT{i} 16-bit (i=1..11)
{0x7FC+4i} PMSR{i} (i=1..11)
{0x8FC+4i} PMCSR{i} (i=0..11)
{0x9FC+4i} PFCAE{i} 16-bit (i=1..11)
0xBFC SNCR
{0x3FFC+4i} PIBC{i} 16-bit (i=0..11)
{0x40FC+4i} PBDC{i} 16-bit (i=1..11)
{0x41FC+4i} PIPC{i} 16-bit (i=1..11)

## IEB
Base 0xFCFEF000
0x00 IEBB0BCR 8-bit
0x04 IEBB0PSR 8-bit
0x08 IEBB0UAR 16-bit
0x0C IEBB0SAR 16-bit
0x10 IEBB0PAR 16-bit
0x14 IEBB0RSA 16-bit
0x18 IEBB0CDR 8-bit
0x1C IEBB0TCD 8-bit
0x20 IEBB0RCD 8-bit
0x24 IEBB0DLR 8-bit
0x28 IEBB0TDL 8-bit
0x2C IEBB0RDL 8-bit
0x30 IEBB0CKS 8-bit
0x34 IEBB0TMS 8-bit
0x38 IEBB0PCR 8-bit
0x3C IEBB0BSR 16-bit
0x40 IEBB0SSR 8-bit
0x44 IEBB0USR 8-bit
0x48 IEBB0ISR 8-bit
0x4C IEBB0ESR 8-bit
0x50 IEBB0FSR 8-bit
0x54 IEBB0SCR 8-bit
0x58 IEBB0CCR 8-bit
0x5C IEBB0STC0 8-bit
0x60 IEBB0STC1 8-bit
0x64 IEBB0DR 8-bit

## INTC
Base 0xE8201000
0x00 ICDDCR
0x04 ICDICTR
0x08 ICDIIDR
{0x80+4i} ICDISR{i} (i=0..18)
{0x100+4i} ICDISER{i} (i=0..18)
{0x180+4i} ICDICER{i} (i=0..18)
{0x200+4i} ICDISPR{i} (i=0..18)
{0x280+4i} ICDICPR{i} (i=0..18)
{0x300+4i} ICDABR{i} (i=0..18)
{0x400+4i} ICDIPR{i} (i=0..146)
{0x800+4i} ICDIPTR{i} (i=0..146)
{0xC00+4i} ICDICFR{i} (i=0..36)
0xD00 PPI_STATUS
{0xD04+4i} SPI_STATUS{i} (i=0..16)
0xF00 ICDSGIR
0x1000 ICCICR
0x1004 ICCPMR
0x1008 ICCBPR
0x100C ICCIAR
0x1010 ICCEOIR
0x1014 ICCRPR
0x1018 ICCHPIR
0x101C ICCABPR
0x10FC ICCIIDR
0x14DEE800 ICR0 16-bit
0x14DEE802 ICR1 16-bit
0x14DEE804 IRQRR 16-bit

## IRDA
Base 0xE8014000
0x00 IRCR 8-bit

## JCU
Base 0xE8017000
0x00 JCMOD 8-bit
0x01 JCCMD 8-bit
0x03 JCQTN 8-bit
0x04 JCHTN 8-bit
0x05 JCDRIU 8-bit
0x06 JCDRID 8-bit
0x07 JCVSZU 8-bit
0x08 JCVSZD 8-bit
0x09 JCHSZU 8-bit
0x0A JCHSZD 8-bit
0x0B JCDTCU 8-bit
0x0C JCDTCM 8-bit
0x0D JCDTCD 8-bit
0x0E JINTE0 8-bit
0x0F JINTS0 8-bit
0x10 JCDERR 8-bit
0x11 JCRST 8-bit
0x40 JIFECNT
0x44 JIFESA
0x48 JIFESOFST
0x4C JIFEDA
0x50 JIFESLC
0x54 JIFEDDC
0x58 JIFDCNT
0x5C JIFDSA
0x60 JIFDDOFST
0x64 JIFDDA
0x68 JIFDSDC
0x6C JIFDDLC
0x70 JIFDADT
0x8C JINTE1
0x90 JINTS1
0x94 JIFESVSZ
0x98 JIFESHSZ
{0x100+0x40*i} JCQTBL{i} 8-bit (i=0..3)
0x200 JCHTBD0 8-bit
0x220 JCHTBA0 8-bit
0x300 JCHTBD1 8-bit
0x320 JCHTBA1 8-bit

## L2C
Base 0x3FFFF000
0x00 REG0_CACHE_ID
0x04 EG0_CACHE_TYPE
0x100 REG1_CONTROL
0x104 REG1_AUX_CONTROL
0x108 REG1_TAG_RAM_CONTROL
0x10C REG1_DATA_RAM_CONTROL
0x200 REG2_EV_COUNTER_CTRL
0x204 REG2_EV_COUNTER1_CFG
0x208 REG2_EV_COUNTER0_CFG
0x20C REG2_EV_COUNTER1
0x210 REG2_EV_COUNTER0
0x214 REG2_INT_MASK
0x218 REG2_INT_MASK_STATUS
0x21C REG2_INT_RAW_STATUS
0x220 REG2_INT_CLEAR
0x730 REG7_CACHE_SYNC
0x770 REG7_INV_PA
0x77C REG7_INV_WAY
0x7B0 REG7_CLEAN_PA
0x7B8 REG7_CLEAN_INDEX
0x7BC REG7_CLEAN_WAY
0x7F0 REG7_CLEAN_INV_PA
0x7F8 REG7_CLEAN_INV_INDEX
0x7FC REG7_CLEAN_INV_WAY
{0x900+8i} REG9_D_LOCKDOWN{i} (i=0..7)
{0x904+8i} REG9_I_LOCKDOWN{i} (i=0..7)
0x950 REG9_LOCK_LINE_EN
0x954 REG9_UNLOCK_WAY
0xC00 REG12_ADDR_FILTERING_START
0xC04 REG12_ADDR_FILTERING_END
0xF40 REG15_DEBUG_CTRL
0xF60 REG15_PREFETCH_CTRL
0xF80 REG15_POWER_CTRL

## LIN0
Base 0xFCFE9001
Same registers: LIN1 0xFCFE9801
0x00 LWBR 8-bit
0x01 LBRP0 8-bit
0x02 LBRP1 8-bit
0x03 LSTC 8-bit
0x07 LMD 8-bit
0x08 LBFC 8-bit
0x09 LSC 8-bit
0x0A LWUP 8-bit
0x0B LIE 8-bit
0x0C LEDE 8-bit
0x0D LCUC 8-bit
0x0F LTRC 8-bit
0x10 LMST 8-bit
0x11 LST 8-bit
0x12 LEST 8-bit
0x13 LDFC 8-bit
0x14 LIDB 8-bit
0x15 LCBR 8-bit
0x16 LUDB0 8-bit
{0x16+i} LDB{i} 8-bit (i=1..8)
0x1F LUOER 8-bit
0x20 LUOR1 8-bit
0x23 LUTDR 16-bit
0x25 LURDR 16-bit
0x27 LUWTDR 16-bit
