# RZA1H register map
File version: 1.00
Registers are 32-bit, read-write, no defined reset value unless marked. A register's access mark holds for its fields unless they carry their own. Offsets are from the block's base; [hi:lo] are bit positions; {n}, {i} and the like mark numbered series.

## ROMDEC
Base 0xE8005000
0x00 CROMEN 8-bit
0x01 CROMSY0 8-bit
0x02 CROMCTL0 8-bit
0x03 CROMCTL1 8-bit
{0x2+i} CROMCTL{i} 8-bit (i=3..5)
0x08 CROMST0 8-bit
0x09 CROMST1 8-bit
{0x8+i} CROMST{i} 8-bit (i=3..6)
{0x14+i} CBUFST{i} 8-bit (i=0..2)
{0x18+i} HEAD{i:02} 8-bit (i=0..3)
{0x1C+i} SHEAD{i:02} 8-bit (i=0..7)
{0x10+i} HEAD{i} 8-bit (i=20..23)
{0x14+i} SHEAD{i} 8-bit (i=20..27)
{0x40+i} CBUFCTL{i} 8-bit (i=0..3)
0x45 CROMST0M 8-bit
0x100 ROMDECRST 8-bit
0x101 RSTSTAT 8-bit
0x102 SSI 8-bit
0x108 INTHOLD 8-bit
0x109 INHINT 8-bit
0x200 STRMDIN0 16-bit
0x202 STRMDIN2 16-bit
0x204 STRMDOUT0 16-bit

## RSPI0
Base 0xE800C800
0x00 SPCR_0 8-bit
0x01 SSLP_0 8-bit
0x02 SPPCR_0 8-bit
0x03 SPSR_0 8-bit
0x04 SPDR_0
0x08 SPSCR_0 8-bit
0x09 SPSSR_0 8-bit
0x0A SPBR_0 8-bit
0x0B SPDCR_0 8-bit
0x0C SPCKD_0 8-bit
0x0D SSLND_0 8-bit
0x0E SPND_0 8-bit
{0x10+2i} SPCMD{i}_0 16-bit (i=0..3)
0x20 SPBFCR_0 8-bit
0x22 SPBFDR_0 16-bit

## RSPI1
Base 0xE800D000
0x00 SPCR_1 8-bit
0x01 SSLP_1 8-bit
0x02 SPPCR_1 8-bit
0x03 SPSR_1 8-bit
0x04 SPDR_1
0x08 SPSCR_1 8-bit
0x09 SPSSR_1 8-bit
0x0A SPBR_1 8-bit
0x0B SPDCR_1 8-bit
0x0C SPCKD_1 8-bit
0x0D SSLND_1 8-bit
0x0E SPND_1 8-bit
{0x10+2i} SPCMD{i}_1 16-bit (i=0..3)
0x20 SPBFCR_1 8-bit
0x22 SPBFDR_1 16-bit

## RSPI2
Base 0xE800D800
0x00 SPCR_2 8-bit
0x01 SSLP_2 8-bit
0x02 SPPCR_2 8-bit
0x03 SPSR_2 8-bit
0x04 SPDR_2
0x08 SPSCR_2 8-bit
0x09 SPSSR_2 8-bit
0x0A SPBR_2 8-bit
0x0B SPDCR_2 8-bit
0x0C SPCKD_2 8-bit
0x0D SSLND_2 8-bit
0x0E SPND_2 8-bit
{0x10+2i} SPCMD{i}_2 16-bit (i=0..3)
0x20 SPBFCR_2 8-bit
0x22 SPBFDR_2 16-bit

## RSPI3
Base 0xE800E000
0x00 SPCR_3 8-bit
0x01 SSLP_3 8-bit
0x02 SPPCR_3 8-bit
0x03 SPSR_3 8-bit
0x04 SPDR_3
0x08 SPSCR_3 8-bit
0x09 SPSSR_3 8-bit
0x0A SPBR_3 8-bit
0x0B SPDCR_3 8-bit
0x0C SPCKD_3 8-bit
0x0D SSLND_3 8-bit
0x0E SPND_3 8-bit
{0x10+2i} SPCMD{i}_3 16-bit (i=0..3)
0x20 SPBFCR_3 8-bit
0x22 SPBFDR_3 16-bit

## RSPI4
Base 0xE800E800
0x00 SPCR_4 8-bit
0x01 SSLP_4 8-bit
0x02 SPPCR_4 8-bit
0x03 SPSR_4 8-bit
0x04 SPDR_4
0x08 SPSCR_4 8-bit
0x09 SPSSR_4 8-bit
0x0A SPBR_4 8-bit
0x0B SPDCR_4 8-bit
0x0C SPCKD_4 8-bit
0x0D SSLND_4 8-bit
0x0E SPND_4 8-bit
{0x10+2i} SPCMD{i}_4 16-bit (i=0..3)
0x20 SPBFCR_4 8-bit
0x22 SPBFDR_4 16-bit

## RTC
Base 0xFCFF1000
0x00 R64CNT 8-bit
0x02 RSECCNT 8-bit
0x04 RMINCNT 8-bit
0x06 RHRCNT 8-bit
0x08 RWKCNT 8-bit
0x0A RDAYCNT 8-bit
0x0C RMONCNT 8-bit
0x0E RYRCNT 16-bit
0x10 RSECAR 8-bit
0x12 RMINAR 8-bit
0x14 RHRAR 8-bit
0x16 RWKAR 8-bit
0x18 RDAYAR 8-bit
0x1A RMONAR 8-bit
0x1C RCR1 8-bit
0x1E RCR2 8-bit
0x20 RYRAR 16-bit
0x24 RCR3 8-bit
0x26 RCR5 8-bit
0x2A RFRH 16-bit
0x2C RFRL 16-bit

## SCIF0
Base 0xE8007000
0x00 SCSMR_0 16-bit
0x04 SCBRR_0 8-bit
0x08 SCSCR_0 16-bit
0x0C SCFTDR_0 8-bit
0x10 SCFSR_0 16-bit
0x14 SCFRDR_0 8-bit
0x18 SCFCR_0 16-bit
0x1C SCFDR_0 16-bit
0x20 SCSPTR_0 16-bit
0x24 SCLSR_0 16-bit
0x28 SCEMR_0 16-bit

## SCIF1
Base 0xE8007800
0x00 SCSMR_1 16-bit
0x04 SCBRR_1 8-bit
0x08 SCSCR_1 16-bit
0x0C SCFTDR_1 8-bit
0x10 SCFSR_1 16-bit
0x14 SCFRDR_1 8-bit
0x18 SCFCR_1 16-bit
0x1C SCFDR_1 16-bit
0x20 SCSPTR_1 16-bit
0x24 SCLSR_1 16-bit
0x28 SCEMR_1 16-bit

## SCIF2
Base 0xE8008000
0x00 SCSMR_2 16-bit
0x04 SCBRR_2 8-bit
0x08 SCSCR_2 16-bit
0x0C SCFTDR_2 8-bit
0x10 SCFSR_2 16-bit
0x14 SCFRDR_2 8-bit
0x18 SCFCR_2 16-bit
0x1C SCFDR_2 16-bit
0x20 SCSPTR_2 16-bit
0x24 SCLSR_2 16-bit
0x28 SCEMR_2 16-bit

## SCIF3
Base 0xE8008800
0x00 SCSMR_3 16-bit
0x04 SCBRR_3 8-bit
0x08 SCSCR_3 16-bit
0x0C SCFTDR_3 8-bit
0x10 SCFSR_3 16-bit
0x14 SCFRDR_3 8-bit
0x18 SCFCR_3 16-bit
0x1C SCFDR_3 16-bit
0x20 SCSPTR_3 16-bit
0x24 SCLSR_3 16-bit
0x28 SCEMR_3 16-bit
