# elvees_vm14 register map
File version: 1.00
Registers are 32-bit, read-write, reset 0x0 unless marked. A register's access mark holds for its fields unless they carry their own. Offsets are from the block's base; [hi:lo] are bit positions; {n}, {i} and the like mark numbered series.

## MFBSP0 — МНОГОФУНКЦИОНАЛЬНЫЙ БУФЕРИЗИРОВАННЫЙ ПОСЛЕДОВАТЕЛЬНЫЙ ПОРТ (MFBSP)
Base 0x38086000
Same registers: MFBSP1 0x38088000
0x00 RX_TX_MFBSP — R Буфер приёма данных, W Буфер передачи данных
0x04 CSR_MFBSP — R/W Регистр управления и состояния
0x08 DIR_MFBSP — R/W Регистр управления направлением выводов порта ввода-вывода
0x0C GPIO_DR — R/W Регистр данных порта ввода-вывода
0x10 TCTR — R/W Регистр управления передатчиком
0x14 RCTR — R/W Регистр управления приёмником
0x18 TSR — R/W Регистр состояния передатчика
0x1C RSR — R/W Регистр состояния приёмника
0x20 TCTR_RATE
0x24 RCTR_RATE
0x28 TSTART — R/W псевдорегистр ten – запуск/останов передатчика без изменения настроек передатчика
0x2C RSTART — R/W псевдорегистр ren – запуск/останов приемника без изменения настроек приемника
0x30 EMERG_MFBSP — R/W Регистр аварийного управления портом
0x34 IMASK_MFBSP — R/W Регистр маски прерываний от порта

## NANDMPORT — КОНТРОЛЛЕР ПАМЯТИ ТИПА NAND FLASH (NANDMPORT)
Base 0x38007000
Same registers: NFCM 0x38007000
0x00 PACKET — 0x0 RW Регистр настройки пакетов
0x04 MEMADDR1 — RW Регистр адреса 1
0x08 MEMADDR2 — RW Регистр адреса 2
0x0C COMMAND — RW Регистр команды
0x10 PROGRAM — RW Регистр программы
0x14 INTERRUPT_STATUS_EN — RW Регистр разрешения статуса прерываний
0x18 INTERRUPT_SIGNAL_EN — RW Регистр разрешения сигнала прерываний
0x1C INTERRUPT_STATUS — RW Регистр статуса прерываний
0x20 ID1 — RO Регистр ID1
0x24 ID2 — RO Регистр ID2
0x28 FLASH_STATUS — RO Регистр статуса флэш-памяти
0x2C TIMING — RW Регистр временных параметров
0x30 BUFFER_DATA — RW Регистр данных буфера
0x34 ECC — RW Регистр ECC
0x38 ECC_ERROR_CNT — RO Счётчик ошибок ECC
0x3C ECC_SPARE_CMD — RW Регистр команд ECC
{0x3C+4i} ERROR_CNT_{i}BIT (i=1..4) — RW Счётчик {i}-битных ошибок
0x50 DMA_SYS_ADDR — RW Системный адрес DMA
0x54 DMA_BUFFER_BOUNDARY — RW Граница DMA пересылки
0x58 CPU_STATE — RW Регистр состояния CPU
{0x48+4i} ERROR_COUNT_{i}BIT (i=5..8) — RW Счётчик {i}-битных ошибок
0x80 SLAVE_DMA_CFG — RW Регистр конфигурации Slave DMA

## NORMPORT — контроллер внешней SRAM/NOR Flash памяти.
Base 0x38008000
0x1000 SMC_MEMC_STATUS — RO Регистр состояния контроллера
0x1004 SMC_MEMIF_CFG — RO Регистр конфигурации интерфейса памяти
0x1008 SMC_MEMC_CFG_SET — WO Регистр установки конфигурации контроллера
0x100C SMC_MEMC_CFG_CLR — WO Регистр сброса конфигурации контроллера
0x1010 SMC_DIRECT_CMD — WO Регистр команд
0x1014 SMC_SET_CYCLES — WO Регистр настройки циклов доступа к памяти
0x1018 SMC_SET_OPMODE — WO Регистр настройки операции с памятью
0x1020 SMC_REFRESH_PERIOD_0 — RW Регистр периода обновления
0x1100 SMC_SRAM_CYCLES0_0 — RO Регистр параметров цикла доступа к памяти 0
0x1104 SMC_OPMODE0_0 — RO Регистр режима операции для памяти 0
0x1120 SMC_SRAM_CYCLES0_1 — RO Регистр параметров цикла доступа к памяти 1
0x1124 SMC_OPMODE0_1 — RO Регистр режима операции для памяти 1
{0x1FE0+4i} SMC_PERIPH_ID_{i} (i=0..2) — RO ID регистр периферии {i}
0x1FEC SMC_PERIPH_ID_4 — RO ID регистр периферии 3
{0x1FF0+4i} SMC_PCELL_ID_{i} (i=0..3) — RO ID регистр компонента {i}
0x200C STATIC_MEM_CFG_0 — RW Регистр настройки внешней памяти
0x2014 ADDR_CFG_0 — RW Регистр настройки адреса 0
0x2018 ADDR_CFG_1 — RW Регистр настройки адреса 1
0x2024 BYTE_ORDER — RW Регистр настройки порядка байтов

## PMCTR — Контроллер управления энергопотреблением
Base 0x38095000
0x00 SYS_PWR_UP — undocumented
0x04 SYS_PWR_DOWN — undocumented
0x0C SYS_PWR_STATUS — Регистр статуса доменов
0x10 SYS_PWR_IMASK — Регистр маски прерывания SYS_PWR_INT
0x14 SYS_PWR_IRSTAT — Регистр наличного статуса прерывания SYS_PWR_ISTAT
0x18 SYS_PWR_INT — Регистр статуса прерывания SYS_PWR_INT
0x1C SYS_PWR_ICLR — Регистр очистки статуса прерывания SYS_PWR_INT
0x20 SYS_PWR_DELAY — Регистр задания задержек автоматов
0x24 DDR_PIN_RET — Регистр перевода выводов DDR в режим хранения состояния
0x28 DDR_INIT_END — Регистр вывода контроллеров DDRMC0, DDRMC1 из режима инициализации
0x2C WARM_RST_EN — Регистр разрешения «теплого» сброса
0x40 SW_RST — Регистр программного «теплого» сброса
0x44 WARM_RST_STATUS — Регистр статуса последнего сброса
0x48 PDM_RST_STATUS — Регистр статуса сброса доменов питания
0x4C NVMODE — Регистр управления сигналами NVMODE
{0x50+0x10*i} CPU0_WKP_MASK[{i}] (i=0..3) — Регистр маски включения домена CPU0 по прерываниям
{0x60+0x10*i} CPU1_WKP_MASK[{i}] (i=0..3) — Регистр маски включения домена CPU1 по прерываниям
0x70 ALWAYS_MISC0 — Регистр общего назначения, не сбрасываемый при «теплом» сбросе
0x74 ALWAYS_MISC1 — Регистр общего назначения, не сбрасываемый при «теплом» сбросе
0x78 WARM_BOOT_OVRD — Регистр управления загрузкой при «теплом» сбросе
0x80 CORE_PWR_UP — Регистр включения доменов
0x84 CORE_PWR_DOWN — Регистр выключения доменов
0x8C CORE_PWR_STATUS — Регистр статуса доменов
0x90 CORE_PWR_IMASK — Регистр маски прерывания CORE_PWR_INT
0x94 CORE_PWR_IRSTAT — Регистр наличного статуса прерывания CORE_PWR_INT
0x98 CORE_PWR_ISTAT — Регистр статуса прерывания CORE_PWR_INT
0x9C CORE_PWR_ICLR — Регистр очистки статуса прерывания CORE_PWR_INT
0xA0 CORE_PWR_DELAY — Регистр задания задержек автоматов доменов
