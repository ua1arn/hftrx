# elvees_vm14 register map
File version: 1.00
for test
Registers are 32-bit, read-write, reset 0x0 unless marked. A register's access mark holds for its fields unless they carry their own. Offsets are from the block's base; lines under a group give offsets from that group; [hi:lo] are bit positions; {n}, {i} and the like mark numbered series; 'fields as' and 'values as' point back to an identical list; <NAME> marks a mode.

## Memory map
0x37220000 SDMA — Регистры блока управления SDMA
0x38007000 NANDMPORT — КОНТРОЛЛЕР ПАМЯТИ ТИПА NAND FLASH (NANDMPORT)
0x38007000 NFCM
0x38008000 NORMPORT — контроллер внешней SRAM/NOR Flash памяти.
0x38028000 UART0 — Universal Asynchronous Receiver-Transmitter
0x38029000 UART1
0x3802A000 UART2
0x3802B000 UART3
0x3802C000 I2C0
0x3802D000 I2C1
0x3802E000 I2C2
0x38030000 I2S0 — Контроллер I2S предназначен для обмена аудио-данными в стерео-формате по последовательной шине I2S.
0x38034000 GPIOA — Регистры блока управления GPIO
0x38034000 GPIO0 — Регистры блока управления GPIO
0x3803400C GPIOB
0x38034018 GPIOC
0x38034024 GPIOD
0x38082000 SWIC0 — КОНТРОЛЛЕР ИНТЕРФЕЙСА SPACEWIRE (SWIC)
0x38083000 DMA_SWIC0
0x38084000 SWIC1
0x38085000 DMA_SWIC1
0x38086000 MFBSP0 — МНОГОФУНКЦИОНАЛЬНЫЙ БУФЕРИЗИРОВАННЫЙ ПОСЛЕДОВАТЕЛЬНЫЙ ПОРТ (MFBSP)
0x38087000 DMA_MFBSP0 — Регистры встроенных DMA портов SWIC и MFBSP
0x38088000 MFBSP1
0x38089000 DMA_MFBSP1
0x38094000 CMCTR — Контроллер управления синхронизацией
0x38095000 PMCTR — Контроллер управления энергопотреблением
0x38096000 SMCTR — общиме системные настройки микросхемы
0x39004000 GICVSELF
0x39005000 GICV

## Interrupts
52 MFBSP0_DMAIRQ0 (DMA_MFBSP0, DMA_MFBSP1, DMA_SWIC0, DMA_SWIC1)
53 MFBSP0_DMAIRQ1 (DMA_MFBSP0, DMA_MFBSP1, DMA_SWIC0, DMA_SWIC1)
54 MFBSP1_DMAIRQ0 (DMA_MFBSP0, DMA_MFBSP1, DMA_SWIC0, DMA_SWIC1)
55 MFBSP1_DMAIRQ1 (DMA_MFBSP0, DMA_MFBSP1, DMA_SWIC0, DMA_SWIC1)
71 NFC_MPORTINT (NANDMPORT, NFCM)
80 SWIC0DMA_IRQ0 (DMA_MFBSP0, DMA_MFBSP1, DMA_SWIC0, DMA_SWIC1)
81 SWIC0DMA_IRQ1 (DMA_MFBSP0, DMA_MFBSP1, DMA_SWIC0, DMA_SWIC1)
82 SWIC0DMA_IRQ2 (DMA_MFBSP0, DMA_MFBSP1, DMA_SWIC0, DMA_SWIC1)
83 SWIC0DMA_IRQ3 (DMA_MFBSP0, DMA_MFBSP1, DMA_SWIC0, DMA_SWIC1)
84 SWIC1DMA_IRQ0 (DMA_MFBSP0, DMA_MFBSP1, DMA_SWIC0, DMA_SWIC1)
85 SWIC1DMA_IRQ1 (DMA_MFBSP0, DMA_MFBSP1, DMA_SWIC0, DMA_SWIC1)
86 SWIC1DMA_IRQ2 (DMA_MFBSP0, DMA_MFBSP1, DMA_SWIC0, DMA_SWIC1)
87 SWIC1DMA_IRQ3 (DMA_MFBSP0, DMA_MFBSP1, DMA_SWIC0, DMA_SWIC1)
88 SWIC0_INT (SWIC0, SWIC1)
89 SWIC1_INT (SWIC0, SWIC1)
90 MFBSP0_RXIRQ (MFBSP0, MFBSP1)
91 MFBSP0_TXIRQ (MFBSP0, MFBSP1)
92 MFBSP0_SRQ (MFBSP0, MFBSP1)
93 MFBSP1_RXIRQ (MFBSP0, MFBSP1)
94 MFBSP1_TXIRQ (MFBSP0, MFBSP1)
95 MFBSP1_SRQ (MFBSP0, MFBSP1)
96 UART0 (UART{n} (n=0..3))
97 UART1 (UART{n} (n=0..3))
98 UART2 (UART{n} (n=0..3))
99 UART3 (UART{n} (n=0..3))
100 I2C0_IC_INTR (I2C{n} (n=0..2))
101 I2C1_IC_INTR (I2C{n} (n=0..2))
102 I2C2_IC_INTR (I2C{n} (n=0..2))
104 I2S0

## CMCTR — Контроллер управления синхронизацией
Base 0x38094000
0x04 DIV_MPU_CTR — Регистр делителя частоты MPUCLK
0x08 DIV_ATB_CTR — Регистр делителя частоты ATCLK
0x0C DIV_APB_CTR — Регистр делителя частоты APCLK
0x10 CHIP_REVISION — Регистр ревизии микросхемы
0x14 GATE_MPU_CTR — Регистр по управлению отключением частот в CMCTR_MPU
0x2C DIV_GPU_CTR — Регистр делителя частоты GPU_ACLK
0x30 DIV_DDR0_CTR — Регистр делителя частоты DDR0_SCLK
0x34 DIV_DDR1_CTR — Регистр делителя частоты DDR1_SCLK
0x38 DIV_NFC_CTR — Регистр делителя частоты NFC_SCLK
0x3C DIV_NOR_CTR — Регистр делителя частоты NOR_SCLK
0x40 DIV_SYS0_CTR — Регистр делителя частоты L1_HCLK и связанных с ней частот
0x44 DIV_SYS1_CTR — Регистр делителя частоты L3_PCLK и связанных с ней частот
0x48 GATE_CORE_CTR — Регистр по управлению отключением частот в CMCTR_CORE
0x4C GATE_SYS_CTR — Регистр по управлению отключением частот в CMCTR_SYS
0x68 GATE_DSP_CTR — Регистр по управлению отключением частот в CMCTR_DSP
0x80 MUX_CLKOUT — Регистр выбора частоты для вывода CLKOUT
0x84 DIV_CLKOUT — Регистр делителя частоты для вывода CLKOUT
0x88 GATE_CLKOUT — Регистр управления отключением частоты для вывода CLKOUT
0x90 LS_ENABLE — Регистр контроля функции LightSleep памятей микросхемы
0x100 SEL_APLL — Регистр контроля APLL
0x104 SEL_CPLL — Регистр контроля CPLL
0x108 SEL_DPLL — Регистр контроля DPLL
0x10C SEL_SPLL — Регистр контроля SPLL
0x110 SEL_VPLL — Регистр контроля VPLL
0x114 SEL_UPLL — Регистр контроля UPLL

## Notices in the file
Copyright (c) 2024 by Genadi V. Zawidowski. All rights reserved.
