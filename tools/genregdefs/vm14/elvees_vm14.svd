# elvees_vm14 register map
File version: 1.00
Registers are 32-bit, read-write, reset 0x0 unless marked. A register's access mark holds for its fields unless they carry their own. Offsets are from the block's base; [hi:lo] are bit positions.

## I2S0 — Контроллер I2S предназначен для обмена аудио-данными в стерео-формате по последовательной шине I2S.
Base 0x38030000
0x00 IER — Регистр включения контроллера. W/R 0x0 0x0
0x04 IRER — Регистр включения блока приема. W/R 0x0 0x4
0x08 ITER — Регистр включения блока передачи. W/R 0x0 0x8
0x0C CER — Регистр включения тактовой частоты. W/R 0x0 0xC
0x10 CCR — Регистр конфигурации тактовой частоты. W/R 0x10 0x10
0x14 RXFFR — Регистр сброса FIFO буферов блока приема. W 0x0 0x14
0x18 TXFFR — Регистр сброса FIFO буферов блока передачи. W 0x0 0x18
0x20 LRBR0_LTHR0 — Регистр «левого» слова приемника. R 0x0 0x20, Регистр «левого» слова нулевого передатчика. W 0x0 0x20
0x24 RRBR0 — Регистр «правого» слова приемника. R 0x0 0x24, Регистр «правого» слова нулевого передатчика. W 0x0 0x24
0x28 RER0 — Регистр включения приемника. W/R 0x1 0x28
0x2C TER0 — Регистр включения нулевого передатчика. W/R 0x1 0x2C
0x30 RCR0 — Регистр конфигурации приемника. W/R 0x5 0x30
0x34 TCR0 — Регистр конфигурации нулевого передатчика. W/R 0x5 0x34
0x38 ISR0 — Регистр статуса прерывания нулевого канала. R 0x10 0x38
0x3C IMR0 — Регистр маски прерывания нулевого канала. W/R 0x33 0x3C
0x40 ROR0 — Регистр переполнения FIFO приемника. R 0x0 0x40
0x44 TOR0 — Регистр переполнения FIFO нулевого передатчика. R 0x0 0x44
0x48 RFCR0 — Регистр конфигурации FIFO приемника. W/R 0x3 0x48
0x4C TFCR0 — Регистр конфигурации FIFO нулевого передатчика. W/R 0x3 0x4C
0x50 RFF0 — Регистр сброса FIFO приемника. W 0x0 0x50
0x54 TFF0 — Регистр сброса FIFO нулевого передатчика. W 0x0 0x54
0x60 LTHR1 — Регистр «левого» слова первого передатчика. W 0x0 0x60
0x64 RTHR1 — Регистр «правого» слова первого передатчика. W 0x0 0x64
0x6C TER1 — Регистр включения первого передатчика W/R 0x1 0x6C
0x74 TCR1 — Регистр конфигурации первого передатчика. W/R 0x5 0x74
0x78 ISR1 — Регистр статуса прерывания первого канала. R 0x10 0x78
0x7C IMR1 — Регистр маски прерывания первого канала. W/R 0x33 0x7C
0x84 TOR1 — Регистр переполнения первого передатчика. R 0x0 0x84
0x8C TFCR1 — Регистр конфигурации FIFO первого передатчика. W/R 0x3 0x8C
0x94 TFF1 — Регистр сброса FIFO первого передатчика. W 0x0 0x94
0xA0 LTHR2 — Регистр «левого» слова второго передатчика. W 0x0 0xA0
0xA4 RTHR2 — Регистр «правого» слова второго передатчика. W 0x0 0xA4
0xAC TER2 — Регистр включения второго передатчика W/R 0x1 0xAC
0xB4 TCR2 — Регистр конфигурации второго передатчика. W/R 0x5 0xB4
0xB8 ISR2 — Регистр статуса прерывания второго канала. R 0x10 0xB8
0xBC IMR2 — Регистр маски прерывания второго канала. W/R 0x33 0xBC
0xC4 TOR2 — Регистр переполнения второго передатчика. R 0x0 0xC4
0xCC TFCR2 — Регистр конфигурации FIFO второго передатчика. W/R 0x3 0xCC
0xD4 TFF2 — Регистр сброса FIFO второго передатчика. W 0x0 0xD4
0xE0 LTHR3 — Регистр «левого» слова третьего передатчика. W 0x0 0xE0
0xE4 RTHR3 — Регистр «правого» слова третьего передатчика. W 0x0 0xE4
0xEC TER3 — Регистр включения третьего передатчика W/R 0x1 0xEC
0xF4 TCR3 — Регистр конфигурации третьего передатчика. W/R 0x5 0xF4
0xF8 ISR3 — Регистр статуса прерывания третьего канала. R 0x10 0xF8
0xFC IMR3 — Регистр маски прерывания третьего канала. W/R 0x33 0xFC
0x104 TOR3 — Регистр переполнения третьего передатчика. R 0x0 0x104
0x10C TFCR3 — Регистр конфигурации FIFO третьего передатчика. W/R 0x3 0x10C
0x114 TFF3 — Регистр сброса FIFO третьего передатчика. W 0x0 0x114
0x1C0 RXDMA — Регистр DMA приема. R 0x0 0x1C0
0x1C8 TXDMA — Регистр DMA передачи. W 0x0 0x1C8
0x1CC RTXDMA — Регистр сброса DMA передачи. W 0x0 0x1CC
0x1F0 I2S_COMP_PARAM_2 — Второй регистр параметров компонента. R 0x48c 0x1F0
0x1F4 I2S_COMP_PARAM_1 — Первый регистр параметров компонента. R 0x24c067e 0x1F4
0x1F8 I2S_COMP_VERSION — Регистр ревизии компонента. R 0x3130362a 0x1F8
0x1FC I2S_COMP_TYPE — Регистр типа компонента. R 0x445701a0 0x1FC
