# elvees_vm14 register map
File version: 1.00
Registers are 32-bit, read-write, reset 0x0 unless marked. A register's access mark holds for its fields unless they carry their own. Offsets are from the block's base; [hi:lo] are bit positions; {n}, {i} and the like mark numbered series.

## GICVSELF
Base 0x39004000
Same registers: GICV 0x39005000
0x00 GICH_HCR — RW 0x00000000 Hypervisor Control Register
0x04 GICH_VTR — RO 0x90000003 VGIC Type Register, GICH_VTR on page 3-13
0x08 GICH_VMCR — RW 0x004C0000 Virtual Machine Control Register
0x10 GICH_MISR — RO 0x00000000 Maintenance Interrupt Status Register
0x20 GICH_EISR0 — RO 0x00000000 End of Interrupt Status Register
0x30 GICH_ELSR0 — RO 0x0000000F Empty List register Status Register
0xF0 GICH_APR0 — RW 0x00000000 Active Priority Register
{0x100+4i} GICH_LR{i} (i=0..3) — RW 0x00000000 List Register {i}

## GPIOA — Регистры блока управления GPIO
Base 0x38034000
Same registers: GPIOB 0x3803400C, GPIOC 0x38034018, GPIOD 0x38034024
0x00 gpio_swport_dr — Регистр данных порта А. W/R 0x0 0x00
0x04 gpio_swport_ddr — Регистр направления потока данных через порт А. W/R 0x0 0x04
0x08 gpio_swport_ctl — Регистр источника данных порта А. W/R 0x0 0x08

## GPIO0 — Регистры блока управления GPIO
Base 0x38034000
0x00 gpio_swporta_dr — Регистр данных порта А. W/R 0x0 0x00
0x04 gpio_swporta_ddr — Регистр направления потока данных через порт А. W/R 0x0 0x04
0x08 gpio_swporta_ctl — Регистр источника данных порта А. W/R 0x0 0x08
0x0C gpio_swportb_dr — Регистр данных порта B. W/R 0x0 0x0C
0x10 gpio_swportb_ddr — Регистр направления потока данных через порт B. W/R 0x0 0x10
0x14 gpio_swportb_ctl — Регистр источника данных порта B. W/R 0xFFFF 0x14
0x18 gpio_swportc_dr — Регистр данных порта C. W/R 0x0 0x18
0x1C gpio_swportc_ddr — Регистр направления потока данных через порт C. W/R 0x0 0x1C
0x20 gpio_swportc_ctl — Регистр источника данных порта C. W/R 0x0 0x20
0x24 gpio_swportd_dr — Регистр данных порта D. W/R 0x0 0x24
0x28 gpio_swportd_ddr — Регистр направления потока данных через порт D. W/R 0x0 0x28
0x2C gpio_swportd_ctl — Регистр источника данных порта D. W/R 0x0 0x2C
0x30 gpio_inten — Регистр включения прерываний. W/R 0x0 0x30
0x34 gpio_intmask — Регистр маскирования прерываний. W/R 0x0 0x34
0x38 gpio_inttype_level — Регистр уровня прерываний. W/R 0x0 0x38
0x3C gpio_int_polarity — Регистр полярности прерываний. W/R 0x0 0x3C
0x40 gpio_intstatus — Регистр статуса прерываний R 0x0 0x40
0x44 gpio_raw_intstatus — Регистр статуса немаскированных прерываний R 0x0 0x44
0x48 gpio_debounce — Регистр включения фильтра дребезга. W/R 0x0 0x48
0x4C gpio_porta_eoi — Регистр сброса прерываний. W 0x0 0x4C
0x50 gpio_ext_porta — Внешний регистр порта А. R 0x0 0x50
0x54 gpio_ext_portb — Внешний регистр порта B. R 0x0 0x54
0x58 gpio_ext_portc — Внешний регистр порта C. R 0x0 0x58
0x5C gpio_ext_portd — Внешний регистр порта D. R 0x0 0x5C
0x60 gpio_ls_sync — Регистр включения синхронизации прерываний по уровню. W/R 0x0 0x60

## I2C0
Base 0x3802C000
Same registers: I2C1 0x3802D000, I2C2 0x3802E000
0x00 IC_CON — Регистр управления W/R (R для 4-ого бита) 0x7F 0x0
0x04 IC_TAR — Регистр адреса абонента W/R 0x1055 0x4
0x08 IC_SAR — Регистр slave-адреса. W/R 0x55 0x8
0x0C IC_HS_MADD — Регистр кода адреса мастера для high speed режима. W/R 0x1 0xС
0x10 IC_DATA_CMD — Регистр управления передачей. W/R 0x0 0x10
0x14 IC_SS_SCL_HCNT — Старший регистр счетчика предделителя частоты для standard.speed режима. W/R 0x190 0x14
0x18 IC_SS_SCL_LCNT — Младший регистр счетчика предделителя частоты для standard.speed режима. W/R 0x1d6 0x18
0x1C IC_FS_SCL_HCNT — Старший регистр счетчика предделителя частоты для fast-speed режима. W/R 0x3c 0x1C
0x20 IC_FS_SCL_LCNT — Младший регистр счетчика предделителя частоты для fast-speed режима. W/R 0x82 0x20
0x24 IC_HS_SCL_HCNT — Старший регистр счетчика предделителя частоты для high-speed режима. W/R 0x6 0x24
0x28 IC_HS_SCL_LCNT — Младший регистр счетчика предделителя частоты для high-speed режима. W/R 0x10 0x28
0x2C IC_INTR_STAT — Регистр статуса прерывания. R 0x0 0x2C
0x30 IC_INTR_MASK — Регистр маски прерывания W/R 0x8ff 0X30
0x34 IC_RAW_INTR_STAT — Регистр статуса необработанного прерывания R 0x0 0x34
0x38 IC_RX_TL — Регистр порога заполнения FIFO приемника. W/R 0x0 0x38
0x3C IC_TX_TL — Регистр порога заполнения FIFO передатчика. W/R 0x0 0x3C
0x40 IC_CLT_INTR — Регистр сброса прерываний. R 0x0 0x40
0x44 C_CLR_RX_UNDER — Регистр сброса прерывания RX_UNDER R 0x0 0x44
0x48 IC_CLR_RX_OVER — Регистр сброса прерывания RX_OVER R 0x0 0x48
0x4C IC_CLR_TX_OVER — Регистр сброса прерывания TX_OVER R 0x0 0x4C
0x50 IC_CLR_RD_REQ — Регистр сброса прерывания RD_REQ R 0x0 0x50
0x54 IC_CLR_TX_ABR — Регистр сброса прерывания TX_ABR R 0x0 0x54
0x58 IC_CLR_RX_DONE — Регистр сброса прерывания RX_DONE R 0x0 0x58
0x5C IC_CLR_ACTIVITY — Регистр сброса прерывания ACTIVITY R 0x0 0x5C
0x60 IC_CLR_STOP_DET — Регистр сброса прерывания STOP_DET R 0x0 0x60
0x64 IC_CLR_START_DET — Регистр сброса прерывания START_DET R 0x0 0x64
0x68 IC_CLR_GEN_CALL — Регистр сброса прерывания GEN_CALL R 0x0 0x68
0x6C IC_ENABLE — Регистр включения шины. W/R 0x0 0x6C
0x70 IC_STATUS — Регистр статуса шины. R 0x6 0x70
0x74 IC_TXFLR — Регистр уровня FIFO передатчика R 0x0 0x74
0x78 IC_RXFLR — Регистр уровня FIFO приемника R 0x0 0x78
0x7C IC_SDA_HOLD — Регистр времени удержания SDA. W/R 0x1 0x7C
0x80 IC_TX_ABRT_SOURCE — Регистр статуса обрыва передачи. R 0x0 0x80
0x84 IC_SLV_DATA_NACK_ONLY — Регистр генерирования SLV_DATA_NACK W/R 0x0 0x84
0x88 IC_DMA_CR — Регистр контроля DMA интерфейса. W/R 0x0 0x88
0x8C IC_DMA_TDLR — Регистр передачи данных через DMA интерфейс. W/R 0x0 0x8C
0x90 IC_DMA_RDLR — Регистр приема данных через DMA интерфейс. W/R 0x0 0x90
0x94 IC_SDA_SETUP — Регистр установки SDA W/R 0x64 0x94
0x98 IC_ACK_GENERAL_CALL — Регистр вызова общего ACK W/R 0x1 0x98
0x9C IC_ENABLE_STATUS — Регистр статуса включения R 0x0 0x9C
0xA0 IC_FS_SPKLEN — Регистр управления фильтрацией для standard-speed и fast.speed режимов W/R 0x5 0xA0
0xA4 IC_HS_SPKLEN — Регистр управления фильтрацией для high.speed режима. W/R 0x1 0xA4
