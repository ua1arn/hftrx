# elvees_vm14 register map
File version: 1.00
Registers are 32-bit, read-write, reset 0x0 unless marked. A register's access mark holds for its fields unless they carry their own. Offsets are from the block's base; [hi:lo] are bit positions; lines under a group give offsets from that group; {n}, {i} and the like mark numbered series.

## SDMA — Регистры блока управления SDMA
Base 0x37220000
0x00 DSR — RO Состояние потока управления
0x04 DPC — RO Счётчик команд потока управления
0x20 INTEN — RW Разрешение прерываний
0x24 INT_EVENT_RIS — RO Статус прерываний/событий
0x28 INTMIS — RO Статус прерываний
0x2C INTCLR — WO Сброс прерываний
0x30 FSRD — RO Сбой потока управления
0x34 FSRC — RO Сбой потоков каналов
0x38 FTRD — RO Тип сбоя потока управления
{0x40+0x20*i} FTR[{i}] (i=0..7) — RO Тип ошибки канала 0..7
{0x100+0x40*i} unnamed[{i}] (i=0..7) group
  0x00 CSR — RO Статус канала 0..7
  0x04 CPC — RO PC канала 0..7
{0x400+0x100*i} unnamed[{i}] (i=0..7) group
  0x00 SAR — RO Адрес Источника для канала 0..7
  0x04 DAR — RO Адрес Приёмника для канала 0..7
  0x08 CCR — RO Регистр управления для канала 0..7
  0x0C LC0 — RO Счётчик циклов 0 для канала 0..7
  0x10 LC1 — RO Счётчик циклов 1 для канала 0..7
0xD00 DBGSTATUS — RO Debug Status Register
0xD04 DBGCMD — WO Debug Command Register
0xD08 DBGINST0 — WO 0-ой регистр отладки
0xD0C DBGINST1 — WO 1-ый регистр отладки
{0xE00+0x14*i} CR[{i}] (i=0..4) — RO Регистр конфигурации 0..4
0xE14 CRD — RO Конфигурация SDMA
0xE80 WD — RW Сторожевой регистр
0xFE0 periph_id_n — RO ID регистры периферии.
0xFF0 pcell_id_n — RO ID регистры компонента.

## SMCTR — общиме системные настройки микросхемы
Base 0x38096000
0x00 BOOT — Регистр отображения сигналов BOOT[1:0] микросхемы
0x04 BOOT_REMAP — Регистр управления картой памяти при начальной загрузке
0x08 MPU_CFGNMFI — Регистр разрешения немаскируемого FIQ в MPU
0x0C DDR_REMAP — Регистр управления картой памяти для DDR
0x24 MIPI_MUX — Регистр мультиплексирования MIPI DSI
0x28 CHIP_ID — ID микросхемы
0x2C CHIP_CONFIG — Регистр конфигурации микросхемы
0x30 EMA_ARM — Регистр подстройки памятей в ARM MPU
0x34 EMA_L2 — Регистр подстройки памятей в L2CACHE
0x38 EMA_DSP — Регистр подстройки памятей в DSP и VPU
0x3C EMA_CORE — Регистр подстройки памятей в CORE
0x40 IOPULL_CTR — Регистры управления подтягивающими резисторами контактных площадок микросхемы
0x44 COMM_DLOCK — Регистр индикации зависания коммутатора микросхемы

## SWIC0 — КОНТРОЛЛЕР ИНТЕРФЕЙСА SPACEWIRE (SWIC)
Base 0x38082000
Same registers: SWIC1 0x38084000
0x00 HW_VER — Номер версии контроллера RD 0x00
0x04 STATUS — Регистр состояния WR/RD 0x04
0x08 RX_CODE — Регистр управляющего символа, принятого из сети (маркера времени, кода распределенного прерывания, кода подтверждения распределенного прерывания или кода CC11) RD 0x08
0x0C MODE_CR — Регистр режима работы WR 0x0С
0x10 TX_SPEED — Регистр коэффициента скорости передачи WR 0x10
0x14 TX_CODE — Регистр управляющего символа (маркера времени, кода распределенного прерывания, кода подтверждения, кода CC11) для передачи в сеть WR 0x14
0x18 RX_SPEED — Регистр скорости приема данных в канале SpaceWire RD 0x18
0x20 CNT_RX_PACK — Регистр счетчика принятых пакетов ненулевой длины RD/WR 0x20
0x24 ISR_L — Младшие разряды регистра ISR RD/WR 0x24
0x28 ISR_H — Старшие разряды регистра ISR RD/WR 0x28
0x2C TRUE_TIME — Регистр, содержащий значение последнего правильного маркера времени и последнего принятого из сети маркера времени RD 0x2C
0x30 TOUT_CODE — Регистр размера таймаутов RD/WR 0x30
0x34 ISR_tout_L — Младшие разряды регистра флагов таймаутов ISR RD/WR 0x34
0x38 ISR_tout_H — Старшие разряды регистра флагов таймаутов ISR RD/WR 0x38
0x3C LOG_ADDR — Регистр логического адреса RD/WR 0x3С
0x40 ack_nonack_regime — Регистр управления режимом распределенных прерываний (с подтверждениями или без подтверждений) RD/WR 0x40
0x44 isr_touts2 — Регистр таймаутов кодов распределенных прерываний 2 RD/WR 0x44
0x48 ISR_handler_TERM_FUNCT — Регистр флагов функций терминального узла –обработчика RD/WR 0x48
0x4C ISR_SPEC — Регистр рассылки управляющих кодов в специальный набор портов RD/WR 0x4C
0x50 ISR_1101 — Регистр флагов приема управляющих кодов, назначение которых не определено в текущей версии стандарта RD/WR 0x50
0x54 ISR_MACK_1101 — Регистр маски портов, из которых не должны приниматься управляющие коды, назначение которых не определено в текущей версии стандарта RD/WR 0x54
0x58 INT_RESET — Регистр параметров команды внешнего сброса WR/RD 0x58
0x5C STATUS2 — Регистр состояния 0x5C
0x60 MODE_CR2 — Регистр режима работы 2 0x60
0x64 Int_H_mack — Старшая половина регистра маски распределенных прерываний WR/RD 0x64
0x68 Int_L_mack — Младшая половина регистра маски распределенных прерываний WR/RD 0x68
0x6C Ack_H_mack — Старшая половина регистра маски кодов подтверждения WR/RD 0x6C
0x70 Ackl_L_mack — Младшая половина регистра маски кодов подтверждения WR/RD 0x70
0x74 AUTO_SPEED_MANAGE — Регистр параметров автоматической установки скорости передачи WR/RD 0x74
0x78 ISR_source_TERM_FUNCT — Регистр флагов функций терминального узла –источника 0x78
0x7C ISR_spec_term_funct — Регистр признака специальной функции для терминального узла обработчика 0x7C
0x80 ISR_L_reset — Младшая половина регистра глобального сброса ISR 0x80
0x84 ISR_H_reset — Старшая половина регистра глобального сброса ISR 0x84

## DMA_MFBSP0 — Регистры встроенных DMA портов SWIC и MFBSP
Base 0x38087000
Same registers: DMA_SWIC0 0x38083000, DMA_SWIC1 0x38085000, DMA_MFBSP1 0x38089000
0x00 CSR — Регистр управления и состояния (по чтению сброс битов «END» и «DONE»)
0x04 CP — Регистр указателя цепочки
0x08 IR — Регистр индекса
0x0C RUN — На запись: Псевдорегистр управления состоянием бита RUN регистра CSR На чтение: Регистр управления и состояния без сброса битов «END» и «DONE»

## UART0 — Universal Asynchronous Receiver-Transmitter
Base 0x38028000
Same registers: UART1 0x38029000, UART2 0x3802A000, UART3 0x3802B000
0x00 UART_RBR_THR_DLL — UART Receive Buffer Register/Transmit Holding Register
0x04 UART_DLH_IER
0x08 UART_IIR_FCR — UART Interrupt Identity Register/UART FIFO Control Register
0x0C UART_LCR — UART Line Control Register
0x10 UART_MCR — UART Modem Control Register
0x14 UART_LSR — UART Line Status Register
0x18 UART_MSR — UART Modem Status Register
0x1C UART_SCR — UART Scratch Register
{0x30+0x40*i} UART_SRBR_STHR[{i}] (i=0..15)
0x7C UART_USR
0x80 UART_TFL
0x84 UART_RFL
0x88 UART_SRR
0x8C UART_SRTS
0x90 UART_SBCR — check address (was: 0x80)
0x98 UART_SFE
0x9C UART_SRT
0xA0 UART_STET
0xA4 UART_HTX
