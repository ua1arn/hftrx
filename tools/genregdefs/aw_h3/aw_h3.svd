# aw_h3 register map
File version: 1.00
Registers are 8-bit, read-write, reset 0x0 unless marked. A register's access mark holds for its fields unless they carry their own. Offsets are from the block's base; [hi:lo] are bit positions; {n}, {i} and the like mark numbered series.

## CCU — Clock Controller Unit (CCU)
Base 0x01C20000
0x00 PLL_CPUX_CTRL_REG 32-bit — PLL_CPUX Control Register
0x08 PLL_AUDIO_CTRL_REG 32-bit — PLL_AUDIO Control Register
0x10 PLL_VIDEO_CTRL_REG 32-bit — PLL_VIDEO Control Register
0x18 PLL_VE_CTRL_REG 32-bit — PLL_VE Control Register
0x20 PLL_DDR_CTRL_REG 32-bit — PLL_DDR Control Register
0x28 PLL_PERIPH0_CTRL_REG 32-bit — PLL_PERIPH0 Control Register
0x38 PLL_GPU_CTRL_REG 32-bit — PLL_GPU Control Register
0x44 PLL_PERIPH1_CTRL_REG 32-bit
0x48 PLL_DE_CTRL_REG 32-bit — PLL_DE Control Register
0x50 CPUX_AXI_CFG_REG 32-bit — CPUX/AXI Configuration Register
0x54 AHB1_APB1_CFG_REG 32-bit — AHB1/APB1 Configuration Register
0x58 APB2_CFG_REG 32-bit — APB2 Configuration Register
0x5C AHB2_CFG_REG 32-bit — AHB2 Configuration Register
{0x60+4i} BUS_CLK_GATING_REG{i} 32-bit (i=0..3) — Bus Clock Gating Register {i}
0x70 BUS_CLK_GATING_REG4 32-bit — Bus Clock Gating Register4
0x74 THS_CLK_REG 32-bit — THS Clock Register
0x80 NAND_CLK_REG 32-bit — NAND Clock Register
{0x88+4i} SDMMC{i}_CLK_REG 32-bit (i=0..2) — SDMMC{i} Clock Register
0x9C CE_CLK_REG 32-bit — CE Clock Register
0xA0 SPI0_CLK_REG 32-bit — SPI0 Clock Register
0xA4 SPI1_CLK_REG 32-bit — SPI1 Clock Register
{0xB0+4i} I2S_PCM{i}_CLK_REG 32-bit (i=0..2) — I2S/PCM{i} Clock Register
0xC0 OWA_CLK_REG 32-bit — OWA Clock Register
0xCC USBPHY_CFG_REG 32-bit — USBPHY Configuration Register
0xF4 DRAM_CFG_REG 32-bit — DRAM Configuration Register
0xFC MBUS_RST_REG 32-bit — MBUS Reset Register
0x100 DRAM_CLK_GATING_REG 32-bit — DRAM Clock Gating Register
0x104 DE_CLK_REG 32-bit — DE Clock Register
0x118 TCON0_CLK_REG 32-bit — TCON0 Clock Register
0x120 TVE_CLK_REG 32-bit — TVE Clock Register
0x124 DEINTERLACE_CLK_REG 32-bit — DEINTERLACE Clock Register
0x130 CSI_MISC_CLK_REG 32-bit — CSI_MISC Clock Register
0x134 CSI_CLK_REG 32-bit — CSI Clock Register
0x13C VE_CLK_REG 32-bit — VE Clock Register
0x140 AC_DIG_CLK_REG 32-bit — AC Digital Clock Register
0x144 AVS_CLK_REG 32-bit — AVS Clock Register
0x150 HDMI_CLK_REG 32-bit — HDMI Clock Register
0x154 HDMI_SLOW_CLK_REG 32-bit — HDMI Slow Clock Register
0x15C MBUS_CLK_REG 32-bit — MBUS Clock Register
0x1A0 GPU_CLK_REG 32-bit — GPU Clock Register
0x200 PLL_STABLE_TIME_REG0 32-bit — PLL Stable Time Register 0
0x204 PLL_STABLE_TIME_REG1 32-bit — PLL Stable Time Register 1
0x220 PLL_CPUX_BIAS_REG 32-bit — PLL_CPUX Bias Register
0x224 PLL_AUDIO_BIAS_REG 32-bit — PLL_AUDIO Bias Register
0x228 PLL_VIDEO_BIAS_REG 32-bit — PLL_VIDEO Bias Register
0x22C PLL_VE_BIAS_REG 32-bit — PLL_VE Bias Register
0x230 PLL_DDR_BIAS_REG 32-bit — PLL_DDR Bias Register
0x234 PLL_PERIPH0_BIAS_REG 32-bit — PLL_PERIPH0 Bias Register
0x23C PLL_GPU_BIAS_REG 32-bit — PLL_GPU Bias Register
0x244 PLL_PERIPH1_BIAS_REG 32-bit — PLL_PERIPH1 Bias Register
0x248 PLL_DE_BIAS_REG 32-bit — PLL_DE Bias Register
0x250 PLL_CPUX_TUN_REG 32-bit — PLL_CPUX Tuning Register
0x260 PLL_DDR_TUN_REG 32-bit — PLL_DDR Tuning Register
0x280 PLL_CPUX_PAT_CTRL_REG 32-bit — PLL_CPUX Pattern Control Register
0x284 PLL_AUDIO_PAT_CTRL_REG0 32-bit — PLL_AUDIO Pattern Control Register
0x288 PLL_VIDEO_PAT_CTRL_REG0 32-bit — PLL_VIDEO Pattern Control Register
0x28C PLL_VE_PAT_CTRL_REG 32-bit — PLL_VE Pattern Control Register
0x290 PLL_DDR_PAT_CTRL_REG0 32-bit — PLL_DDR Pattern Control Register
0x29C PLL_GPU_PAT_CTRL_REG 32-bit — PLL_GPU Pattern Control Register
0x2A4 PLL_PERIPH1_PAT_CTRL_REG1 32-bit — PLL_PERIPH1 Pattern Control Register
0x2A8 PLL_DE_PAT_CTRL_REG 32-bit — PLL_DE Pattern Control Register
{0x2C0+4i} BUS_SOFT_RST_REG{i} 32-bit (i=0..2) — Bus Software Reset Register {i}
0x2D0 BUS_SOFT_RST_REG3 32-bit — Bus Software Reset Register 3
0x2D8 BUS_SOFT_RST_REG4 32-bit — Bus Software Reset Register 4
0x2F0 CCU_SEC_SWITCH_REG 32-bit — CCU Security Switch Register
0x300 PS_CTRL_REG 32-bit — PS Control Register
0x304 PS_CNT_REG 32-bit — PS Counter Register
