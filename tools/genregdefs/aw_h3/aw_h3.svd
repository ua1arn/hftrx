# aw_h3 register map
File version: 1.00
Registers are 8-bit, read-write, reset 0x0 unless marked. A register's access mark holds for its fields unless they carry their own. Offsets are from the block's base; [hi:lo] are bit positions; lines under a group give offsets from that group; {n}, {i} and the like mark numbered series.

## SYSCTRL
Base 0x01C00000
0x24 VER_REG 32-bit — Version Register
0x30 EMAC_EPHY_CLK_REG 32-bit — EMAC-EPHY Clock Register

## TCON0 — TCON0, TCON1
Base 0x01C0C000
Same registers: TCON1 0x01C0D000
0x00 TCON_GCTL_REG 32-bit — TCON global control register
0x04 TCON_GINT0_REG 32-bit — TCON global interrupt register0
0x08 TCON_GINT1_REG 32-bit — TCON global interrupt register1
0x90 TCON1_CTL_REG 32-bit — TCON1 control register
{0x94+4i} TCON1_BASIC{i}_REG 32-bit (i=0..5) — TCON1 basic timing register{i}
0xB0 TCON1_PS_SYNC_REG 32-bit — TCON1 sync register
0xF0 TCON1_IO_POL_REG 32-bit — TCON1 IO polarity register
0xF4 TCON1_IO_TRI_REG 32-bit — TCON1 IO control register
0xF8 TCON_ECC_FIFO_REG 32-bit — TCON ECC FIFO register
0x100 TCON_CEU_CTL_REG 32-bit — TCON CEU control register
{0x110+0x2C*i} TCON_CEU_COEF_MUL_REG[{i}] (i=0..10) 32-bit — TCON CEU coefficient register0 (N=0,1,2,4,5,6,8,9,10)
{0x140+0xC*i} TCON_CEU_COEF_RANG_REG[{i}] (i=0..2) 32-bit — TCON CEU coefficient register2 (N=0,1,2)
0x1F0 TCON_SAFE_PERIOD_REG 32-bit — TCON safe period register
0x300 TCON1_FILL_CTL_REG 32-bit — TCON1 fill data control register
{0x304+0x24*i} unnamed[{i}] (i=0..2) group
  0x00 TCON1_FILL_BEGIN_REG 32-bit — TCON1 fill data begin register (N=0,1,2)
  0x04 TCON1_FILL_END_REG 32-bit — TCON1 fill data end register (N=0,1,2)
  0x08 TCON1_FILL_DATA0_REG 32-bit — TCON1 fill data value register (N=0,1,2)
{0x400+0x400*i} TCON1_GAMMA_TABLE_REG[{i}] (i=0..255) 32-bit — Gamma Table 0x400-0x7FF
0xFFC TCON_ECC_FIFO_BIST_REG 32-bit

## TIMER
Base 0x01C20C00
0x00 TMR_IRQ_EN_REG 32-bit — Timer IRQ Enable Register
0x04 TMR_IRQ_STA_REG 32-bit — Timer Status Register
{0x10+0x20*i} unnamed[{i}] (i=0..1) group
  0x00 CTRL_REG 32-bit — Timer n Control Register
  0x04 INTV_VALUE_REG 32-bit — Timer n Interval Value Register
  0x08 CUR_VALUE_REG 32-bit — Timer n Current Value Register
0x80 AVS_CNT_CTL_REG 32-bit — AVS Control Register
0x84 AVS_CNT0_REG 32-bit — AVS Counter 0 Register
0x88 AVS_CNT1_REG 32-bit — AVS Counter 1 Register
0xA0 WDOG_IRQ_EN_REG 32-bit — Watchdog IRQ Enable Register
0xA4 WDOG_IRQ_STA_REG 32-bit — Watchdog Status Register
0xB0 WDOG_CTRL_REG 32-bit — Watchdog Control Register
0xB4 WDOG_CFG_REG 32-bit — Watchdog Configuration Register
0xB8 WDOG_MODE_REG 32-bit — Watchdog Mode Register

## UART0
Base 0x01C28000
Same registers: UART1 0x01C28400, UART2 0x01C28800, UART3 0x01C28C00, UART4 0x01C29000, R_UART 0x01F02800
0x00 UART_RBR_THR_DLL 32-bit — UART Receive Buffer Register/Transmit Holding Register
0x04 UART_DLH_IER 32-bit
0x08 UART_IIR_FCR 32-bit — UART Interrupt Identity Register/UART FIFO Control Register
0x0C UART_LCR 32-bit — UART Line Control Register
0x10 UART_MCR 32-bit — UART Modem Control Register
0x14 UART_LSR 32-bit — UART Line Status Register
0x18 UART_MSR 32-bit — UART Modem Status Register
0x1C UART_SCH 32-bit — UART Scratch Register
0x7C UART_USR 32-bit — UART Status Register
0x80 UART_TFL 32-bit — UART Transmit FIFO Level Register
0x84 UART_RFL 32-bit — UART Receive FIFO Level Register
0x8C UART_DMA_REQ_EN 32-bit — UART DMA Request Enable Register
0xA4 UART_HALT 32-bit — UART Halt TX Register

## USB20_OTG_DEVICE — USB OTG Dual-Role Device controller
Base 0x01C19000
{0x0+0x40*i} USB_EPFIFO[{i}] (i=0..15) 32-bit — USB_EPFIFO [0..5] USB FIFO Entry for Endpoint N
0x40 USB_GCS 32-bit — USB_POWER, USB_DEVCTL, USB_EPINDEX, USB_DMACTL USB Global Control and Status Register
0x44 USB_EPINTF 32-bit — USB_INTTX - lower 16, USB_INTRX - high 16, USB_EPINTF USB Endpoint Interrupt Flag Register
0x48 USB_EPINTE 32-bit — USB_INTTXE - lower 16, USB_INTRXE - high 16, USB_EPINTE USB Endpoint Interrupt Enable Register
0x4C USB_INTUSB 32-bit — USB_INTUSB USB_BUSINTF USB Bus Interrupt Flag Register
0x50 USB_INTUSBE 32-bit — USB_INTUSBE USB_BUSINTE USB Bus Interrupt Enable Register
0x54 USB_FNUM 32-bit — USB Frame Number Register
0x7C USB_TESTC 32-bit — USB_TESTC USB Test Control Register
0x80 USB_TXMAXP 16-bit — USB_TXMAXP USB EP1~5 Tx Control and Status Register
0x82 USB_TXCSRHI 16-bit — [15:8]: USB_TXCSRH, [7:0]: USB_TXCSRL
0x84 USB_RXMAXP 16-bit — USB_RXMAXP USB EP1~5 Rx Control and Status Register
0x86 USB_RXCSRHI 16-bit — USB_RXCSR
0x88 USB_RXCOUNT 32-bit — USB_RXCOUNT, USB_RXPKTCNT - high 16 bits
0x8C USB_EPATTR 32-bit — USB_EPATTR USB EP0 Attribute Register, USB EP1~5 Attribute Register
0x90 USB_TXFIFO 32-bit — USB_TXFIFO (bits 28:16 Start address of the endpoint FIFO is in units of 8 bytes)
0x94 USB_RXFIFO 32-bit — USB_RXFIFO (bits 28:16 Start address of the endpoint FIFO is in units of 8 bytes)
{0x98+0x70*i} unnamed[{i}] (i=0..15) group
  0x00 USB_TXFADDR 16-bit
  0x02 USB_TXHADDR
  0x03 USB_TXHUBPORT
  0x04 USB_RXFADDR
  0x06 USB_RXHADDR
  0x07 USB_RXHUBPORT
0x400 USB_ISCR 32-bit — HCI Interface Register (HCI_Interface)
0x404 USBPHY_PHYCTL 32-bit
0x408 HCI_CTRL3 32-bit — HCI Control 3 Register (bist)
0x410 PHY_CTRL 32-bit — PHY Control Register (PHY_Control)
0x420 PHY_OTGCTL 32-bit — Control PHY routing to EHCI or OTG
0x424 PHY_STATUS 32-bit
0x428 USB_SPDCR 32-bit — HCI SIE Port Disable Control Register
0x500 USB_DMA_INTE 32-bit — USB DMA Interrupt Enable Register
0x504 USB_DMA_INTS 32-bit — USB DMA Interrupt Status Register
{0x540+0x100*i} unnamed[{i}] (i=0..15) group
  0x00 CHAN_CFG 32-bit — USB DMA Channel Configuration Register
  0x04 SDRAM_ADD 32-bit — USB DMA SDRAM Start Address Register
  0x08 BC 32-bit — USB DMA Byte Counter Register
  0x0C RESIDUAL_BC 32-bit — USB DMA RESIDUAL Byte Counter Register

## USB20_HOST0_EHCI
Base 0x01C1A000
Same registers: USB20_HOST1_EHCI 0x01C1B000, USB20_HOST2_EHCI 0x01C1C000, USB20_HOST3_EHCI 0x01C1D000
0x00 HCCAPBASE 32-bit — EHCI Capability Register (HCIVERSION and CAPLENGTH) register
0x04 HCSPARAMS 32-bit — EHCI Host Control Structural Parameter Register
0x08 HCCPARAMS 32-bit — EHCI Host Control Capability Parameter Register
0x0C HCSPPORTROUTE 32-bit — EHCI Companion Port Route Description
0x10 USBCMD 32-bit — EHCI USB Command Register
0x14 USBSTS 32-bit — EHCI USB Status Register
0x18 USBINTR 32-bit — EHCI USB Interrupt Enable Register
0x1C FRINDEX 32-bit — EHCI USB Frame Index Register
0x20 CTRLDSSEGMENT 32-bit — EHCI 4G Segment Selector Register
0x24 PERIODICLISTBASE 32-bit — EHCI Frame List Base Address Register
0x28 ASYNCLISTADDR 32-bit — EHCI Next Asynchronous List Address Register

## USB20_HOST0_OHCI
Base 0x01C1A400
Same registers: USB20_HOST1_OHCI 0x01C1B400, USB20_HOST2_OHCI 0x01C1C400, USB20_HOST3_OHCI 0x01C1D400
0x00 O_HcRevision 32-bit — OHCI Revision Register (not documented)
0x04 O_HcControl 32-bit — OHCI Control Register
0x08 O_HcCommandStatus 32-bit — OHCI Command Status Register
0x0C O_HcInterruptStatus 32-bit — OHCI Interrupt Status Register
0x10 O_HcInterruptEnable 32-bit — OHCI Interrupt Enable Register
0x14 O_HcInterruptDisable 32-bit — OHCI Interrupt Disable Register
0x18 O_HcHCCA 32-bit — OHCI HCCA Base
0x1C O_HcPeriodCurrentED 32-bit — OHCI Period Current ED Base
0x20 O_HcControlHeadED 32-bit — OHCI Control Head ED Base
0x24 O_HcControlCurrentED 32-bit — OHCI Control Current ED Base
0x28 O_HcBulkHeadED 32-bit — OHCI Bulk Head ED Base
0x2C O_HcBulkCurrentED 32-bit — OHCI Bulk Current ED Base
0x30 O_HcDoneHead 32-bit — OHCI Done Head Base
0x34 O_HcFmInterval 32-bit — OHCI Frame Interval Register
0x38 O_HcFmRemaining 32-bit — OHCI Frame Remaining Register
0x3C O_HcFmNumber 32-bit — OHCI Frame Number Register
0x40 O_HcPerioddicStart 32-bit — OHCI Periodic Start Register
0x44 O_HcLSThreshold 32-bit — OHCI LS Threshold Register
0x48 O_HcRhDescriptorA 32-bit — OHCI Root Hub Descriptor Register A
0x4C O_HcRhDesriptorB 32-bit — OHCI Root Hub Descriptor Register B
0x50 O_HcRhStatus 32-bit — OHCI Root Hub Status Register
{0x54+4i} O_HcRhPortStatus[{i}] (i=0..0) 32-bit — OHCI Root Hub Port Status Register
