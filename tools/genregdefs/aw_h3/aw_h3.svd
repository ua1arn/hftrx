# aw_h3 register map
File version: 1.00
Registers are 8-bit, read-write, reset 0x0 unless marked. A register's access mark holds for its fields unless they carry their own. Offsets are from the block's base; [hi:lo] are bit positions; lines under a group give offsets from that group; {n}, {i} and the like mark numbered series.

## DE_MIXER0_BLD
Base 0x01101000
Same registers: DE_MIXER1_BLD 0x01201000
0x00 BLD_EN_COLOR_CTL 32-bit — BLD_FILL_COLOR_CTL Offset 0x000 BLD fill color control register
{0x4+0x60*i} unnamed[{i}] (i=0..5) group
  0x00 BLD_FILL_COLOR 32-bit
  0x04 BLD_CH_ISIZE 32-bit — BLD input memory size register
  0x08 BLD_CH_OFFSET 32-bit — BLD input memory offset register
0x80 ROUTE 32-bit — BLD_CH_RTCTL BLD routing control register (default value 0x00543210)
0x84 PREMULTIPLY 32-bit — BLD pre-multiply control register
0x88 BKCOLOR 32-bit
0x8C OUTPUT_SIZE 32-bit
{0x90+0x18*i} BLD_MODE[{i}] (i=0..5) 32-bit — BLD_CTL SUN8I_MIXER_BLEND_MODE blender0..blaener3 (or more)
0xB0 CK_CTL 32-bit
0xB4 CK_CFG 32-bit
{0xC0+0x10*i} CK_MAX[{i}] (i=0..3) 32-bit
{0xE0+0x10*i} CK_MIN[{i}] (i=0..3) 32-bit
0xFC OUT_CTL 32-bit

## DE_CSR — Copy & Rotation
Base 0x01020000
0x00 CSR_CTL 32-bit
0x04 INT 32-bit — Interrupt register
0x20 IFMT 32-bit — Input data attribute register
0x24 IDATA_SIZE 32-bit — Input data size register
0x30 IDATA_MEN_PITCH0 32-bit — Input Y/RGB/ARGB memory pitch register
0x34 IDATA_MEN_PITCH1 32-bit — Input U/UV memory pitch register
0x38 IDATA_MEN_PITCH2 32-bit — Input V memory pitch register
0x40 IMEN_LADD0 32-bit — Input Y/RGB/ARGB memory address register0
0x44 IMEN_HADD0 32-bit — Input Y/RGB/ARGB memory address register1
0x48 IMEN_LADD1 32-bit — Input U/UV memory address register0
0x4C IMEN_HADD1 32-bit — Input U/UV memory address register1
0x50 IMEN_LADD2 32-bit — Input V memory address register0
0x54 IMEN_HADD2 32-bit — Input V memory address register1
0x84 ODATA_SIZE 32-bit — Output data size register
{0x90+4i} ODATA_MEN_PITCH{i} 32-bit (i=0..2)
0xA0 OMEN_LADD0 32-bit — Output Y/RGB/ARGB memory address register0
0xA4 OMEN_HADD0 32-bit — Output Y/RGB/ARGB memory address register1
0xA8 OMEN_LADD1 32-bit — Output U/UV memory address register0
0xAC OMEN_HADD1 32-bit — Output U/UV memory address register1
0xB0 OMEN_LADD2 32-bit — Output V memory address register0
0xB4 OMEN_HADD2 32-bit — Output V memory address register1

## DE_MIXER0_GLB
Base 0x01100000
Same registers: DE_MIXER1_GLB 0x01200000
0x00 GLB_CTL 32-bit — Global control register
0x04 GLB_STS 32-bit — Global status register
0x08 GLB_DBUFFER 32-bit — Global double buffer control register
0x0C GLB_SIZE 32-bit — Global size register

## DE_TOP — Display Engine Top
Base 0x01000000
0x00 SCLK_GATE 32-bit — DE SCLK Gating Register
0x04 HCLK_GATE 32-bit — DE HCLK Gating Register
0x08 AHB_RESET 32-bit — DE AHB Reset register
0x0C SCLK_DIV 32-bit — DE SCLK Division register
0x10 DE2TCON_MUX 32-bit — MUX register
0x14 CMD_CTL 32-bit

## DE_MIXER0_UI1
Base 0x01103000
Same registers: DE_MIXER0_UI2 0x01104000, DE_MIXER0_UI3 0x01105000, DE_MIXER1_UI1 0x01203000
{0x0+0x80*i} unnamed[{i}] (i=0..3) group
  0x00 ATTR 32-bit
  0x04 SIZE 32-bit
  0x08 COORD 32-bit
  0x0C PITCH 32-bit
  0x10 TOP_LADDR 32-bit
  0x14 BOT_LADDR 32-bit
  0x18 FCOLOR 32-bit
0x80 TOP_HADDR 32-bit
0x84 BOT_HADDR 32-bit
0x88 OVL_SIZE 32-bit

## DE_MIXER0_UIS1 — UI Scaler(UIS) provides RGB format image resizing function
Base 0x01140000
Same registers: DE_MIXER0_UIS2 0x01150000, DE_MIXER0_UIS3 0x01160000, DE_MIXER1_UIS1 0x01240000
0x00 UIS_CTRL_REG 32-bit — Control register
0x08 UIS_STATUS_REG 32-bit — Status register
0x0C UIS_FIELD_CTRL_REG 32-bit — Field control register
0x10 UIS_BIST_REG 32-bit — BIST control register
0x40 UIS_OUT_SIZE_REG 32-bit — Output size register
0x80 UIS_INSIZE_REG 32-bit — Input size register
0x88 UIS_HSTEP_REG 32-bit — Horizontal step register
0x8C UIS_VSTEP_REG 32-bit — Vertical step register
0x90 UIS_HPHASE_REG 32-bit — Horizontal initial phase register
0x98 UIS_VPHASE0_REG 32-bit — Vertical initial phase 0 register
0x9C UIS_VPHASE1_REG 32-bit — Vertical initial phase 1 register
{0x200+0x40*i} UIS_HCOEF_REGN[{i}] (i=0..15) 32-bit — Horizontal filter coefficient register N (N=0:15)

## Notices in the file
Copyright (c) 2024 by Genadi V. Zawidowski. All rights reserved.
