# aw_h3 register map
File version: 1.00
Registers are 8-bit, read-write, reset 0x0 unless marked. A register's access mark holds for its fields unless they carry their own. Offsets are from the block's base; [hi:lo] are bit positions; lines under a group give offsets from that group; {n}, {i} and the like mark numbered series.

## DE_MIXER0_VI1
Base 0x01102000
Same registers: DE_MIXER1_VI1 0x01202000
{0x0+0xC0*i} unnamed[{i}] (i=0..3) group
  0x00 ATTR 32-bit
  0x04 SIZE 32-bit
  0x08 COORD 32-bit
  {0xC+0xC*j} PITCH[{j}] (j=0..2) 32-bit — ix=0: Y, ix=1: U/UV channel, ix=3: V channel
  {0x18+0xC*j} TOP_LADDR[{j}] (j=0..2) 32-bit
  {0x24+0xC*j} BOT_LADDR[{j}] (j=0..2) 32-bit
{0xC0+0x10*i} FCOLOR[{i}] (i=0..3) 32-bit
{0xD0+0xC*i} TOP_HADDR[{i}] (i=0..2) 32-bit
{0xDC+0xC*i} BOT_HADDR[{i}] (i=0..2) 32-bit
{0xE8+8i} OVL_SIZE[{i}] (i=0..1) 32-bit — OVL_Y, OVL_UV overlay window size register
{0xF0+8i} HORI[{i}] (i=0..1) 32-bit — OVL_V horizontal down sample control register
{0xF8+8i} VERT[{i}] (i=0..1) 32-bit — OVL_V vertical down sample control register

## DE_MIXER0_VSU1 — Video Scaler Unit (VSU), VS
Base 0x01120000
Same registers: DE_MIXER1_VSU1 0x01220000
0x00 VSU_CTRL_REG 32-bit — VSU Module Control Register
0x08 VSU_STATUS_REG 32-bit — VSU Status Register
0x0C VSU_FIELD_CTRL_REG 32-bit — VSU Field Control Register
0x10 VSU_SCALE_MODE_REG 32-bit — VSU Scale Mode Setting Register
0x20 VSU_DIRECTION_THR_REG 32-bit — VSU Direction Detection Threshold Register
0x24 VSU_EDGE_THR_REG 32-bit — VSU Edge Detection Setting Register
0x28 VSU_EDSCALER_CTRL_REG 32-bit — VSU Edge-Direction Scaler Control Register
0x2C VSU_ANGLE_THR_REG 32-bit — VSU Angle Reliability Setting Register
0x30 VSU_SHARP_EN_REG 32-bit — VSU Sharpness Control Enable Register
0x34 VSU_SHARP_CORING_REG 32-bit — VSU Sharpness Control Coring Setting Register
0x38 VSU_SHARP_GAIN0_REG 32-bit — VSU Sharpness Control Gain Setting 0 Register
0x3C VSU_SHARP_GAIN1_REG 32-bit — VSU Sharpness Control Gain Setting 1 Register
0x40 VSU_OUT_SIZE_REG 32-bit — VSU Output Size Register
0x44 VSU_GLOBAL_ALPHA_REG 32-bit — VSU Output Global Alpha Register
0x80 VSU_Y_SIZE_REG 32-bit — VSU Y Channel Size Register
0x88 VSU_Y_HSTEP_REG 32-bit — VSU Y Channel Horizontal Step Register
0x8C VSU_Y_VSTEP_REG 32-bit — VSU Y Channel Vertical Step Register
0x90 VSU_Y_HPHASE_REG 32-bit — VSU Y Channel Horizontal Initial Phase Register
0x98 VSU_Y_VPHASE0_REG 32-bit — VSU Y Channel Vertical Initial Phase 0 Register
0x9C VSU_Y_VPHASE1_REG 32-bit — VSU Y Channel Vertical Initial Phase 1 Register
0xC0 VSU_C_SIZE_REG 32-bit — VSU C Channel Size Register
0xC8 VSU_C_HSTEP_REG 32-bit — VSU C Channel Horizontal Step Register
0xCC VSU_C_VSTEP_REG 32-bit — VSU C Channel Vertical Step Register
0xD0 VSU_C_HPHASE_REG 32-bit — VSU C Channel Horizontal Initial Phase Register
0xD8 VSU_C_VPHASE0_REG 32-bit — VSU C Channel Vertical Initial Phase 0 Register
0xDC VSU_C_VPHASE1_REG 32-bit — VSU C Channel Vertical Initial Phase 1 Register
{0x200+0x80*i} VSU_Y_HCOEF0_REGN[{i}] (i=0..31) 32-bit — 0x200+N*4 VSU Y Channel Horizontal Filter Coefficient0 Register N N = M 1))
{0x300+0x80*i} VSU_Y_HCOEF1_REGN[{i}] (i=0..31) 32-bit — 0x300+N*4 VSU Y Channel Horizontal Filter Coefficient1 Register N N = M 1
{0x400+0x80*i} VSU_Y_VCOEF_REGN[{i}] (i=0..31) 32-bit — 0x400+N*4 VSU Y Channel Vertical Filter Coefficient Register N N = M 1))
{0x600+0x80*i} VSU_C_HCOEF0_REGN[{i}] (i=0..31) 32-bit — 0x600+N*4 VSU C Channel Horizontal Filter Coefficient0 Register N N = M 1))
{0x700+0x80*i} VSU_C_HCOEF1_REGN[{i}] (i=0..31) 32-bit — 0x700+N*4 VSU C Channel Horizontal Filter Co efficient1 Register N N = M 1))
{0x800+0x80*i} VSU_C_VCOEF_REGN[{i}] (i=0..31) 32-bit — 0x800+N*4 VSU C Channel Vertical Filter Coefficient Register N N = M 1))

## DE_WB — Real-time write-back controller (RT-WB)
Base 0x01010000
0x00 WB_GCTRL_REG 32-bit — Module general control register
0x04 WB_SIZE_REG 32-bit — Input size register
0x08 WB_CROP_COORD_REG 32-bit — Cropping coordinate register
0x0C WB_CROP_SIZE_REG 32-bit — Cropping size register
{0x10+4i} WB_A_CH{i}_ADDR_REG 32-bit (i=0..2) — Write-back Group A channel {i} address register
0x1C WB_A_HIGH_ADDR_REG 32-bit — Write-back Group A address high bit register
{0x20+4i} WB_B_CH{i}_ADDR_REG 32-bit (i=0..2) — Write-back Group B channel {i} address register
0x2C WB_B_HIGH_ADDR_REG 32-bit — Write-back Group B address high bit register
0x30 WB_CH0_PITCH_REG 32-bit — Write-back channel 0 pitch register
0x34 WB_CH12_PITCH_REG 32-bit — Write-back channel 1/2 pitch register
0x40 WB_ADDR_SWITCH_REG 32-bit — Write-back address switch setting register
0x44 WB_FORMAT_REG 32-bit — Output format register
0x48 WB_INT_REG 32-bit — Interrupt control register
0x4C WB_STATUS_REG 32-bit — Module status register
0x54 WB_BYPASS_REG 32-bit — Bypass control register
0x70 WB_CS_HORZ_REG 32-bit — Coarse scaling horizontal setting register
0x74 WB_CS_VERT_REG 32-bit — Coarse scaling vertical setting register
0x80 WB_FS_INSIZE_REG 32-bit — Fine scaling input size register
0x84 WB_FS_OUTSIZE_REG 32-bit — Fine scaling output size register
0x88 WB_FS_HSTEP_REG 32-bit — Fine scaling horizontal step registe
0x8C WB_FS_VSTEP_REG 32-bit — Fine scaling vertical step register
0xFC WB_DEBUG_REG 32-bit — Debug register
{0x200+0x40*i} WB_CH0_HCOEF_REGN[{i}] (i=0..15) 32-bit — 0x200 + N*4 Channel 0 horizontal coefficient register N ( N = 0,1,2,...,15)
{0x280+0x40*i} WB_CH1_HCOEF_REGN[{i}] (i=0..15) 32-bit — 0x280 + N*4 Channel 1/2 horizontal coefficient register N ( N = 0,1,2,...,15)
