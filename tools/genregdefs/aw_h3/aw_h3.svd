# aw_h3 register map
File version: 1.00
for test
Registers are 8-bit, read-write, reset 0x0 unless marked. A register's access mark holds for its fields unless they carry their own. Offsets are from the block's base; lines under a group give offsets from that group; [hi:lo] are bit positions; {n}, {i} and the like mark numbered series; 'fields as' and 'values as' point back to an identical list; <NAME> marks a mode.

## Memory map
0x01000000 DE_TOP — Display Engine Top
0x01010000 DE_WB — Real-time write-back controller (RT-WB)
0x01020000 DE_CSR — Copy & Rotation
0x01100000 DE_MIXER0_GLB
0x01101000 DE_MIXER0_BLD
0x01102000 DE_MIXER0_VI1
0x01103000 DE_MIXER0_UI1
0x01104000 DE_MIXER0_UI2
0x01105000 DE_MIXER0_UI3
0x01120000 DE_MIXER0_VSU1 — Video Scaler Unit (VSU), VS
0x01140000 DE_MIXER0_UIS1 — UI Scaler(UIS) provides RGB format image resizing function
0x01150000 DE_MIXER0_UIS2
0x01160000 DE_MIXER0_UIS3
0x01200000 DE_MIXER1_GLB
0x01201000 DE_MIXER1_BLD
0x01202000 DE_MIXER1_VI1
0x01203000 DE_MIXER1_UI1
0x01220000 DE_MIXER1_VSU1
0x01240000 DE_MIXER1_UIS1
0x01C00000 SYSCTRL
0x01C0C000 TCON0 — TCON0, TCON1
0x01C0D000 TCON1
0x01C19000 USB20_OTG_DEVICE — USB OTG Dual-Role Device controller
0x01C1A000 USB20_HOST0_EHCI
0x01C1A400 USB20_HOST0_OHCI
0x01C1B000 USB20_HOST1_EHCI
0x01C1B400 USB20_HOST1_OHCI
0x01C1C000 USB20_HOST2_EHCI
0x01C1C400 USB20_HOST2_OHCI
0x01C1D000 USB20_HOST3_EHCI
0x01C1D400 USB20_HOST3_OHCI
0x01C20000 CCU — Clock Controller Unit (CCU)
0x01C20800 GPIOA
0x01C20800 GPIOBLOCK
0x01C20848 GPIOC
0x01C2086C GPIOD
0x01C20890 GPIOE
0x01C208B4 GPIOF
0x01C208D8 GPIOG
0x01C20A00 GPIOINTA
0x01C20A20 GPIOINTG
0x01C20C00 TIMER
0x01C28000 UART0
0x01C28400 UART1
0x01C28800 UART2
0x01C28C00 UART3
0x01C29000 UART4
0x01C84000 GICVSELF
0x01C85000 GICV
0x01EE0000 HDMI_TX0
0x01EF0000 HDMI_PHY
0x01F00000 RTC
0x01F01400 R_PRCM
0x01F01C00 CPUCFG — CPU Configuration
0x01F02800 R_UART
0x01F02C00 GPIOL

## Interrupts
32 UART0 (UART{n} (n=0..4), R_UART)
33 UART1 (UART{n} (n=0..4), R_UART)
34 UART2 (UART{n} (n=0..4), R_UART)
35 UART3 (UART{n} (n=0..4), R_UART)
43 PA_EINT (GPIOINTA, GPIOINTG)
49 PG_EINT (GPIOINTA, GPIOINTG)
50 TIMER0 (TIMER)
51 TIMER1 (TIMER)
70 R_UART (UART{n} (n=0..4), R_UART)
77 R_PL_EINT (GPIOINTA, GPIOINTG)
103 USB20_OTG_DEVICE
104 USB20_HOST0_EHCI (USB20_HOST{n}_EHCI (n=0..3))
105 USB20_HOST0_OHCI (USB20_HOST{n}_OHCI (n=0..3))
106 USB20_HOST1_EHCI (USB20_HOST{n}_EHCI (n=0..3))
107 USB20_HOST1_OHCI (USB20_HOST{n}_OHCI (n=0..3))
108 USB20_HOST2_EHCI (USB20_HOST{n}_EHCI (n=0..3))
109 USB20_HOST2_OHCI (USB20_HOST{n}_OHCI (n=0..3))
110 USB20_HOST3_EHCI (USB20_HOST{n}_EHCI (n=0..3))
111 USB20_HOST3_OHCI (USB20_HOST{n}_OHCI (n=0..3))
118 TCON0 (TCON0, TCON1)
119 TCON1 (TCON0, TCON1)
120 HDMI_TX0
127 DE (DE_TOP)
140 CTI0 (CPUCFG)
141 CTI1 (CPUCFG)
142 CTI2 (CPUCFG)
143 CTI3 (CPUCFG)
144 COMMTX0 (CPUCFG)
145 COMMTX1 (CPUCFG)
146 COMMTX2 (CPUCFG)
147 COMMTX3 (CPUCFG)
148 COMMRX0 (CPUCFG)
149 COMMRX1 (CPUCFG)
150 COMMRX2 (CPUCFG)
151 COMMRX3 (CPUCFG)
152 PMU0 (CPUCFG)
153 PMU1 (CPUCFG)
154 PMU2 (CPUCFG)
155 PMU3 (CPUCFG)
156 AXI_ERROR (CPUCFG)

## CPUCFG — CPU Configuration
Base 0x01F01C00
0x00 CPUS_RST_CTRL_REG 32-bit — CPUS reset control register
{0x40+0x100*i} unnamed[{i}] (i=0..3) group
  0x00 CPU_RST_CTRL_REG 32-bit — CPU0 reset control
  0x04 CPU_CTRL_REG 32-bit — CPU0 control register
  0x08 CPU_STATUS_REG 32-bit — CPU0 status register
0x140 CPU_SYS_RST_REG 32-bit — CPU System Reset Register
0x144 CPU_CLK_GATING_REG 32-bit — CPU clock gating Register
0x184 GENER_CTRL_REG 32-bit — General Control Register
0x1A0 SUP_STAN_FLAG_REG 32-bit — Super Standby Flag Register
0x1A4 RVADDR 32-bit — Hot plugin start address
0x280 CNT64_CTRL_REG 32-bit — 64-bit Counter Control Register
0x284 CNT64_LOW_REG 32-bit — 64-bit Counter Low Register
0x288 CNT64_HIGH_REG 32-bit — 64-bit Counter High Register

## DE_MIXER0_BLD
Base 0x01101000
Same registers: DE_MIXER1_BLD 0x01201000
0x00 BLD_EN_COLOR_CTL 32-bit — BLD_FILL_COLOR_CTL Offset 0x000 BLD fill color control register
{0x4+0x60*i} unnamed[{i}] (i=0..5) group
  0x00 BLD_FILL_COLOR 32-bit
  0x04 BLD_CH_ISIZE 32-bit — BLD input memory size register
  0x08 BLD_CH_OFFSET 32-bit — BLD input memory offset register
0x80 ROUTE 32-bit — BLD_CH_RTCTL BLD routing control register (default value 0x00543210)
0x84 PREMULTIPLY 32-bit — BLD pre-multiply control register
0x88 BKCOLOR 32-bit
0x8C OUTPUT_SIZE 32-bit
{0x90+0x18*i} BLD_MODE[{i}] (i=0..5) 32-bit — BLD_CTL SUN8I_MIXER_BLEND_MODE blender0..blaener3 (or more)
0xB0 CK_CTL 32-bit
0xB4 CK_CFG 32-bit
{0xC0+0x10*i} CK_MAX[{i}] (i=0..3) 32-bit
{0xE0+0x10*i} CK_MIN[{i}] (i=0..3) 32-bit
0xFC OUT_CTL 32-bit

## Notices in the file
Copyright (c) 2024 by Genadi V. Zawidowski. All rights reserved.
