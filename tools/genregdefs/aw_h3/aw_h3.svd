# aw_h3 register map
File version: 1.00
Registers are 8-bit, read-write, reset 0x0 unless marked. A register's access mark holds for its fields unless they carry their own. Offsets are from the block's base; [hi:lo] are bit positions; lines under a group give offsets from that group; {n}, {i} and the like mark numbered series.

## GICVSELF
Base 0x01C84000
Same registers: GICV 0x01C85000
0x00 GICH_HCR 32-bit — RW 0x00000000 Hypervisor Control Register
0x04 GICH_VTR 32-bit — RO 0x90000003 VGIC Type Register, GICH_VTR on page 3-13
0x08 GICH_VMCR 32-bit — RW 0x004C0000 Virtual Machine Control Register
0x10 GICH_MISR 32-bit — RO 0x00000000 Maintenance Interrupt Status Register
0x20 GICH_EISR0 32-bit — RO 0x00000000 End of Interrupt Status Register
0x30 GICH_ELSR0 32-bit — RO 0x0000000F Empty List register Status Register
0xF0 GICH_APR0 32-bit — RW 0x00000000 Active Priority Register
{0x100+4i} GICH_LR{i} 32-bit (i=0..3) — RW 0x00000000 List Register {i}

## GPIOA
Base 0x01C20800
Same registers: GPIOC 0x01C20848, GPIOD 0x01C2086C, GPIOE 0x01C20890, GPIOF 0x01C208B4, GPIOG 0x01C208D8, GPIOL 0x01F02C00
{0x0+0x10*i} CFG[{i}] (i=0..3) 32-bit — Configure Register
0x10 DATA 32-bit
{0x14+8i} DRV[{i}] (i=0..1) 32-bit — Multi_Driving Register
{0x1C+8i} PULL[{i}] (i=0..1) 32-bit

## GPIOBLOCK
Base 0x01C20800
{0x0+0x120*i} unnamed[{i}] (i=0..7) group
  {0x0+0x10*j} CFG[{j}] (j=0..3) 32-bit — Configure Register
  0x10 DATA 32-bit
  {0x14+8j} DRV[{j}] (j=0..1) 32-bit — Multi_Driving Register
  {0x1C+8j} PULL[{j}] (j=0..1) 32-bit
{0x200+0x40*i} unnamed[{i}] (i=0..1) group
  {0x0+0x10*j} EINT_CFG[{j}] (j=0..3) 32-bit — External Interrupt Configure Registers
  0x10 EINT_CTL 32-bit — External Interrupt Control Register
  0x14 EINT_STATUS 32-bit — External Interrupt Status Register
  0x18 EINT_DEB 32-bit — External Interrupt Debounce Register

## GPIOINTA
Base 0x01C20A00
Same registers: GPIOINTG 0x01C20A20
{0x0+0x10*i} EINT_CFG[{i}] (i=0..3) 32-bit — External Interrupt Configure Registers
0x10 EINT_CTL 32-bit — External Interrupt Control Register
0x14 EINT_STATUS 32-bit — External Interrupt Status Register
0x18 EINT_DEB 32-bit — External Interrupt Debounce Register

## HDMI_PHY
Base 0x01EF0000
0x00 HDMI_PHY_POL 32-bit
0x10 HDMI_PHY_READ_EN 32-bit
0x14 HDMI_PHY_UNSCRAMBLE 32-bit
{0x1C+4i} HDMI_PHY_CFG{i} 32-bit (i=1..3)
{0x28+4i} HDMI_PHY_PLL{i} 32-bit (i=1..3)
0x38 HDMI_PHY_STS 32-bit
0x3C HDMI_PHY_CEC 32-bit
0xFF8 CEC_VERSION 32-bit — Controller Version Register(Default Value: 0x0100_0000)
0xFFC VERSION 32-bit — PHY Version Register(Default Value: 0x0101_0000)

## RTC
Base 0x01F00000
0x00 LOSC_CTRL_REG 32-bit — Low Oscillator Control Register
0x04 LOSC_AUTO_SWT_STA_REG 32-bit — LOSC Auto Switch Status Register
0x08 INTOSC_CLK_PRESCAL_REG 32-bit — Internal OSC Clock Prescalar Register
0x10 RTC_YY_MM_DD_REG 32-bit — RTC Year-Month-Day Register
0x14 RTC_HH_MM_SS_REG 32-bit — RTC Hour-Minute-Second Register
0x20 ALARM0_COUNTER_REG 32-bit — Alarm 0 Counter Register
0x24 ALARM0_CUR_VLU_REG 32-bit — Alarm 0 Counter Current Value Register
0x28 ALARM0_ENABLE_REG 32-bit — Alarm 0 Enable Register
0x2C ALARM0_IRQ_EN 32-bit — Alarm 0 IRQ Enable Register
0x30 ALARM0_IRQ_STA_REG 32-bit — Alarm 0 IRQ Status Register
0x40 ALARM1_WK_HH_MM_SS 32-bit — Alarm 1 Week HMS Register
0x44 ALARM1_ENABLE_REG 32-bit — Alarm 1 Enable Register
0x48 ALARM1_IRQ_EN 32-bit — Alarm 1 IRQ Enable Register
0x4C ALARM1_IRQ_STA_REG 32-bit
0x50 ALARM_CONFIG_REG 32-bit — Alarm Config Register
0x60 LOSC_OUT_GATING_REG 32-bit — LOSC output gating register
{0x100+0x20*i} GP_DATA_REG[{i}] (i=0..7) 32-bit — General Purpose Register (N=0~3)
0x180 GPL_HOLD_OUTPUT_REG 32-bit — GPL Hold Output Register
0x190 VDD_RTC_REG 32-bit — VDD RTC Regulate Register
0x1F0 IC_CHARA_REG 32-bit — IC Characteristic Register

## R_PRCM
Base 0x01F01400
0x00 CPUS_CLK_REG 32-bit — CPUS Clock Register
0x0C APB0_CFG_REG 32-bit — APB0 Configuration Register
0x28 APB0_CLK_GATING_REG 32-bit — APB0 Clock Gating Register
0x44 PLL_CTRL_REG1 32-bit — PLL Control Register 1
0x54 R_CIR_RX_CLK_REG 32-bit — R_CIR_RX Clock Register
0xB0 APB0_SOFT_RST_REG 32-bit — APB0 Software Reset Register
0x100 C0CPUX_PWROFF_GATING_REG 32-bit — Cluster0 CPUX Power Off Gating Register
0x104 C1CPUX_PWROFF_GATING_REG 32-bit — Cluster1 CPUX Power Off Gating Register
0x110 VDD_SYS_PWROFF_GATING_REG 32-bit — VDD_SYS Power Off Gating Register
0x118 GPU_PWROFF_GATING_REG 32-bit — GPU Power Off Gating Register
0x120 VDD_SYS_PWROFF_RST_REG 32-bit — VDD_SYS Power Domain Reset Register
{0x140+4i} C0_CPU{i}_PWR_SWITCH_CTRL 32-bit (i=0..3) — C0_CPU{i} Power Switch Control Register
{0x150+4i} C1_CPU{i}_PWR_SWITCH_CTRL 32-bit (i=0..3) — C1_CPU{i} Power Switch Control Register
0x1F0 RPIO_HOLD_CTRL_REG 32-bit — R_PIO Hold Control Register
0x1F4 OSC24M_CTRL_REG 32-bit — OSC24M Control Register
