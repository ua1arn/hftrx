# aw_a64 register map
File version: 1.00
Registers are 32-bit, read-write, reset 0x0 unless marked. A register's access mark holds for its fields unless they carry their own. Offsets are from the block's base; [hi:lo] are bit positions; lines under a group give offsets from that group; {n}, {i} and the like mark numbered series.

## DRAMC
Base 0x01C01000
0x00 ccr — controller configuration register
0x04 dcr — dram configuration register
0x08 iocr — i/o configuration register
0x0C csr — controller status register
0x10 drr — dram refresh register
{0x14+4i} tpr{i} (i=0..2) — dram timing parameters register {i}
0x20 gdllcr — global dll control register
0x4C rslr0 — rank system latency register
0x50 rslr1 — rank system latency register
0x5C rdgr0 — rank dqs gating register
0x60 rdgr1 — rank dqs gating register
0x98 odtcr — odt configuration register
0x9C dtr0 — data training register 0
0xA0 dtr1 — data training register 1
0xA4 dtar — data training address register
0xA8 zqcr0 — zq control register 0
0xAC zqcr1 — zq control register 1
0xB0 zqsr — zq status register
0xB4 idcr — initializaton delay configure reg
0x1F0 mr — mode register
0x1F4 emr — extended mode register
0x1F8 emr2
0x1FC emr3 — extended mode register
0x200 dllctr — dll control register
{0x204+0x14*i} dllcr[{i}] (i=0..4) — dll control register 0(byte 0)..4(byte 4)
{0x218+4i} dqtr{i} (i=0..3) — dq timing register
0x228 dqstr — dqs timing register
0x22C dqsbtr — dqsb timing register
0x230 mcr — mode configure register
0x23C ppwrsctl — pad power save control
0x240 apr — arbiter period register
0x244 pldtr — priority level data threshold reg
{0x250+0x80*i} hpcr[{i}] (i=0..31) — host port configure register
0x2E0 csel — controller select register

## EMAC
Base 0x01C30000
0x00 EMAC_BASIC_CTL0 — EMAC Basic Control Register0
0x04 EMAC_BASIC_CTL1 — EMAC Basic Control Register1
0x08 EMAC_INT_STA — EMAC Interrupt Status Register
0x0C EMAC_INT_EN — EMAC Interrupt Enable Register
0x10 EMAC_TX_CTL0 — EMAC Transmit Control Register0
0x14 EMAC_TX_CTL1 — EMAC Transmit Control Register1
0x1C EMAC_TX_FLOW_CTL — EMAC Transmit Flow Control Register
0x20 EMAC_TX_DMA_DESC_LIST — EMAC Transmit Descriptor List Address Register
0x24 EMAC_RX_CTL0 — EMAC Receive Control Register0
0x28 EMAC_RX_CTL1 — EMAC Receive Control Register1
0x34 EMAC_RX_DMA_DESC_LIST — EMAC Receive Descriptor List Address Register
0x38 EMAC_RX_FRM_FLT — EMAC Receive Frame Filter Register
0x40 EMAC_RX_HASH0 — EMAC Hash Table Register0
0x44 EMAC_RX_HASH1 — EMAC Hash Table Register1
0x48 EMAC_MII_CMD — EMAC Management Interface Command Register
0x4C EMAC_MII_DATA — EMAC Management Interface Data Register
{0x50+0x40*i} unnamed[{i}] (i=0..7) group
  0x00 HIGH — EMAC MAC Address High Register
  0x04 LOW — EMAC MAC Address Low Register
0xB0 EMAC_TX_DMA_STA — EMAC Transmit DMA Status Register
0xB4 EMAC_TX_CUR_DESC — EMAC Current Transmit Descriptor Register
0xB8 EMAC_TX_CUR_BUF — EMAC Current Transmit Buffer Address Register
0xC0 EMAC_RX_DMA_STA — EMAC Receive DMA Status Register
0xC4 EMAC_RX_CUR_DESC — EMAC Current Receive Descriptor Register
0xC8 EMAC_RX_CUR_BUF — EMAC Current Receive Buffer Address Register
0xD0 EMAC_RGMII_STA — EMAC RGMII Status Register

## GICVSELF
Base 0x01C84000
Same registers: GICV 0x01C85000
0x00 GICH_HCR — RW 0x00000000 Hypervisor Control Register
0x04 GICH_VTR — RO 0x90000003 VGIC Type Register, GICH_VTR on page 3-13
0x08 GICH_VMCR — RW 0x004C0000 Virtual Machine Control Register
0x10 GICH_MISR — RO 0x00000000 Maintenance Interrupt Status Register
0x20 GICH_EISR0 — RO 0x00000000 End of Interrupt Status Register
0x30 GICH_ELSR0 — RO 0x0000000F Empty List register Status Register
0xF0 GICH_APR0 — RW 0x00000000 Active Priority Register
{0x100+4i} GICH_LR{i} (i=0..3) — RW 0x00000000 List Register {i}

## GPADC
Base 0x02009000
0x00 GP_SR_CON — GPADC Sample Rate Configure Register
0x04 GP_CTRL — GPADC Control Register
0x08 GP_CS_EN — GPADC Compare and Select Enable Register
0x0C GP_FIFO_INTC — GPADC FIFO Interrupt Control Register
0x10 GP_FIFO_INTS — GPADC FIFO Interrupt Status Register
0x14 GP_FIFO_DATA — GPADC FIFO Data Register
0x18 GP_CDATA — GPADC Calibration Data Register
0x20 GP_DATAL_INTC — GPADC Data Low Interrupt Configure Register
0x24 GP_DATAH_INTC — GPADC Data High Interrupt Configure Register
0x28 GP_DATA_INTC — GPADC Data Interrupt Configure Register
0x30 GP_DATAL_INTS — GPADC Data Low Interrupt Status Register
0x34 GP_DATAH_INTS — GPADC Data High Interrupt Status Register
0x38 GP_DATA_INTS — GPADC Data Interrupt Status Register
0x40 GP_CH0_CMP_DATA — GPADC CH0 Compare Data Register
0x80 GP_CH0_DATA — GPADC CH0 Data Register
