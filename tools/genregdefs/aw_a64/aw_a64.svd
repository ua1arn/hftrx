# aw_a64 register map
File version: 1.00
Registers are 32-bit, read-write, reset 0x0 unless marked. A register's access mark holds for its fields unless they carry their own. Offsets are from the block's base; [hi:lo] are bit positions; lines under a group give offsets from that group; {n}, {i} and the like mark numbered series.

## HDMI_PHY
Base 0x01EF0000
0x00 HDMI_PHY_POL
0x10 HDMI_PHY_READ_EN
0x14 HDMI_PHY_UNSCRAMBLE
{0x1C+4i} HDMI_PHY_CFG{i} (i=1..3)
{0x28+4i} HDMI_PHY_PLL{i} (i=1..3)
0x38 HDMI_PHY_STS
0x3C HDMI_PHY_CEC
0xFF8 CEC_VERSION — Controller Version Register(Default Value: 0x0100_0000)
0xFFC VERSION — PHY Version Register(Default Value: 0x0101_0000)

## I2S0 — I2S/PCM Controller
Base 0x01C22000
Same registers: I2S1 0x01C22400, I2S2 0x01C22800
0x00 I2S_PCM_CTL — I2S/PCM Control Register
0x04 I2S_PCM_FMT0 — I2S/PCM Format Register 0
0x08 I2S_PCM_FMT1 — I2S/PCM Format Register 1
0x0C I2S_PCM_ISTA — I2S/PCM Interrupt Status Register
0x10 I2S_PCM_RXFIFO
0x14 I2S_PCM_FCTL — I2S/PCM FIFO Control Register
0x18 I2S_PCM_FSTA — I2S/PCM FIFO Status Register
0x1C I2S_PCM_INT — I2S/PCM DMA & Interrupt Control Register
0x20 I2S_PCM_TXFIFO
0x24 I2S_PCM_CLKD — I2S/PCM Clock Divide Register
0x28 I2S_PCM_TXCNT — I2S/PCM TX Sample Counter Register
0x2C I2S_PCM_RXCNT — I2S/PCM RX Sample Counter Register
0x30 I2S_PCM_CHCFG — I2S/PCM Channel Configuration register
0x34 I2S_PCM_TX0CHSEL — I2S/PCM TX0 Channel Configuration register I2S/PCM_TXnCHSEL
{0x34+4i} I2S_PCM_TX{i}CHSEL (i=1..3) — I2S/PCM TX{i} Channel Select Register I2S/PCM_TXnCHSEL
{0x44+4i} I2S_PCM_TX{i}CHMAP (i=0..3) — I2S/PCM TX{i} Channel Mapping Register I2S/PCM_TXnCHMAP
0x54 I2S_PCM_RXCHSEL — I2S/PCM RX Channel Select register
0x58 I2S_PCM_RXCHMAP — I2S/PCM RX Channel Mapping Register

## MSGBOX
Base 0x01C17000
0x00 MSGBOX_CTRL_REG0 — Message Queue Attribute Control Register 0
0x04 MSGBOX_CTRL_REG1 — Message Queue Attribute Control Register 1
{0x40+0x10*i} unnamed[{i}] (i=0..1) group
  0x00 MSGBOXU_IRQ_EN_REG — IRQ Enable For User N(N=0,1)
  0x10 MSGBOXU_IRQ_STATUS_REG — IRQ Status For User N(N=0,1)
{0x100+0x20*i} MSGBOXM_FIFO_STATUS_REG[{i}] (i=0..7) — FIFO Status For Message Queue N(N = 0~7)
{0x140+0x20*i} MSGBOXM_MSG_STATUS_REG[{i}] (i=0..7) — Message Status For Message Queue N(N=0~7)
{0x180+0x20*i} MSGBOXM_MSG_REG[{i}] (i=0..7) — Message Register For Message Queue N(N=0~7)

## NDFC — NAND Flash Controller Interface
Base 0x01C03000
0x00 NDFC_CTL — NDFC Configure and Control Register
0x04 NDFC_ST — NDFC Status Information Register
0x08 NDFC_INT — NDFC Interrupt Control Register
0x0C NDFC_TIMING_CTL — NDFC Timing Control Register
0x10 NDFC_TIMING_CFG — NDFC Timing Configure Register
0x14 NDFC_ADDR_LOW — NDFC Low Word Address Register
0x18 NDFC_ADDR_HIGH — NDFC High Word Address Register
0x1C NDFC_BLOCK_NUM — NDFC Data Block Number Register
0x20 NDFC_CNT — NDFC Data Counter for data transfer Register
0x24 NDFC_CMD — Set up NDFC commands Register
0x28 NDFC_RCMD_SET — Read Command Set Register for vendor’s NAND memory
0x2C NDFC_WCMD_SET — Write Command Set Register for vendor’s NAND memory
0x34 NDFC_ECC_CTL — ECC Configure and Control Register
0x38 NDFC_ECC_ST — ECC Status and Operation information Register
0x3C NDFC_EFR — Enhanced Feature Register
0x40 NDFC_ERR_CNT0 — Corrected Error Bit Counter Register 0
0x44 NDFC_ERR_CNT1 — Corrected Error Bit Counter Register 1
{0x50+0x40*i} NDFC_USER_DATA[{i}] (i=0..15) — User Data Field Register n (n from 0 to 15)
0x90 NDFC_EFNAND_STA — EFNAND Status Register
0xA0 NDFC_SPARE_AREA — Spare Area Configure Register
0xA4 NDFC_PAT_ID — Pattern ID Register
0xA8 NDFC_RDATA_STA_CTL — Read Data Status Control Register
0xAC NDFC_RDATA_STA_0 — Read Data Status Register 0
0xB0 NDFC_RDATA_STA_1 — Read Data Status Register 1
0xC0 NDFC_MDMA_ADDR — MBUS DMA Address Register
0xC4 NDFC_MDMA_CNT — MBUS DMA Data Counter Register
0xD0 NDFC_NDMA_MODE_CTL — DFC Normal DMA Mode Control Register
0x300 NDFC_IO_DATA — Data Input/ Output Port Address Register
{0x400+0x400*i} RAM0_BASE[{i}] (i=0..1023) 8-bit — 1024 Bytes RAM0 base
{0x800+0x400*i} RAM1_BASE[{i}] (i=0..1023) 8-bit — 1024 Bytes RAM1 base
