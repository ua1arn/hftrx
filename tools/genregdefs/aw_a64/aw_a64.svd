# aw_a64 register map
File version: 1.00
Registers are 32-bit, read-write, reset 0x0 unless marked. A register's access mark holds for its fields unless they carry their own. Offsets are from the block's base; [hi:lo] are bit positions; {n}, {i} and the like mark numbered series.

## CCU
Base 0x01C20000
0x00 PLL_CPUX_CTRL_REG — PLL_CPUX Control Register
0x08 PLL_AUDIO_CTRL_REG — PLL_AUDIO Control Register
0x10 PLL_VIDEO0_CTRL_REG — PLL_VIDEO0 Control Register
0x18 PLL_VE_CTRL_REG — PLL_VE Control Register
0x20 PLL_DDR0_CTRL_REG — PLL_DDR0 Control Register
0x28 PLL_PERIPH0_CTRL_REG — PLL_PERIPH0 Control Register
0x2C PLL_PERIPH1_CTRL_REG — PLL_PERIPH1 Control Register
0x30 PLL_VIDEO1_CTRL_REG — PLL_VIDEO1 Control Register
0x38 PLL_GPU_CTRL_REG — PLL_GPU Control Register
0x40 PLL_MIPI_CTRL_REG — PLL_MIPI Control Register
0x44 PLL_HSIC_CTRL_REG — PLL_HSIC Control Register
0x48 PLL_DE_CTRL_REG — PLL_DE Control Register
0x4C PLL_DDR1_CTRL_REG — PLL_DDR1 Control Register
0x50 CPUX_AXI_CFG_REG — CPUX/AXI Configuration Register
0x54 AHB1_APB1_CFG_REG — AHB1/APB1 Configuration Register
0x58 APB2_CFG_REG — APB2 Configuration Register
0x5C AHB2_CFG_REG — AHB2 Configuration Register
{0x60+4i} BUS_CLK_GATING_REG{i} (i=0..4) — Bus Clock Gating Register {i}
0x74 THS_CLK_REG — THS Clock Register
0x80 NAND_CLK_REG — NAND Clock Register
{0x88+4i} SDMMC{i}_CLK_REG (i=0..2) — SDMMC{i} Clock Register
0x98 TS_CLK_REG — TS Clock Register
0x9C CE_CLK_REG — CE Clock Register
0xA0 SPI0_CLK_REG — SPI0 Clock Register
0xA4 SPI1_CLK_REG — SPI1 Clock Register
{0xB0+4i} I2S_PCM_{i}_CLK_REG (i=0..2) — I2S/PCM-{i} Clock Register
0xC0 SPDIF_CLK_REG — SPDIF Clock Register
0xCC USBPHY_CFG_REG — USBPHY Configuration Register
0xF4 DRAM_CFG_REG — DRAM Configuration Register
0xF8 PLL_DDR_CFG_REG — PLL_DDR Configuration Register
0xFC MBUS_RST_REG — MBUS Reset Register
0x100 DRAM_CLK_GATING_REG — DRAM Clock Gating Register
0x104 DE_CLK_REG — DE Clock Register
0x118 TCON0_CLK_REG — TCON0 Clock Register
0x11C TCON1_CLK_REG — TCON1 Clock Register
0x124 DEINTERLACE_CLK_REG — DEINTERLACE Clock Register
0x130 CSI_MISC_CLK_REG — CSI_MISC Clock Register
0x134 CSI_CLK_REG — CSI Clock Register
0x13C VE_CLK_REG — VE Clock Register
0x140 AC_DIG_CLK_REG — AC Digital Clock Register
0x144 AVS_CLK_REG — AVS Clock Register
0x150 HDMI_CLK_REG — HDMI Clock Register
0x154 HDMI_SLOW_CLK_REG — HDMI Slow Clock Register
0x15C MBUS_CLK_REG — MBUS Clock Register
0x168 MIPI_DSI_CLK_REG
0x1A0 GPU_CLK_REG — GPU Clock Register
0x200 PLL_STABLE_TIME_REG0 — PLL Stable Time Register0
0x204 PLL_STABLE_TIME_REG1 — PLL Stable Time Register1
0x21C PLL_PERIPH1_BIAS_REG — PLL_PERIPH1 Bias Register
0x220 PLL_CPUX_BIAS_REG — PLL_CPUX Bias Register
0x224 PLL_AUDIO_BIAS_REG — PLL_AUDIO Bias Register
0x228 PLL_VIDEO0_BIAS_REG — PLL_VIDEO0 Bias Register
0x22C PLL_VE_BIAS_REG — PLL_VE Bias Register
0x230 PLL_DDR0_BIAS_REG — PLL_DDR0 Bias Register
0x234 PLL_PERIPH0_BIAS_REG — PLL_PERIPH0 Bias Register
0x238 PLL_VIDEO1_BIAS_REG — PLL_VIDEO1 Bias Register
0x23C PLL_GPU_BIAS_REG — PLL_GPU Bias Register
0x240 PLL_MIPI_BIAS_REG — PLL_MIPI Bias Register
0x244 PLL_HSIC_BIAS_REG — PLL_HSIC Bias Register
0x248 PLL_DE_BIAS_REG — PLL_DE Bias Register
0x24C PLL_DDR1_BIAS_REG — PLL_DDR1 Bias Register
0x250 PLL_CPUX_TUN_REG — PLL_CPUX Tuning Register
0x260 PLL_DDR0_TUN_REG — PLL_DDR0 Tuning Register
0x270 PLL_MIPI_TUN_REG — PLL_MIPI Tuning Register
0x27C PLL_PERIPH1_PAT_CTRL_REG — PLL_PERIPH1 Pattern Control Register
0x280 PLL_CPUX_PAT_CTRL_REG — PLL_CPUX Pattern Control Register
0x284 PLL_AUDIO_PAT_CTRL_REG — PLL_AUDIO Pattern Control Register
0x288 PLL_VIDEO0_PAT_CTRL_REG — PLL_VIDEO0 Pattern Control Register
0x28C PLL_VE_PAT_CTRL_REG — PLL_VE Pattern Control Register
0x290 PLL_DDR0_PAT_CTRL_REG — PLL_DDR0 Pattern Control Register
0x298 PLL_VIDEO1_PAT_CTRL_REG — PLL_VIDEO1 Pattern Control Register
0x29C PLL_GPU_PAT_CTRL_REG — PLL_GPU Pattern Control Register
0x2A0 PLL_MIPI_PAT_CTRL_REG — PLL_MIPI Pattern Control Register
0x2A4 PLL_HSIC_PAT_CTRL_REG — PLL_HSIC Pattern Control Register
0x2A8 PLL_DE_PAT_CTRL_REG — PLL_DE Pattern Control Register
0x2AC PLL_DDR1_PAT_CTRL_REG0 — PLL_DDR1 Pattern Control Register0
0x2B0 PLL_DDR1_PAT_CTRL_REG1 — PLL_DDR1 Pattern Control Register1
{0x2C0+4i} BUS_SOFT_RST_REG{i} (i=0..2) — Bus Software Reset Register {i}
0x2D0 BUS_SOFT_RST_REG3 — Bus Software Reset Register 3
0x2D8 BUS_SOFT_RST_REG4 — Bus Software Reset Register 4
0x2F0 CCM_SEC_SWITCH_REG — CCM Security Switch Register
0x300 PS_CTRL_REG — PS Control Register
0x304 PS_CNT_REG — PS Counter Register
0x320 PLL_LOCK_CTRL_REG — PLL Lock Control Register
