# aw_a64 register map
File version: 1.00
Registers are 32-bit, read-write, reset 0x0 unless marked. A register's access mark holds for its fields unless they carry their own. Offsets are from the block's base; [hi:lo] are bit positions; lines under a group give offsets from that group; {n}, {i} and the like mark numbered series.

## GPIOB
Base 0x01C20824
Same registers: GPIOC 0x01C20848, GPIOD 0x01C2086C, GPIOE 0x01C20890, GPIOF 0x01C208B4, GPIOG 0x01C208D8, GPIOH 0x01C208FC, GPIOL 0x01F02C00
{0x0+0x10*i} CFG[{i}] (i=0..3) — Configure Register
0x10 DATA
{0x14+8i} DRV[{i}] (i=0..1) — Multi_Driving Register
{0x1C+8i} PULL[{i}] (i=0..1)

## GPIOBLOCK
Base 0x01C20800
{0x0+0x120*i} unnamed[{i}] (i=0..7) group
  {0x0+0x10*j} CFG[{j}] (j=0..3) — Configure Register
  0x10 DATA
  {0x14+8j} DRV[{j}] (j=0..1) — Multi_Driving Register
  {0x1C+8j} PULL[{j}] (j=0..1)
{0x200+0x100*i} unnamed[{i}] (i=0..7) group
  {0x0+0x10*j} EINT_CFG[{j}] (j=0..3) — External Interrupt Configure Registers
  0x10 EINT_CTL — External Interrupt Control Register
  0x14 EINT_STATUS — External Interrupt Status Register
  0x18 EINT_DEB — External Interrupt Debounce Register

## GPIOINTB
Base 0x01C20A00
Same registers: GPIOINTC 0x01C20A20, GPIOINTD 0x01C20A40, GPIOINTE 0x01C20A60, GPIOINTF 0x01C20A80, GPIOINTG 0x01C20AA0, GPIOINTH 0x01C20AC0
{0x0+0x10*i} EINT_CFG[{i}] (i=0..3) — External Interrupt Configure Registers
0x10 EINT_CTL — External Interrupt Control Register
0x14 EINT_STATUS — External Interrupt Status Register
0x18 EINT_DEB — External Interrupt Debounce Register

## GPU — Mali-400MP2
Base 0x01C40000
0x00 MALIGP2_MGMT_VSCL_START_ADDR — MALIGP2_REG_ADDR_MGMT_VSCL_START_ADDR
0x04 MALIGP2_MGMT_VSCL_END_ADDR — MALIGP2_REG_ADDR_MGMT_VSCL_END_ADDR
0x08 MALIGP2_MGMT_PLBUCL_START_ADDR — MALIGP2_REG_ADDR_MGMT_PLBUCL_START_ADDR
0x0C MALIGP2_MGMT_PLBUCL_END_ADDR — MALIGP2_REG_ADDR_MGMT_PLBUCL_END_ADDR
0x10 MALIGP2_MGMT_PLBU_ALLOC_START_ADDR — MALIGP2_REG_ADDR_MGMT_PLBU_ALLOC_START_ADDR
0x14 MALIGP2_MGMT_PLBU_ALLOC_END_ADDR — MALIGP2_REG_ADDR_MGMT_PLBU_ALLOC_END_ADDR
0x20 MALIGP2_MGMT_CMD — MALIGP2_REG_ADDR_MGMT_CMD
0x24 MALIGP2_MGMT_INT_RAWSTAT — MALIGP2_REG_ADDR_MGMT_INT_RAWSTAT
0x28 MALIGP2_MGMT_INT_CLEAR — MALIGP2_REG_ADDR_MGMT_INT_CLEAR
0x2C MALIGP2_MGMT_INT_MASK — MALIGP2_REG_ADDR_MGMT_INT_MASK
0x30 MALIGP2_MGMT_INT_STAT — MALIGP2_REG_ADDR_MGMT_INT_STAT
0x3C MALIGP2_MGMT_PERF_CNT_0_ENABLE — MALIGP2_REG_ADDR_MGMT_PERF_CNT_0_ENABLE
0x40 MALIGP2_MGMT_PERF_CNT_1_ENABLE — MALIGP2_REG_ADDR_MGMT_PERF_CNT_1_ENABLE
0x44 MALIGP2_MGMT_PERF_CNT_0_SRC — MALIGP2_REG_ADDR_MGMT_PERF_CNT_0_SRC
0x48 MALIGP2_MGMT_PERF_CNT_1_SRC — MALIGP2_REG_ADDR_MGMT_PERF_CNT_1_SRC
0x4C MALIGP2_MGMT_PERF_CNT_0_VALUE — MALIGP2_REG_ADDR_MGMT_PERF_CNT_0_VALUE
0x50 MALIGP2_MGMT_PERF_CNT_1_VALUE — MALIGP2_REG_ADDR_MGMT_PERF_CNT_1_VALUE
0x54 MALIGP2_MGMT_PERF_CNT_0_LIMIT — MALIGP2_REG_ADDR_MGMT_PERF_CNT_0_LIMIT
0x68 MALIGP2_MGMT_STATUS — MALIGP2_REG_ADDR_MGMT_STATUS
0x6C MALIGP2_MGMT_VERSION — MALIGP2_REG_ADDR_MGMT_VERSION
0x80 MALIGP2_MGMT_VSCL_START_ADDR_READ — MALIGP2_REG_ADDR_MGMT_VSCL_START_ADDR_READ
0x84 MALIGP2_MGMT_PLBCL_START_ADDR_READ — MALIGP2_REG_ADDR_MGMT_PLBCL_START_ADDR_READ
0x94 MALIGP2_CONTR_AXI_BUS_ERROR_STAT
0x98 MALIGP2_REGISTER_ADDRESS_SPACE_SIZE
0x1000 MALI200_MGMT_VERSION — MALI200_REG_ADDR_MGMT_VERSION
0x1004 MALI200_MGMT_CURRENT_REND_LIST_ADDR — MALI200_REG_ADDR_MGMT_CURRENT_REND_LIST_ADDR
0x1008 MALI200_MGMT_STATUS — MALI200_REG_ADDR_MGMT_STATUS
0x100C MALI200_MGMT_CTRL_MGMT — MALI200_REG_ADDR_MGMT_CTRL_MGMT
0x1020 MALI200_MGMT_INT_RAWSTAT — MALI200_REG_ADDR_MGMT_INT_RAWSTAT
0x1024 MALI200_MGMT_INT_CLEAR — MALI200_REG_ADDR_MGMT_INT_CLEAR
0x1028 MALI200_MGMT_INT_MASK — MALI200_REG_ADDR_MGMT_INT_MASK
0x102C MALI200_MGMT_INT_STATUS — MALI200_REG_ADDR_MGMT_INT_STATUS
0x1050 MALI200_MGMT_BUS_ERROR_STATUS — MALI200_REG_ADDR_MGMT_BUS_ERROR_STATUS
0x1080 MALI200_MGMT_PERF_CNT_0_ENABLE — MALI200_REG_ADDR_MGMT_PERF_CNT_0_ENABLE
0x1084 MALI200_MGMT_PERF_CNT_0_SRC — MALI200_REG_ADDR_MGMT_PERF_CNT_0_SRC
0x1088 MALI200_MGMT_PERF_CNT_0_LIMIT — MALI200_REG_ADDR_MGMT_PERF_CNT_0_LIMIT
0x108C MALI200_MGMT_PERF_CNT_0_VALUE — MALI200_REG_ADDR_MGMT_PERF_CNT_0_VALUE
0x10A0 MALI200_MGMT_PERF_CNT_1_ENABLE — MALI200_REG_ADDR_MGMT_PERF_CNT_1_ENABLE
0x10A4 MALI200_MGMT_PERF_CNT_1_SRC — MALI200_REG_ADDR_MGMT_PERF_CNT_1_SRC
0x10AC MALI200_MGMT_PERF_CNT_1_VALUE — MALI200_REG_ADDR_MGMT_PERF_CNT_1_VALUE
0x10B0 MALI200_MGMT_PERFMON_CONTR — MALI200_REG_ADDR_MGMT_PERFMON_CONTR
{0x10B4+0x3C*i} MALI200_MGMT_PERFMON_BASE[{i}] (i=0..14) — MALI200_REG_ADDR_MGMT_PERFMON_BASE
0x10F0 MALI200_REG_SIZEOF_REGISTER_BANK
