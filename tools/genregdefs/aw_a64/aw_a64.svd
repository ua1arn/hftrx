# aw_a64 register map
File version: 1.00
Registers are 32-bit, read-write, reset 0x0 unless marked. A register's access mark holds for its fields unless they carry their own. Offsets are from the block's base; [hi:lo] are bit positions; {n}, {i} and the like mark numbered series.

## R_RSB — Reduced Serial Bus Host Controller
Base 0x01F03400
0x00 RSB_CTRL — RSB Control Register
0x04 RSB_CCR — RSB Clock Control Register
0x08 RSB_INTE — RSB Interrupt Enable Register
0x0C RSB_STAT — RSB Status Register
0x10 RSB_DADDR0 — RSB Data Acess Address Register0
0x18 RSB_DLEN — RSB Data Length Register
0x1C RSB_DATA0 — RSB Data Buffer0 Register
0x24 RSB_LCR — RSB Line Control register
0x28 RSB_PMCR — RSB PMU Mode Control register
0x2C RSB_CMD — RSB Command Register
0x30 RSB_SADDR — RSB Slave address Register

## R_TIMER
Base 0x01F00800
0x00 RTMR_IRQ_EN_REG — R_timer IRQ Enable Register
0x04 RTMR_IRQ_STA_REG — R_timer IRQ Status Register
0x20 RTMR0_CTRL_REG — R_timer 0 Control Register
0x24 RTMR0_INTV_VALUE_REG — R_timer 0 Interval Value Register
0x28 RTMR0_CUR_VALUE_REG — R_timer 0 Current Value Register
0x40 RTMR1_CTRL_REG — R_timer 1 Control Register
0x44 RTMR1_INTV_VALUE_REG — R_timer 1 Interval Value Register
0x48 RTMR1_CUR_VALUE_REG — R_timer 1 Current Value Register

## R_WDOG
Base 0x01F01000
0x00 RWDOG_IRQ_EN_REG — R_watchdog IRQ Enable Register
0x04 RWDOG_IRQ_STA_REG — R_watchdog Status Register
0x10 RWDOG_CTRL_REG — R_watchdog Control Register
0x14 RWDOG_CFG_REG — R_watchdog Configuration Register
0x18 RWDOG_MODE_REG — R_watchdog Mode Register

## SID — Security ID
Base 0x01C14000
{0x0+4i} SID_RKEY{i} (i=0..3) — Securiy root key[{32i+31}:{32i}]
0x40 SID_PRCTL
0x60 SID_RDKEY
{0x200+0x400*i} SID_DATA[{i}] (i=0..255) — SID data (xfel display as 'sid' replay)

## SMHC0 — SD-MMC Host Controller
Base 0x01C0F000
Same registers: SMHC1 0x01C10000, SMHC2 0x01C11000
0x00 SMHC_CTRL — Control Register
0x04 SMHC_CLKDIV — Clock control Register
0x08 SMHC_TMOUT — Time out Register
0x0C SMHC_CTYPE — Bus width Register
0x10 SMHC_BLKSIZ — Block size Register
0x14 SMHC_BYTCNT — Byte count Register
0x18 SMHC_CMD — Command Register
0x1C SMHC_CMDARG — Command argument Register
{0x20+4i} SMHC_RESP{i} (i=0..3) — Response {i} Register
0x30 SMHC_INTMASK — Interrupt mask Register
0x34 SMHC_MINTSTS — Masked interrupt status Register
0x38 SMHC_RINTSTS — Raw interrupt status Register
0x3C SMHC_STATUS — Status Register
0x40 SMHC_FIFOTH — FIFO water level Register
0x44 SMHC_FUNS — FIFO function select Register
0x48 SMHC_TBC0 — Transferred byte count0 between controller and card
0x4C SMHC_TBC1 — Transferred byte count1 between host memory and internal FIFO
0x54 SMHC_CSDC — CRC status detect control Register(only for SMHC2)
0x58 SMHC_A12A — Auto command 12 argument Register
0x5C SMHC_NTSR — SD new timing set Register(only for SMHC0&1)
0x78 SMHC_HWRST — Hardware reset Register
0x80 SMHC_DMAC — DMA control Register
0x84 SMHC_DLBA — Descriptor list base address Register
0x88 SMHC_IDST — DMAC status Register
0x8C SMHC_IDIE — DMAC interrupt enable Register
0x100 SMHC_THLD — Card threshold control Register
0x10C SMHC_EDSD — eMMC4.5 DDR start bit detection control Register
0x110 SMHC_RES_CRC — Response CRC from device(only for SMHC0&1)
{0x114+0x20*i} SMHC_D7_D0_CRC[{i}] (i=0..7) — CRC in Data7..Data0 from Device (Only for SMHC0, SMHC1)
0x134 SMHC_CRC_STA — CRC status from device in write operation(only for SMHC0&1)
0x140 SMHC_DRV_DL — Drive delay control Register
0x144 SMHC_SAMP_DL — Sample delay control Register
0x148 SMHC_DS_DL — Data strobe delay control Register
0x200 SMHC_FIFO — Read/ Write FIFO

## SPI0 — Serial Peripheral Interface
Base 0x01C68000
Same registers: SPI1 0x01C69000
0x04 SPI_GCR — SPI Global Control Register
0x08 SPI_TCR — SPI Transfer Control Register
0x10 SPI_IER — SPI Interrupt Control Register
0x14 SPI_ISR — SPI Interrupt Status Register
0x18 SPI_FCR — SPI FIFO Control Register
0x1C SPI_FSR — SPI FIFO Status Register
0x20 SPI_WCR — SPI Wait Clock Register
0x24 SPI_CCR — SPI Clock Rate Control register
0x30 SPI_MBC — SPI Master Burst Counter Register
0x34 SPI_MTC — SPI Master Transmit Counter Register
0x38 SPI_BCC — SPI Master Burst Control Register
0x200 SPI_TXD — SPI TX Data Register
0x300 SPI_RXD — SPI RX Data Register
