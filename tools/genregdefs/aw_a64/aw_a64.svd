# aw_a64 register map
File version: 1.00
Registers are 32-bit, read-write, reset 0x0 unless marked. A register's access mark holds for its fields unless they carry their own. Offsets are from the block's base; [hi:lo] are bit positions; {n}, {i} and the like mark numbered series.

## AUDIO_CODEC
Base 0x01C22C00
0x00 DA_CTL — Digital Audio Control Register
0x04 DA_FAT0 — Digital Audio Format Register 0
0x08 DA_FAT1 — Digital Audio Format Register 1
0x0C DA_ISTA — Digital Audio Interrupt Status Register
0x10 AC_ADC_RXDATA — Digital Audio RX FIFO Register (was: DA_RXFIFO)
0x14 DA_FCTL — Digital Audio FIFO Control Register
0x18 DA_FSTA — Digital Audio FIFO Status Register
0x1C DA_INT — Digital Audio Interrupt Control Register
0x20 AC_DAC_TXDATA — Digital Audio TX FIFO Register (was: DA_TXFIFO)
0x24 DA_CLKD — Digital Audio Clock Divide Register
0x28 DA_TXCNT — Digital Audio RX Sample Counter Register
0x2C DA_RXCNT — Digital Audio TX Sample Counter Register
0x30 DA_TXCHSEL — Digital Audio TX Channel Select register
0x34 DA_TXCHMAP — Digital Audio TX Channel Mapping Register
0x38 DA_RXCHSEL — Digital Audio RX Channel Select register
0x3C DA_RXCHMAP — Digital Audio RX Channel Mapping Register
0x200 Codec_RST — Chip Soft Reset Register
0x20C SYSCLK_CTL — System Clock Control Register
0x210 MOD_CLK_ENA — Module Clock Control Register
0x214 MOD_RST_CTL — Module Reset Control Register
0x218 SYS_SR_CTRL — System Sample rate & SRC Configuration Register
0x21C SYS_SRC_CLK — System SRC Clock Source Select Register
0x220 SYS_DVC_MOD — System DVC Mode Select Register
0x240 AIF1CLK_CTRL — AIF1 BCLK/LRCK Control Register
{0x204+0x40*i} AIF{i}_ADCDAT_CTRL (i=1..3) — AIF{i} ADCDAT Control Register
{0x208+0x40*i} AIF{i}_DACDAT_CTRL (i=1..3) — AIF{i} DACDAT Control Register
0x24C AIF1_MIXR_SRC — AIF1 Digital Mixer Source Select Register
{0x24C+4i} AIF1_VOL_CTRL{i} (i=1..4) — AIF1 Volume Control {i} Register
0x260 AIF1_MXR_GAIN — AIF1 Digital Mixer Gain Control Register
{0x224+0x40*i} AIF{i}_RXD_CTRL (i=1..3) — AIF{i} Receiver Data Discarding Control Register
0x280 AIF2_CLK_CTRL — AIF2 BCLK/LRCK Control Register
0x28C AIF2_MXR_SRC — AIF2 Digital Mixer Source Select Register
0x290 AIF2_VOL_CTRL1 — AIF2 Volume Control 1 Register
0x298 AIF2_VOL_CTRL2 — AIF2 Volume Control 2 Register
0x2A0 AIF2_MXR_GAIN — AIF2 Digital Mixer Gain Control Register
0x2C0 AIF3_CLK_CTRL — AIF3 BCLK/LRCK Control Register
0x2CC AIF3_SGP_CTRL — AIF3 Signal Path Control Register
0x300 ADC_DIG_CTRL — ADC Digital Control Register
0x304 ADC_VOL_CTRL — ADC Volume Control Register
0x308 ADC_DBG_CTRL — ADC Debug Control Register
0x310 HMIC_CTRL1 — HMIC Control 1 Register
0x314 HMIC_CTRL2 — HMIC Control 2 Register
0x318 HMIC_STS — HMIC Status Register
0x320 DAC_DIG_CTRL — DAC Digital Control Register
0x324 DAC_VOL_CTRL — DAC Volume Control Register
0x328 DAC_DBG_CTRL — DAC Debug Control Register
0x330 DAC_MXR_SRC — DAC Digital Mixer Source Select Register
0x334 DAC_MXR_GAIN — DAC Digital Mixer Gain Control Register
0x400 AC_ADC_DAPLSTA — ADC DAP Left Status Register
0x404 AC_ADC_DAPRSTA — ADC DAP Right Status Register
0x408 AC_ADC_DAPLCTRL — ADC DAP Left Channel Control Register
0x40C AC_ADC_DAPRCTRL — ADC DAP Right Channel Control Register
0x410 AC_ADC_DAPLTL — ADC DAP Left Target Level Register
0x414 AC_ADC_DAPRTL — ADC DAP Right Target Level Register
0x418 AC_ADC_DAPLHAC — ADC DAP Left High Average Coef Register
0x41C AC_ADC_DAPLLAC — ADC DAP Left Low Average Coef Register
0x420 AC_ADC_DAPRHAC — ADC DAP Right High Average Coef Register
0x424 AC_ADC_DAPRLAC — ADC DAP Right Low Average Coef Register
0x428 AC_ADC_DAPLDT — ADC DAP Left Decay Time Register
0x42C AC_ADC_DAPLAT — ADC DAP Left Attack Time Register
0x430 AC_ADC_DAPRDT — ADC DAP Right Decay Time Register
0x434 AC_ADC_DAPRAT — ADC DAP Right Attack Time Register
0x438 AC_ADC_DAPNTH — ADC DAP Noise Threshold Register
0x43C AC_ADC_DAPLHNAC — ADC DAP Left Input Signal High Average Coef Register
0x440 AC_ADC_DAPLLNAC — ADC DAP Left Input Signal Low Average Coef Register
0x444 AC_ADC_DAPRHNAC — ADC DAP Right Input Signal High Average Coef Register
0x448 AC_ADC_DAPRLNAC — ADC DAP Right Input Signal Low Average Coef Register
0x44C AC_DAPHHPFC — ADC DAP High HPF Coef Register
0x450 AC_DAPLHPFC — ADC DAP Low HPF Coef Register
0x454 AC_DAPOPT — ADC DAP Optimum Register
0x480 AC_DAC_DAPCTRL — DAC DAP Control Register
0x4D0 AGC_ENA — AGC Enable Register
0x4D4 DRC_ENA — DRC Enable Register
0x4D8 SRC_BISTCR — SRC Bist control Register
0x4DC SRC_BISTST — SRC Bist Status Register
{0x4DC+4i} SRC1_CTRL{i} (i=1..4) — SRC1 Control {i} Register
{0x4EC+4i} SRC2_CTRL{i} (i=1..4) — SRC2 Control {i} Register
0x600 AC_DRC0_HHPFC — DRC0 High HPF Coef Register
0x604 AC_DRC0_LHPFC — DRC0 Low HPF Coef Register
0x608 AC_DRC0_CTRL — DRC0 Control Register
0x60C AC_DRC0_LPFHAT — DRC0 Left Peak Filter High Attack Time Coef Register
0x610 AC_DRC0_LPFLAT — DRC0 Left Peak Filter Low Attack Time Coef Register
0x614 AC_DRC0_RPFHAT — DRC0 Right Peak Filter High Attack Time Coef Register
0x618 AC_DRC0_RPFLAT — DRC0 Peak Filter Low Attack Time Coef Register
0x61C AC_DRC0_LPFHRT — DRC0 Left Peak Filter High Release Time Coef Register
0x620 AC_DRC0_LPFLRT — DRC0 Left Peak Filter Low Release Time Coef Register
0x624 AC_DRC0_RPFHRT — DRC0 Right Peak filter High Release Time Coef Register
0x628 AC_DRC0_RPFLRT — DRC0 Right Peak filter Low Release Time Coef Register
0x62C AC_DRC0_LRMSHAT — DRC0 Left RMS Filter High Coef Register
0x630 AC_DRC0_LRMSLAT — DRC0 Left RMS Filter Low Coef Register
0x634 AC_DRC0_RRMSHAT — DRC0 Right RMS Filter High Coef Register
0x638 AC_DRC0_RRMSLAT — DRC0 Right RMS Filter Low Coef Register
0x63C AC_DRC0_HCT — DRC0 Compressor Theshold High Setting Register
0x640 AC_DRC0_LCT — DRC0 Compressor Slope High Setting Register
0x644 AC_DRC0_HKC — DRC0 Compressor Slope High Setting Register
0x648 AC_DRC0_LKC — DRC0 Compressor Slope Low Setting Register
0x64C AC_DRC0_HOPC — DRC0 Compressor High Output at Compressor Threshold Register
0x650 AC_DRC0_LOPC — DRC0 Compressor Low Output at Compressor Threshold Register
0x654 AC_DRC0_HLT — DRC0 Limiter Theshold High Setting Register
0x658 AC_DRC0_LLT — DRC0 Limiter Theshold Low Setting Register
0x65C AC_DRC0_HKl — DRC0 Limiter Slope High Setting Register
0x660 AC_DRC0_LKl — DRC0 Limiter Slope Low Setting Register
0x664 AC_DRC0_HOPL — DRC0 Limiter High Output at Limiter Threshold
0x668 AC_DRC0_LOPL — DRC0 Limiter Low Output at Limiter Threshold
0x66C AC_DRC0_HET — DRC0 Expander Theshold High Setting Register
0x670 AC_DRC0_LET — DRC0 Expander Theshold Low Setting Register
0x674 AC_DRC0_HKE — DRC0 Expander Slope High Setting Register
0x678 AC_DRC0_LKE — DRC0 Expander Slope Low Setting Register
0x67C AC_DRC0_HOPE — DRC0 Expander High Output at Expander Threshold
0x680 AC_DRC0_LOPE — DRC0 Expander Low Output at Expander Threshold
0x684 AC_DRC0_HKN — DRC0 Linear Slope High Setting Register
0x688 AC_DRC0_LKN — DRC0 Linear Slope Low Setting Register
0x68C AC_DRC0_SFHAT — DRC0 Smooth filter Gain High Attack Time Coef Register
0x690 AC_DRC0_SFLAT — DRC0 Smooth filter Gain Low Attack Time Coef Register
0x694 AC_DRC0_SFHRT — DRC0 Smooth filter Gain High Release Time Coef Register
0x698 AC_DRC0_SFLRT — DRC0 Smooth filter Gain Low Release Time Coef Register
0x69C AC_DRC0_MXGHS — DRC0 MAX Gain High Setting Register
0x6A0 AC_DRC0_MXGLS — DRC0 MAX Gain Low Setting Register
0x6A4 AC_DRC0_MNGHS — DRC0 MIN Gain High Setting Register
0x6A8 AC_DRC0_MNGLS — DRC0 MIN Gain Low Setting Register
0x6AC AC_DRC0_EPSHC — DRC0 Expander Smooth Time High Coef Register
0x6B0 AC_DRC0_EPSLC — DRC0 Expander Smooth Time Low Coef Register
0x6BC AC_DRC0_OPT — Was: 0x6AC DRC0 Optimum Register
0x700 AC_DRC1_HHPFC — DRC1 High HPF Coef Register
0x704 AC_DRC1_LHPFC — DRC1 Low HPF Coef Register
0x708 AC_DRC1_CTRL — DRC1 Control Register
0x70C AC_DRC1_LPFHAT — DRC1 Left Peak Filter High Attack Time Coef Register
0x710 AC_DRC1_LPFLAT — DRC1 Left Peak Filter Low Attack Time Coef Register
0x714 AC_DRC1_RPFHAT — DRC1 Right Peak Filter High Attack Time Coef Register
0x718 AC_DRC1_RPFLAT — DRC1 Peak Filter Low Attack Time Coef Register
0x71C AC_DRC1_LPFHRT — DRC1 Left Peak Filter High Release Time Coef Register
0x720 AC_DRC1_LPFLRT — DRC1 Left Peak Filter Low Release Time Coef Register
0x724 AC_DRC1_RPFHRT — DRC1 Right Peak filter High Release Time Coef Register
0x728 AC_DRC1_RPFLRT — DRC1 Right Peak filter Low Release Time Coef Register
0x72C AC_DRC1_LRMSHAT — DRC1 Left RMS Filter High Coef Register
0x730 AC_DRC1_LRMSLAT — DRC1 Left RMS Filter Low Coef Register
0x734 AC_DRC1_RRMSHAT — DRC1 Right RMS Filter High Coef Register
0x738 AC_DRC1_RRMSLAT — DRC1 Right RMS Filter Low Coef Register
0x73C AC_DRC1_HCT — DRC1 Compressor Theshold High Setting Register
0x740 AC_DRC1_LCT — DRC1 Compressor Slope High Setting Register
0x744 AC_DRC1_HKC — DRC1 Compressor Slope High Setting Register
0x748 AC_DRC1_LKC — DRC1 Compressor Slope Low Setting Register
0x74C AC_DRC1_HOPC — DRC1 Compressor High Output at Compressor Threshold
0x750 AC_DRC1_LOPC — DRC1 Compressor Low Output at Compressor Threshold Register
0x754 AC_DRC1_HLT — DRC1 Limiter Theshold High Setting Register
0x758 AC_DRC1_LLT — DRC1 Limiter Theshold Low Setting Register
0x75C AC_DRC1_HKl — DRC1 Limiter Slope High Setting Register
0x760 AC_DRC1_LKl — DRC1 Limiter Slope Low Setting Register
0x764 AC_DRC1_HOPL — DRC1 Limiter High Output at Limiter Threshold
0x768 AC_DRC1_LOPL — DRC1 Limiter Low Output at Limiter Threshold
0x76C AC_DRC1_HET — DRC1 Expander Theshold High Setting Register
0x770 AC_DRC1_LET — DRC1 Expander Theshold Low Setting Register
0x774 AC_DRC1_HKE — DRC1 Expander Slope High Setting Register
0x778 AC_DRC1_LKE — DRC1 Expander Slope Low Setting Register
0x77C AC_DRC1_HOPE — DRC1 Expander High Output at Expander Threshold
0x780 AC_DRC1_LOPE — DRC1 Expander Low Output at Expander Threshold
0x784 AC_DRC1_HKN — DRC1 Linear Slope High Setting Register
0x788 AC_DRC1_LKN — DRC1 Linear Slope Low Setting Register
0x78C AC_DRC1_SFHAT — DRC1 Smooth filter Gain High Attack Time Coef Register
0x790 AC_DRC1_SFLAT — DRC1 Smooth filter Gain Low Attack Time Coef Register
0x794 AC_DRC1_SFHRT — DRC1 Smooth filter Gain High Release Time Coef Register
0x798 AC_DRC1_SFLRT — DRC1 Smooth filter Gain Low Release Time Coef Register
0x79C AC_DRC1_MXGHS — DRC1 MAX Gain High Setting Register
0x7A0 AC_DRC1_MXGLS — DRC1 MAX Gain Low Setting Register
0x7A4 AC_DRC1_MNGHS — DRC1 MIN Gain High Setting Register
0x7A8 AC_DRC1_MNGLS — DRC1 MIN Gain Low Setting Register
0x7AC AC_DRC1_EPSHC — DRC1 Expander Smooth Time High Coef Register
0x7B0 AC_DRC1_EPSLC — DRC1 Expander Smooth Time Low Coef Register
0x7B4 AC_DRC1_OPT — DRC1 Optimum Register

## Notices in the file
Copyright (c) 2024 by Genadi V. Zawidowski. All rights reserved.
