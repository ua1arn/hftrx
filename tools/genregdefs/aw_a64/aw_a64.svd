# aw_a64 register map
File version: 1.00
Registers are 32-bit, read-write, reset 0x0 unless marked. A register's access mark holds for its fields unless they carry their own. Offsets are from the block's base; [hi:lo] are bit positions; lines under a group give offsets from that group; {n}, {i} and the like mark numbered series.

## DE_WB — Real-time write-back controller (RT-WB)
Base 0x01010000
0x00 WB_GCTRL_REG — Module general control register
0x04 WB_SIZE_REG — Input size register
0x08 WB_CROP_COORD_REG — Cropping coordinate register
0x0C WB_CROP_SIZE_REG — Cropping size register
{0x10+4i} WB_A_CH{i}_ADDR_REG (i=0..2) — Write-back Group A channel {i} address register
0x1C WB_A_HIGH_ADDR_REG — Write-back Group A address high bit register
{0x20+4i} WB_B_CH{i}_ADDR_REG (i=0..2) — Write-back Group B channel {i} address register
0x2C WB_B_HIGH_ADDR_REG — Write-back Group B address high bit register
0x30 WB_CH0_PITCH_REG — Write-back channel 0 pitch register
0x34 WB_CH12_PITCH_REG — Write-back channel 1/2 pitch register
0x40 WB_ADDR_SWITCH_REG — Write-back address switch setting register
0x44 WB_FORMAT_REG — Output format register
0x48 WB_INT_REG — Interrupt control register
0x4C WB_STATUS_REG — Module status register
0x54 WB_BYPASS_REG — Bypass control register
0x70 WB_CS_HORZ_REG — Coarse scaling horizontal setting register
0x74 WB_CS_VERT_REG — Coarse scaling vertical setting register
0x80 WB_FS_INSIZE_REG — Fine scaling input size register
0x84 WB_FS_OUTSIZE_REG — Fine scaling output size register
0x88 WB_FS_HSTEP_REG — Fine scaling horizontal step registe
0x8C WB_FS_VSTEP_REG — Fine scaling vertical step register
0xFC WB_DEBUG_REG — Debug register
{0x200+0x40*i} WB_CH0_HCOEF_REGN[{i}] (i=0..15) — 0x200 + N*4 Channel 0 horizontal coefficient register N ( N = 0,1,2,...,15)
{0x280+0x40*i} WB_CH1_HCOEF_REGN[{i}] (i=0..15) — 0x280 + N*4 Channel 1/2 horizontal coefficient register N ( N = 0,1,2,...,15)

## DMAC
Base 0x01C02000
0x00 DMAC_IRQ_EN_REG — DMAC IRQ Enable Register
0x10 DMAC_IRQ_PEND_REG — DMAC IRQ Pending Register
0x20 DMA_SEC_REG — DMA Security Register
0x28 DMAC_AUTO_GATE_REG — DMAC Auto Gating Register
0x30 DMAC_STA_REG — DMAC Status Register
{0x100+0x200*i} unnamed[{i}] (i=0..7) group
  0x00 DMAC_EN_REGN — DMAC Channel Enable Register N (N = 0 to 7) 0x0100 + N*0x0040
  0x04 DMAC_PAU_REGN — DMAC Channel Pause Register N (N = 0 to 7) 0x0104 + N*0x0040
  0x08 DMAC_DESC_ADDR_REGN — DMAC Channel Start Address Register N (N = 0 to 7) 0x0108 + N*0x0040
  0x0C DMAC_CFG_REGN — DMAC Channel Configuration Register N (N = 0 to 7) 0x010C + N*0x0040
  0x10 DMAC_CUR_SRC_REGN — DMAC Channel Current Source Register N (N = 0 to 7) 0x0110 + N*0x0040
  0x14 DMAC_CUR_DEST_REGN — DMAC Channel Current Destination Register N (N = 0 to 7) 0x0114 + N*0x0040
  0x18 DMAC_BCNT_LEFT_REGN — DMAC Channel Byte Counter Left Register N (N = 0 to 7) 0x0118 + N*0x0040
  0x1C DMAC_PARA_REGN — DMAC Channel Parameter Register N (N = 0 to 7) 0x011C + N*0x0040
  0x28 DMAC_MODE_REGN — DMAC Mode Register N (N = 0 to 7) 0x0128 + N*0x0040
  0x2C DMAC_FDESC_ADDR_REGN — DMAC Former Descriptor Address Register N (N = 0 to 7) 0x012C + N*0x0040
  0x30 DMAC_PKG_NUM_REGN — DMAC Package Number Register N (N = 0 to 7) 0x0130 + N*0x0040

## DMIC
Base 0x02031000
0x00 DMIC_EN — DMIC Enable Control Register
0x04 DMIC_SR — DMIC Sample Rate Register
0x08 DMIC_CTR — DMIC Control Register
0x10 DMIC_DATA
0x14 DMIC_INTC — MIC Interrupt Control Register
0x18 DMIC_INTS — DMIC Interrupt Status Register
0x1C DMIC_RXFIFO_CTR — DMIC RXFIFO Control Register
0x20 DMIC_RXFIFO_STA — DMIC RXFIFO Status Register
0x24 DMIC_CH_NUM — DMIC Channel Numbers Register
0x28 DMIC_CH_MAP — DMIC Channel Mapping Register
0x2C DMIC_CNT — DMIC Counter Register
0x30 DATA0_DATA1_VOL_CTR — Data0 and Data1 Volume Control Register
0x34 DATA2_DATA3_VOL_CTR — Data2 And Data3 Volume Control Register
0x38 HPF_EN_CTR — High Pass Filter Enable Control Register
0x3C HPF_COEF_REG — High Pass Filter Coefficient Register
0x40 HPF_GAIN_REG — High Pass Filter Gain Register
