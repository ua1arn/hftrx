# aw_a64 register map
File version: 1.00
Registers are 32-bit, read-write, reset 0x0 unless marked. A register's access mark holds for its fields unless they carry their own. Offsets are from the block's base; [hi:lo] are bit positions; lines under a group give offsets from that group; {n}, {i} and the like mark numbered series.

## OWA — One Wire Audio
Base 0x01C21000
0x00 OWA_GEN_CTL — OWA General Control Register
0x04 OWA_TX_CFIG — OWA TX Configuration Register
0x08 OWA_RX_CFIG — OWA RX Configuration Register
0x0C OWA_ISTA — OWA Interrupt Status Register
0x10 OWA_RXFIFO
0x14 OWA_FCTL — OWA FIFO Control Register
0x18 OWA_FSTA — OWA FIFO Status Register
0x1C OWA_INT — OWA Interrupt Control Register
0x20 OWA_TX_FIFO
0x24 OWA_TX_CNT — OWA TX Counter Register
0x28 OWA_RX_CNT — OWA RX Counter Register
0x2C OWA_TX_CHSTA0 — OWA TX Channel Status Register0
0x30 OWA_TX_CHSTA1 — OWA TX Channel Status Register1
0x34 OWA_RXCHSTA0 — OWA RX Channel Status Register0
0x38 OWA_RXCHSTA1 — OWA RX Channel Status Register1
0x40 OWA_EXP_CTL — OWA Expand Control Register
0x44 OWA_EXP_ISTA — OWA Expand Interrupt Status Register
0x48 OWA_EXP_INFO_0 — OWA Expand Infomation Register0
0x4C OWA_EXP_INFO_1 — OWA Expand Infomation Register1
0x50 OWA_EXP_DBG_0 — OWA Expand Debug Register0
0x54 OWA_EXP_DBG_1 — OWA Expand Debug Register1

## PWM
Base 0x01C21400
0x00 PIER — PWM IRQ Enable Register
0x04 PISR — PWM IRQ Status Register
0x10 CIER — Capture IRQ Enable Register
0x14 CISR — Capture IRQ Status Register
{0x20+0x10*i} PCCR[{i}] (i=0..3) — PWM01, PWM23, PWM45, PWM67 Clock Configuration Register
0x40 PCGR — PWM Clock Gating Register
{0x60+0x10*i} PDZCR[{i}] (i=0..3) — PWM01, PWM23, PWM45, PWM67 Dead Zone Control Register
0x80 PER — PWM Enable Register
{0x90+0x10*i} PGR0[{i}] (i=0..3) — PWM Group0, Group1, Group2, Group3 Register
0xC0 CER — Capture Enable Register
{0x100+0x100*i} unnamed[{i}] (i=0..7) group
  0x00 PCR — PWM Control Register
  0x04 PPR — PWM Period Register
  0x08 PCNTR — PWM Count Register
  0x0C PPCNTR — PWM Pulse Count Register
  0x10 CCR — Capture Control Register
  0x14 CRLR — Capture Rise Lock Register
  0x18 CFLR — Capture Fall Lock Register

## RTC
Base 0x01F00000
0x00 LOSC_CTRL_REG — Low Oscillator Control Register
0x04 LOSC_AUTO_SWT_STA_REG — LOSC Auto Switch Status Register
0x08 INTOSC_CLK_PRESCAL_REG — Internal OSC Clock Prescalar Register
0x10 RTC_YY_MM_DD_REG — RTC Year-Month-Day Register
0x14 RTC_HH_MM_SS_REG — RTC Hour-Minute-Second Register
0x20 ALARM0_COUNTER_REG — Alarm 0 Counter Register
0x24 ALARM0_CUR_VLU_REG — Alarm 0 Counter Current Value Register
0x28 ALARM0_ENABLE_REG — Alarm 0 Enable Register
0x2C ALARM0_IRQ_EN — Alarm 0 IRQ Enable Register
0x30 ALARM0_IRQ_STA_REG — Alarm 0 IRQ Status Register
0x40 ALARM1_WK_HH_MM_SS — Alarm 1 Week HMS Register
0x44 ALARM1_ENABLE_REG — Alarm 1 Enable Register
0x48 ALARM1_IRQ_EN — Alarm 1 IRQ Enable Register
0x4C ALARM1_IRQ_STA_REG
0x50 ALARM_CONFIG_REG — Alarm Config Register
0x60 LOSC_OUT_GATING_REG — LOSC output gating register
{0x100+0x10*i} GP_DATA_REG[{i}] (i=0..3) — General Purpose Register (N=0~3)
0x180 GPL_HOLD_OUTPUT_REG — GPL Hold Output Register
0x190 VDD_RTC_REG — VDD RTC Regulate Register
0x1F0 IC_CHARA_REG — IC Characteristic Register
0x210 CRY_CONFIG_REG — Crypt Configuration Register
0x214 CRY_KEY_REG — Crypt Key Register
0x218 CRY_ENABLE_REG — Crypt Enable Register

## R_CPUCFG
Base 0x01F01C00
{0x1A4+0x10*i} SOFTENTRY[{i}] (i=0..3) — The Soft Entry Address Register of CPUx (x=0..1)

## R_PRCM
Base 0x01F01400
0x00 CPUS_CLK_REG — CPUS Clock Register
0x0C APB0_CFG_REG — APB0 Configuration Register
0x28 APB0_CLK_GATING_REG — APB0 Clock Gating Register
0x44 PLL_CTRL_REG1 — PLL Control Register 1
0x54 R_CIR_RX_CLK_REG — R_CIR_RX Clock Register
0xB0 APB0_SOFT_RST_REG — APB0 Software Reset Register
0x100 C0CPUX_PWROFF_GATING_REG — Cluster0 CPUX Power Off Gating Register
0x104 C1CPUX_PWROFF_GATING_REG — Cluster1 CPUX Power Off Gating Register
0x110 VDD_SYS_PWROFF_GATING_REG — VDD_SYS Power Off Gating Register
0x118 GPU_PWROFF_GATING_REG — GPU Power Off Gating Register
0x120 VDD_SYS_PWROFF_RST_REG — VDD_SYS Power Domain Reset Register
{0x140+4i} C0_CPU{i}_PWR_SWITCH_CTRL (i=0..3) — C0_CPU{i} Power Switch Control Register
{0x150+4i} C1_CPU{i}_PWR_SWITCH_CTRL (i=0..3) — C1_CPU{i} Power Switch Control Register
0x1F0 RPIO_HOLD_CTRL_REG — R_PIO Hold Control Register
0x1F4 OSC24M_CTRL_REG — OSC24M Control Register
