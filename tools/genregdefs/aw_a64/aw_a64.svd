# aw_a64 register map
File version: 1.00
Registers are 32-bit, read-write, reset 0x0 unless marked. A register's access mark holds for its fields unless they carry their own. Offsets are from the block's base; [hi:lo] are bit positions; lines under a group give offsets from that group; {n}, {i} and the like mark numbered series.

## SYS_CFG
Base 0x01C00000
0x04 MEMMAP_REG — DE memory control Register
0x24 VER_REG — Version Register
0x30 EMAC_EPHY_CLK_REG0 — EMAC-EPHY Clock Register 0

## TCON0 — TCON0 LVDS/RGB/MIPI-DSI Interface
Base 0x01C0C000
0x00 TCON_GCTL_REG — TCON global control register
0x04 TCON_GINT0_REG — TCON global interrupt register0
0x08 TCON_GINT1_REG — TCON global interrupt register1
0x10 TCON0_FRM_CTL_REG — TCON FRM control register
{0x14+0x18*i} TCON0_FRM_SEED_REG[{i}] (i=0..5) — TCON FRM seed register (N=0,1,2,3,4,5)
{0x2C+0x10*i} TCON0_FRM_TAB_REG[{i}] (i=0..3) — TCON FRM table register (N=0,1,2,3)
0x3C TCON0_3D_FIFO_REG — TCON0 3D fifo register
0x40 TCON0_CTL_REG — TCON0 control register
0x44 TCON0_DCLK_REG — TCON0 data clock register
0x48 TCON0_BASIC0_REG — TCON0 basic timing register0
0x4C TCON0_BASIC1_REG — TCON0 basic timing register
0x50 TCON0_BASIC2_REG — TCON0 basic timing register2
0x54 TCON0_BASIC3_REG — TCON0 basic timing register3
0x58 TCON0_HV_IF_REG — TCON0 hv panel interface register
0x60 TCON0_CPU_IF_REG — TCON0 cpu panel interface register
0x64 TCON0_CPU_WR_REG — TCON0 cpu panel write data register
0x68 TCON0_CPU_RD0_REG — TCON0 cpu panel read data register0
0x6C TCON0_CPU_RD1_REG — TCON0 cpu panel read data register1
0x84 TCON0_LVDS_IF_REG — TCON0 lvds panel interface register
0x88 TCON0_IO_POL_REG — TCON0 IO polarity register
0x8C TCON0_IO_TRI_REG — TCON0 IO trigger register
0x100 TCON_CEU_CTL_REG — TCON CEU control register
{0x110+0x30*i} unnamed[{i}] (i=0..2) group
  {0x0+0xC*j} MUL_REG[{j}] (j=0..2) — TCON CEU coefficient register0 (N=0,1,2, 4,5,6, 8,9,10)
  0x0C ADD_REG — 0x11C+N*0x10 TCON CEU coefficient register1 (N=0,1,2)
0x1F0 TCON_SAFE_PERIOD_REG — TCON safe period register
0x220 TCON0_LVDS_ANA0_REG — TCON LVDS analog register0
{0x400+0x400*i} TCON0_GAMMA_TABLE_REG[{i}] (i=0..255) — Gamma Table 0x400-0x7FF
0xFF4 TCON0_3D_FIFO_BIST_REG
0xFF8 TCON_TRI_FIFO_BIST_REG

## TCON1 — TCON1 HDMI Interface
Base 0x01C0D000
0x00 TCON_GCTL_REG — TCON global control register
0x04 TCON_GINT0_REG — TCON global interrupt register0
0x08 TCON_GINT1_REG — TCON global interrupt register1
0x90 TCON1_CTL_REG — TCON1 control register
{0x94+4i} TCON1_BASIC{i}_REG (i=0..5) — TCON1 basic timing register{i}
0xB0 TCON1_PS_SYNC_REG — TCON1 sync register
0xF0 TCON1_IO_POL_REG — TCON1 IO polarity register
0xF4 TCON1_IO_TRI_REG — TCON1 IO trigger register
0x100 TCON_CEU_CTL_REG — TCON CEU control register
{0x110+0x30*i} unnamed[{i}] (i=0..2) group
  {0x0+0xC*j} MUL_REG[{j}] (j=0..2) — TCON CEU coefficient register0 (N=0,1,2, 4,5,6, 8,9,10)
  0x0C ADD_REG — 0x11C+N*0x10 TCON CEU coefficient register1 (N=0,1,2)
{0x160+0xC*i} TCON_CEU_COEF_RANG_REG[{i}] (i=0..2) — TCON CEU coefficient register2 (N=0,1,2)
0x1F0 TCON_SAFE_PERIOD_REG — TCON safe period register
0x300 TCON1_FILL_CTL_REG — TCON1 fill data control register
{0x304+0x24*i} unnamed[{i}] (i=0..2) group
  0x00 TCON1_FILL_BEGIN_REG — TCON1 fill data begin register (N=0,1,2)
  0x04 TCON1_FILL_END_REG — TCON1 fill data end register (N=0,1,2)
  0x08 TCON1_FILL_DATA0_REG — TCON1 fill data value register (N=0,1,2)
{0x400+0x400*i} TCON1_GAMMA_TABLE_REG[{i}] (i=0..255) — Gamma Table 0x400-0x7FF
0xFFC TCON_ECC_FIFO_BIST_REG

## THS
Base 0x01C25000
0x00 THS_CTRL — THS Control Register
0x04 THS_EN — THS Enable Register
0x08 THS_PER — THS Period Control Register
0x10 THS_DATA_INTC — THS Data Interrupt Control Register
0x14 THS_SHUT_INTC — THS Shut Interrupt Control Register
0x18 THS_ALARM_INTC — THS Alarm Interrupt Control Register
0x20 THS_DATA_INTS — THS Data Interrupt Status Register
0x24 THS_SHUT_INTS — THS Shut Interrupt Status Register
0x28 THS_ALARMO_INTS — THS Alarm off Interrupt Status Register
0x2C THS_ALARM_INTS — THS Alarm Interrupt Status Register
0x30 THS_FILTER — THS Median Filter Control Register
0x40 THS_ALARM_CTRL — THS Alarm Threshold Control Register
0x80 THS_SHUTDOWN_CTRL — THS Shutdown Threshold Control Register
0xA0 THS_CDATA — THS Calibration Data
0xC0 THS_DATA
