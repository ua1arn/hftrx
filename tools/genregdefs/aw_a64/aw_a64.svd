# aw_a64 register map
File version: 1.00
Registers are 32-bit, read-write, reset 0x0 unless marked. A register's access mark holds for its fields unless they carry their own. Offsets are from the block's base; [hi:lo] are bit positions; lines under a group give offsets from that group; {n}, {i} and the like mark numbered series.

## TIMER
Base 0x01C20C00
0x00 TMR_IRQ_EN_REG — Timer IRQ Enable Register
0x04 TMR_IRQ_STA_REG — Timer Status Register
{0x10+0x20*i} unnamed[{i}] (i=0..1) group
  0x00 CTRL_REG — Timer n Control Register
  0x04 INTV_VALUE_REG — Timer n Interval Value Register
  0x08 CUR_VALUE_REG — Timer n Current Value Register
0x80 AVS_CNT_CTL_REG — AVS Control Register
0x84 AVS_CNT0_REG — AVS Counter 0 Register
0x88 AVS_CNT1_REG — AVS Counter 1 Register
0xA0 WDOG_IRQ_EN_REG — Watchdog IRQ Enable Register
0xA4 WDOG_IRQ_STA_REG — Watchdog Status Register
0xB0 WDOG_CTRL_REG — Watchdog Control Register
0xB4 WDOG_CFG_REG — Watchdog Configuration Register
0xB8 WDOG_MODE_REG — Watchdog Mode Register

## TIMESTAMP_CTRL
Base 0x01C1A000
0x00 TSTAMP_CTRL_REG — Counter Control Register.
0x04 CNTSR — Timestamp Status Register
0x08 CNT_CTRL_LOW_REG — Counter Low Register
0x0C CNT_CTRL_HI_REG — Counter High Register
0x20 CNT_FREQID_REG — Counter Base Frequency ID Register

## TIMESTAMP_STA
Base 0x01C1B000
0x00 CNT_LOW_REG — Counter Low Register
0x04 CNT_HI_REG — Counter High Register

## TPADC
Base 0x02009C00
{0x0+4i} TP_CTRL_REG{i} (i=0..3) — TP Control Register {i}
0x10 TP_INT_FIFO_CTRL_REG — TP Interrupt FIFO Control Register
0x14 TP_INT_FIFO_STAT_REG — TP Interrupt FIFO Status Register
0x1C TP_CALI_DATA_REG — TP Calibration Data Register
0x24 TP_DATA_REG — TP Data Register

## R_TWI
Base 0x01F02400
Same registers: TWI0 0x01C2AC00, TWI1 0x01C2B000, TWI2 0x01C2B400
0x00 TWI_ADDR — TWI Slave Address Register
0x04 TWI_XADDR — TWI Extended Slave Address Register
0x08 TWI_DATA — TWI Data Byte Register
0x0C TWI_CNTR — TWI Control Register
0x10 TWI_STAT — TWI Status Register
0x14 TWI_CCR — TWI Clock Control Register
0x18 TWI_SRST — TWI Software Reset Register
0x1C TWI_EFR — TWI Enhance Feature Register
0x20 TWI_LCR — TWI Line Control Register

## UART0
Base 0x01C28000
Same registers: UART1 0x01C28400, UART2 0x01C28800, UART3 0x01C28C00, UART4 0x01C29000, R_UART 0x01F02800
0x00 UART_RBR_THR_DLL — UART Receive Buffer Register/Transmit Holding Register
0x04 UART_DLH_IER
0x08 UART_IIR_FCR — UART Interrupt Identity Register/UART FIFO Control Register
0x0C UART_LCR — UART Line Control Register
0x10 UART_MCR — UART Modem Control Register
0x14 UART_LSR — UART Line Status Register
0x18 UART_MSR — UART Modem Status Register
0x1C UART_SCH — UART Scratch Register
0x7C UART_USR — UART Status Register
0x80 UART_TFL — UART Transmit FIFO Level Register
0x84 UART_RFL — UART Receive FIFO Level Register
0x88 UART_HSK — UART DMA Handshake Configuration Register
0x8C UART_DMA_REQ_EN — UART DMA Request Enable Register
0xA4 UART_HALT — UART Halt TX Register
0xB0 UART_DBG_DLL — UART Debug DLL Register
0xB4 UART_DBG_DLH — UART Debug DLH Register
0xF0 UART_A_FCC — UART FIFO Clock Control Register
0x100 UART_A_RXDMA_CTRL — UART RXDMA Control Register
0x104 UART_A_RXDMA_STR — UART RXDMA Start Register
0x108 UART_A_RXDMA_STA — UART RXDMA Status Register
0x10C UART_A_RXDMA_LMT — UART RXDMA Limit Register
0x110 UART_A_RXDMA_SADDRL — UART RXDMA Buffer Start Address Low Register
0x114 UART_A_RXDMA_SADDRH — UART RXDMA Buffer Start Address High Register
0x118 UART_A_RXDMA_BL — UART RXDMA Buffer Length Register
0x120 UART_A_RXDMA_IE — UART RXDMA Interrupt Enable Register
0x124 UART_A_RXDMA_IS — UART RXDMA Interrupt Status Register
0x128 UART_A_RXDMA_WADDRL — UART RXDMA Write Address Low Register
0x12C UART_A_RXDMA_WADDRH — UART RXDMA Write Address high Register
0x130 UART_A_RXDMA_RADDRL — UART RXDMA Read Address Low Register
0x134 UART_A_RXDMA_RADDRH — UART RXDMA Read Address high Register
0x138 UART_A_RXDMA_DCNT — UART RADMA Data Count Register
