# aw_a64 register map
File version: 1.00
Registers are 32-bit, read-write, reset 0x0 unless marked. A register's access mark holds for its fields unless they carry their own. Offsets are from the block's base; [hi:lo] are bit positions; lines under a group give offsets from that group; {n}, {i} and the like mark numbered series.

## USBOTG0 — USB OTG Dual-Role Device controller
Base 0x01C19000
{0x0+0x40*i} USB_EPFIFO[{i}] (i=0..15) — USB_EPFIFO [0..5] USB FIFO Entry for Endpoint N
0x40 USB_GCS — USB_POWER, USB_DEVCTL, USB_EPINDEX, USB_DMACTL USB Global Control and Status Register
0x44 USB_EPINTF — USB_INTTX - lower 16, USB_INTRX - high 16, USB_EPINTF USB Endpoint Interrupt Flag Register
0x48 USB_EPINTE — USB_INTTXE - lower 16, USB_INTRXE - high 16, USB_EPINTE USB Endpoint Interrupt Enable Register
0x4C USB_INTUSB — USB_INTUSB USB_BUSINTF USB Bus Interrupt Flag Register
0x50 USB_INTUSBE — USB_INTUSBE USB_BUSINTE USB Bus Interrupt Enable Register
0x54 USB_FNUM — USB Frame Number Register
0x7C USB_TESTC — USB_TESTC USB Test Control Register
0x80 USB_TXMAXP 16-bit — USB_TXMAXP USB EP1~5 Tx Control and Status Register
0x82 USB_TXCSRHI 16-bit — [15:8]: USB_TXCSRH, [7:0]: USB_TXCSRL
0x84 USB_RXMAXP 16-bit — USB_RXMAXP USB EP1~5 Rx Control and Status Register
0x86 USB_RXCSRHI 16-bit — USB_RXCSR
0x88 USB_RXCOUNT — USB_RXCOUNT, USB_RXPKTCNT - high 16 bits
0x8C USB_EPATTR — USB_EPATTR USB EP0 Attribute Register, USB EP1~5 Attribute Register
0x90 USB_TXFIFO — USB_TXFIFO (bits 28:16 Start address of the endpoint FIFO is in units of 8 bytes)
0x94 USB_RXFIFO — USB_RXFIFO (bits 28:16 Start address of the endpoint FIFO is in units of 8 bytes)
{0x98+0x70*i} unnamed[{i}] (i=0..15) group
  0x00 USB_TXFADDR 16-bit
  0x02 USB_TXHADDR 8-bit
  0x03 USB_TXHUBPORT 8-bit
  0x04 USB_RXFADDR 8-bit
  0x06 USB_RXHADDR 8-bit
  0x07 USB_RXHUBPORT 8-bit
0x400 USB_ISCR — HCI Interface Register (HCI_Interface)
0x404 USBPHY_PHYCTL
0x408 HCI_CTRL3 — HCI Control 3 Register (bist)
0x410 PHY_CTRL — PHY Control Register (PHY_Control)
0x420 PHY_OTGCTL — Control PHY routing to EHCI or OTG
0x424 PHY_STATUS
0x428 USB_SPDCR — HCI SIE Port Disable Control Register
0x500 USB_DMA_INTE — USB DMA Interrupt Enable Register
0x504 USB_DMA_INTS — USB DMA Interrupt Status Register
{0x540+0x100*i} unnamed[{i}] (i=0..15) group
  0x00 CHAN_CFG — USB DMA Channel Configuration Register
  0x04 SDRAM_ADD — USB DMA SDRAM Start Address Register
  0x08 BC — USB DMA Byte Counter Register
  0x0C RESIDUAL_BC — USB DMA RESIDUAL Byte Counter Register

## USBPHY0
Base 0x01C1A800
Same registers: USBPHY1 0x01C1B800
0x00 HCI_ICR — HCI Interface Register (HCI_Interface)
0x04 USBPHY_PHYCTL — (HSIC_STATUS) HSIC status Register This register is valid on HCI1.
0x08 HCI_CTRL3 — HCI Control 3 Register (bist)
0x10 PHY_CTRL — PHY Control Register (PHY_Control)
0x20 PHY_OTGCTL — Control PHY routing to EHCI or OTG
0x24 PHY_STATUS
0x28 USB_SPDCR — HCI SIE Port Disable Control Register

## USBEHCI0
Base 0x01C1A000
Same registers: USBEHCI1 0x01C1B000
0x00 HCCAPBASE — EHCI Capability Register (HCIVERSION and CAPLENGTH) register
0x04 HCSPARAMS — EHCI Host Control Structural Parameter Register
0x08 HCCPARAMS — EHCI Host Control Capability Parameter Register
0x0C HCSPPORTROUTE — EHCI Companion Port Route Description
0x10 USBCMD — EHCI USB Command Register
0x14 USBSTS — EHCI USB Status Register
0x18 USBINTR — EHCI USB Interrupt Enable Register
0x1C FRINDEX — EHCI USB Frame Index Register
0x20 CTRLDSSEGMENT — EHCI 4G Segment Selector Register
0x24 PERIODICLISTBASE — EHCI Frame List Base Address Register
0x28 ASYNCLISTADDR — EHCI Next Asynchronous List Address Register

## USBOHCI0
Base 0x01C1A400
Same registers: USBOHCI1 0x01C1B400
0x00 O_HcRevision — OHCI Revision Register (not documented)
0x04 O_HcControl — OHCI Control Register
0x08 O_HcCommandStatus — OHCI Command Status Register
0x0C O_HcInterruptStatus — OHCI Interrupt Status Register
0x10 O_HcInterruptEnable — OHCI Interrupt Enable Register
0x14 O_HcInterruptDisable — OHCI Interrupt Disable Register
0x18 O_HcHCCA — OHCI HCCA Base
0x1C O_HcPeriodCurrentED — OHCI Period Current ED Base
0x20 O_HcControlHeadED — OHCI Control Head ED Base
0x24 O_HcControlCurrentED — OHCI Control Current ED Base
0x28 O_HcBulkHeadED — OHCI Bulk Head ED Base
0x2C O_HcBulkCurrentED — OHCI Bulk Current ED Base
0x30 O_HcDoneHead — OHCI Done Head Base
0x34 O_HcFmInterval — OHCI Frame Interval Register
0x38 O_HcFmRemaining — OHCI Frame Remaining Register
0x3C O_HcFmNumber — OHCI Frame Number Register
0x40 O_HcPerioddicStart — OHCI Periodic Start Register
0x44 O_HcLSThreshold — OHCI LS Threshold Register
0x48 O_HcRhDescriptorA — OHCI Root Hub Descriptor Register A
0x4C O_HcRhDesriptorB — OHCI Root Hub Descriptor Register B
0x50 O_HcRhStatus — OHCI Root Hub Status Register
{0x54+4i} O_HcRhPortStatus[{i}] (i=0..0) — OHCI Root Hub Port Status Register
