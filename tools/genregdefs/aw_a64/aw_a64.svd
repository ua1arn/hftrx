# aw_a64 register map
File version: 1.00
for test
Registers are 32-bit, read-write, reset 0x0 unless marked. A register's access mark holds for its fields unless they carry their own. Offsets are from the block's base; lines under a group give offsets from that group; [hi:lo] are bit positions; {n}, {i} and the like mark numbered series; 'fields as' and 'values as' point back to an identical list; <NAME> marks a mode.

## Memory map
0x01000000 DE_TOP — Display Engine Top
0x01010000 DE_WB — Real-time write-back controller (RT-WB)
0x01020000 DE_CSR — Copy & Rotation
0x01100000 DE_MIXER0_GLB
0x01101000 DE_MIXER0_BLD
0x01102000 DE_MIXER0_VI1
0x01103000 DE_MIXER0_UI1
0x01104000 DE_MIXER0_UI2
0x01105000 DE_MIXER0_UI3
0x01120000 DE_MIXER0_VSU1 — Video Scaler Unit (VSU), VS
0x01140000 DE_MIXER0_UIS1 — UI Scaler(UIS) provides RGB format image resizing function
0x01150000 DE_MIXER0_UIS2
0x01160000 DE_MIXER0_UIS3
0x01200000 DE_MIXER1_GLB
0x01201000 DE_MIXER1_BLD
0x01202000 DE_MIXER1_VI1
0x01203000 DE_MIXER1_UI1
0x01220000 DE_MIXER1_VSU1
0x01240000 DE_MIXER1_UIS1
0x01700000 CPUX_CFG
0x01C00000 SYS_CFG
0x01C01000 DRAMC
0x01C02000 DMAC
0x01C03000 NDFC — NAND Flash Controller Interface
0x01C0C000 TCON0 — TCON0 LVDS/RGB/MIPI-DSI Interface
0x01C0D000 TCON1 — TCON1 HDMI Interface
0x01C0E000 VENCODER — Video Encoding
0x01C0F000 SMHC0 — SD-MMC Host Controller
0x01C10000 SMHC1
0x01C11000 SMHC2
0x01C14000 SID — Security ID
0x01C17000 MSGBOX
0x01C19000 USBOTG0 — USB OTG Dual-Role Device controller
0x01C1A000 TIMESTAMP_CTRL
0x01C1A000 USBEHCI0
0x01C1A400 USBOHCI0
0x01C1A800 USBPHY0
0x01C1B000 TIMESTAMP_STA
0x01C1B000 USBEHCI1
0x01C1B400 USBOHCI1
0x01C1B800 USBPHY1
0x01C20000 CCU
0x01C20800 GPIOBLOCK
0x01C20824 GPIOB
0x01C20848 GPIOC
0x01C2086C GPIOD
0x01C20890 GPIOE
0x01C208B4 GPIOF
0x01C208D8 GPIOG
0x01C208FC GPIOH
0x01C20A00 GPIOINTB
0x01C20A20 GPIOINTC
0x01C20A40 GPIOINTD
0x01C20A60 GPIOINTE
0x01C20A80 GPIOINTF
0x01C20AA0 GPIOINTG
0x01C20AC0 GPIOINTH
0x01C20C00 TIMER
0x01C21000 OWA — One Wire Audio
0x01C21400 PWM
0x01C22000 I2S0 — I2S/PCM Controller
0x01C22400 I2S1
0x01C22800 I2S2
0x01C22C00 AUDIO_CODEC
0x01C25000 THS
0x01C28000 UART0
0x01C28400 UART1
0x01C28800 UART2
0x01C28C00 UART3
0x01C29000 UART4
0x01C2AC00 TWI0
0x01C2B000 TWI1
0x01C2B400 TWI2
0x01C30000 EMAC
0x01C40000 GPU — Mali-400MP2
0x01C68000 SPI0 — Serial Peripheral Interface
0x01C69000 SPI1
0x01C84000 GICVSELF
0x01C85000 GICV
0x01EE0000 HDMI_TX0
0x01EF0000 HDMI_PHY
0x01F00000 RTC
0x01F00800 R_TIMER
0x01F01000 R_WDOG
0x01F01400 R_PRCM
0x01F01C00 R_CPUCFG
0x01F02000 CIR_RX
0x01F02400 R_TWI
0x01F02800 R_UART
0x01F02C00 GPIOL
0x01F03400 R_RSB — Reduced Serial Bus Host Controller
0x02009000 GPADC
0x02009C00 TPADC
0x02010000 IOMMU
0x02031000 DMIC
0x03040000 CE_NS
0x03040800 CE_S
0x03103000 DDRPHYC
0x08100000 CPU_SUBSYS_CTRL

## Interrupts
32 UART0 (UART{n} (n=0..4), R_UART)
33 UART1 (UART{n} (n=0..4), R_UART)
34 UART2 (UART{n} (n=0..4), R_UART)
35 UART3 (UART{n} (n=0..4), R_UART)
36 UART4 (UART{n} (n=0..4), R_UART)
38 TWI0 (R_TWI, TWI{n} (n=0..2))
39 TWI1 (R_TWI, TWI{n} (n=0..2))
40 TWI2 (R_TWI, TWI{n} (n=0..2))
43 PB_EINT (GPIOINTB, GPIOINTC, GPIOINTD, GPIOINTE, GPIOINTF, GPIOINTG, GPIOINTH)
44 OWA
45 I2S_PCM0 (I2S{n} (n=0..2))
46 I2S_PCM1 (I2S{n} (n=0..2))
47 I2S_PCM2 (I2S{n} (n=0..2))
49 PG_EINT (GPIOINTB, GPIOINTC, GPIOINTD, GPIOINTE, GPIOINTF, GPIOINTG, GPIOINTH)
50 TIMER0 (TIMER)
51 TIMER1 (TIMER)
53 PH_EINT (GPIOINTB, GPIOINTC, GPIOINTD, GPIOINTE, GPIOINTF, GPIOINTG, GPIOINTH)
61 AUDIO_CODEC
65 R_TIMER0 (R_TIMER)
66 R_TIMER1 (R_TIMER)
68 R_WDOG
70 R_UART (UART{n} (n=0..4), R_UART)
71 R_RSB
74 R_TIMER2 (R_TIMER)
75 R_TIMER3 (R_TIMER)
76 R_TWI (R_TWI, TWI{n} (n=0..2))
77 R_PL_EINT (GPIOINTB, GPIOINTC, GPIOINTD, GPIOINTE, GPIOINTF, GPIOINTG, GPIOINTH)
78 EMAC
81 MSGBOX
82 DMAC
89 GPADC
90 VE (VENCODER)
92 SMHC0 (SMHC{n} (n=0..2))
93 SMHC1 (SMHC{n} (n=0..2))
94 SMHC2 (SMHC{n} (n=0..2))
94 TPADC
96 IOMMU
97 SPI0 (SPI0, SPI1)
98 SPI1 (SPI0, SPI1)
102 NAND (NDFC)
103 USBOTG0
104 USBEHCI0 (USBEHCI0, USBEHCI1)
105 USBOHCI0 (USBOHCI0, USBOHCI1)
106 USBEHCI1 (USBEHCI0, USBEHCI1)
107 USBOHCI1 (USBOHCI0, USBOHCI1)
118 TCON0
119 TCON1
120 HDMI_TX0
127 DE (DE_TOP)
129 GPU_GP (GPU)
130 GPU_GPMMU (GPU)
131 GPU_PP0 (GPU)
132 GPU_PP0MMU (GPU)
133 GPU_PMU (GPU)
134 GPU_PP1 (GPU)
135 GPU_PPMMU1 (GPU)

## Notices in the file
Copyright (c) 2024 by Genadi V. Zawidowski. All rights reserved.
