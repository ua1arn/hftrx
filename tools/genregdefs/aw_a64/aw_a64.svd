# aw_a64 register map
File version: 1.00
Registers are 32-bit, read-write, reset 0x0 unless marked. A register's access mark holds for its fields unless they carry their own. Offsets are from the block's base; [hi:lo] are bit positions; lines under a group give offsets from that group; {n}, {i} and the like mark numbered series.

## DE_CSR — Copy & Rotation
Base 0x01020000
0x00 CSR_CTL
0x04 INT — Interrupt register
0x20 IFMT — Input data attribute register
0x24 IDATA_SIZE — Input data size register
0x30 IDATA_MEN_PITCH0 — Input Y/RGB/ARGB memory pitch register
0x34 IDATA_MEN_PITCH1 — Input U/UV memory pitch register
0x38 IDATA_MEN_PITCH2 — Input V memory pitch register
0x40 IMEN_LADD0 — Input Y/RGB/ARGB memory address register0
0x44 IMEN_HADD0 — Input Y/RGB/ARGB memory address register1
0x48 IMEN_LADD1 — Input U/UV memory address register0
0x4C IMEN_HADD1 — Input U/UV memory address register1
0x50 IMEN_LADD2 — Input V memory address register0
0x54 IMEN_HADD2 — Input V memory address register1
0x84 ODATA_SIZE — Output data size register
{0x90+4i} ODATA_MEN_PITCH{i} (i=0..2)
0xA0 OMEN_LADD0 — Output Y/RGB/ARGB memory address register0
0xA4 OMEN_HADD0 — Output Y/RGB/ARGB memory address register1
0xA8 OMEN_LADD1 — Output U/UV memory address register0
0xAC OMEN_HADD1 — Output U/UV memory address register1
0xB0 OMEN_LADD2 — Output V memory address register0
0xB4 OMEN_HADD2 — Output V memory address register1

## DE_MIXER0_GLB
Base 0x01100000
Same registers: DE_MIXER1_GLB 0x01200000
0x00 GLB_CTL — Global control register
0x04 GLB_STS — Global status register
0x08 GLB_DBUFFER — Global double buffer control register
0x0C GLB_SIZE — Global size register

## DE_TOP — Display Engine Top
Base 0x01000000
0x00 SCLK_GATE — DE SCLK Gating Register
0x04 HCLK_GATE — DE HCLK Gating Register
0x08 AHB_RESET — DE AHB Reset register
0x0C SCLK_DIV — DE SCLK Division register
0x10 DE2TCON_MUX — MUX register
0x14 CMD_CTL

## DE_MIXER0_UI1
Base 0x01103000
Same registers: DE_MIXER0_UI2 0x01104000, DE_MIXER0_UI3 0x01105000, DE_MIXER1_UI1 0x01203000
{0x0+0x80*i} unnamed[{i}] (i=0..3) group
  0x00 ATTR
  0x04 SIZE
  0x08 COORD
  0x0C PITCH
  0x10 TOP_LADDR
  0x14 BOT_LADDR
  0x18 FCOLOR
0x80 TOP_HADDR
0x84 BOT_HADDR
0x88 OVL_SIZE

## DE_MIXER0_UIS1 — UI Scaler(UIS) provides RGB format image resizing function
Base 0x01140000
Same registers: DE_MIXER0_UIS2 0x01150000, DE_MIXER0_UIS3 0x01160000, DE_MIXER1_UIS1 0x01240000
0x00 UIS_CTRL_REG — Control register
0x08 UIS_STATUS_REG — Status register
0x0C UIS_FIELD_CTRL_REG — Field control register
0x10 UIS_BIST_REG — BIST control register
0x40 UIS_OUT_SIZE_REG — Output size register
0x80 UIS_INSIZE_REG — Input size register
0x88 UIS_HSTEP_REG — Horizontal step register
0x8C UIS_VSTEP_REG — Vertical step register
0x90 UIS_HPHASE_REG — Horizontal initial phase register
0x98 UIS_VPHASE0_REG — Vertical initial phase 0 register
0x9C UIS_VPHASE1_REG — Vertical initial phase 1 register
{0x200+0x40*i} UIS_HCOEF_REGN[{i}] (i=0..15) — Horizontal filter coefficient register N (N=0:15)

## DE_MIXER0_VI1
Base 0x01102000
Same registers: DE_MIXER1_VI1 0x01202000
{0x0+0xC0*i} unnamed[{i}] (i=0..3) group
  0x00 ATTR
  0x04 SIZE
  0x08 COORD
  {0xC+0xC*j} PITCH[{j}] (j=0..2) — ix=0: Y, ix=1: U/UV channel, ix=3: V channel
  {0x18+0xC*j} TOP_LADDR[{j}] (j=0..2)
  {0x24+0xC*j} BOT_LADDR[{j}] (j=0..2)
{0xC0+0x10*i} FCOLOR[{i}] (i=0..3)
{0xD0+0xC*i} TOP_HADDR[{i}] (i=0..2)
{0xDC+0xC*i} BOT_HADDR[{i}] (i=0..2)
{0xE8+8i} OVL_SIZE[{i}] (i=0..1) — OVL_Y, OVL_UV overlay window size register
{0xF0+8i} HORI[{i}] (i=0..1) — OVL_V horizontal down sample control register
{0xF8+8i} VERT[{i}] (i=0..1) — OVL_V vertical down sample control register

## DE_MIXER0_VSU1 — Video Scaler Unit (VSU), VS
Base 0x01120000
Same registers: DE_MIXER1_VSU1 0x01220000
0x00 VSU_CTRL_REG — VSU Module Control Register
0x08 VSU_STATUS_REG — VSU Status Register
0x0C VSU_FIELD_CTRL_REG — VSU Field Control Register
0x10 VSU_SCALE_MODE_REG — VSU Scale Mode Setting Register
0x20 VSU_DIRECTION_THR_REG — VSU Direction Detection Threshold Register
0x24 VSU_EDGE_THR_REG — VSU Edge Detection Setting Register
0x28 VSU_EDSCALER_CTRL_REG — VSU Edge-Direction Scaler Control Register
0x2C VSU_ANGLE_THR_REG — VSU Angle Reliability Setting Register
0x30 VSU_SHARP_EN_REG — VSU Sharpness Control Enable Register
0x34 VSU_SHARP_CORING_REG — VSU Sharpness Control Coring Setting Register
0x38 VSU_SHARP_GAIN0_REG — VSU Sharpness Control Gain Setting 0 Register
0x3C VSU_SHARP_GAIN1_REG — VSU Sharpness Control Gain Setting 1 Register
0x40 VSU_OUT_SIZE_REG — VSU Output Size Register
0x44 VSU_GLOBAL_ALPHA_REG — VSU Output Global Alpha Register
0x80 VSU_Y_SIZE_REG — VSU Y Channel Size Register
0x88 VSU_Y_HSTEP_REG — VSU Y Channel Horizontal Step Register
0x8C VSU_Y_VSTEP_REG — VSU Y Channel Vertical Step Register
0x90 VSU_Y_HPHASE_REG — VSU Y Channel Horizontal Initial Phase Register
0x98 VSU_Y_VPHASE0_REG — VSU Y Channel Vertical Initial Phase 0 Register
0x9C VSU_Y_VPHASE1_REG — VSU Y Channel Vertical Initial Phase 1 Register
0xC0 VSU_C_SIZE_REG — VSU C Channel Size Register
0xC8 VSU_C_HSTEP_REG — VSU C Channel Horizontal Step Register
0xCC VSU_C_VSTEP_REG — VSU C Channel Vertical Step Register
0xD0 VSU_C_HPHASE_REG — VSU C Channel Horizontal Initial Phase Register
0xD8 VSU_C_VPHASE0_REG — VSU C Channel Vertical Initial Phase 0 Register
0xDC VSU_C_VPHASE1_REG — VSU C Channel Vertical Initial Phase 1 Register
{0x200+0x80*i} VSU_Y_HCOEF0_REGN[{i}] (i=0..31) — 0x200+N*4 VSU Y Channel Horizontal Filter Coefficient0 Register N N = M 1))
{0x300+0x80*i} VSU_Y_HCOEF1_REGN[{i}] (i=0..31) — 0x300+N*4 VSU Y Channel Horizontal Filter Coefficient1 Register N N = M 1
{0x400+0x80*i} VSU_Y_VCOEF_REGN[{i}] (i=0..31) — 0x400+N*4 VSU Y Channel Vertical Filter Coefficient Register N N = M 1))
{0x600+0x80*i} VSU_C_HCOEF0_REGN[{i}] (i=0..31) — 0x600+N*4 VSU C Channel Horizontal Filter Coefficient0 Register N N = M 1))
{0x700+0x80*i} VSU_C_HCOEF1_REGN[{i}] (i=0..31) — 0x700+N*4 VSU C Channel Horizontal Filter Co efficient1 Register N N = M 1))
{0x800+0x80*i} VSU_C_VCOEF_REGN[{i}] (i=0..31) — 0x800+N*4 VSU C Channel Vertical Filter Coefficient Register N N = M 1))
