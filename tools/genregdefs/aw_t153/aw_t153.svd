# aw_t153 register map
File version: 1.00
Registers are 32-bit, read-write, reset 0x0 unless marked. A register's access mark holds for its fields unless they carry their own. Offsets are from the block's base; [hi:lo] are bit positions; {n}, {i} and the like mark numbered series.

## SPI0 — Serial Peripheral Interface
Base 0x04025000
Same registers: SPI1 0x04026000, SPI2 0x04027000, SPI3 0x04028000
0x04 SPI_GCR — SPI Global Control Register
0x08 SPI_TCR — SPI Transfer Control Register
0x10 SPI_IER — SPI Interrupt Control Register
0x14 SPI_ISR — SPI Interrupt Status Register
0x18 SPI_FCR — SPI FIFO Control Register
0x1C SPI_FSR — SPI FIFO Status Register
0x20 SPI_WCR — SPI Wait Clock Register
0x24 SPI_CCR — SPI Clock Control Register (not documented)
0x28 SPI_SAMP_DL — SPI Sample Delay Control Register
0x30 SPI_MBC — SPI Master Burst Counter Register
0x34 SPI_MTC — SPI Master Transmit Counter Register
0x38 SPI_BCC — SPI Master Burst Control Register
0x40 SPI_BATCR — SPI Bit-Aligned Transfer Configure Register
0x44 SPI_BA_CCR — SPI Bit-Aligned Clock Configuration Register
0x48 SPI_TBR — SPI TX Bit Register
0x4C SPI_RBR — SPI RX Bit Register
0x88 SPI_NDMA_MODE_CTL — SPI Normal DMA Mode Control Register
{0x100+4i} DBI_CTL_{i} (i=0..2) — DBI Control Register {i}
0x10C DBI_TIMER — DBI Timer Control Register
0x110 DBI_VIDEO_SZIE — DBI Video Size Configuration Register
0x120 DBI_INT — DBI Interrupt Register
0x124 DBI_DEBUG_0 — DBI BEBUG 0 Register
0x128 DBI_DEBUG_1 — DBI BEBUG 1 Register
0x200 SPI_TXD — SPI TX Data Register
0x300 SPI_RXD — SPI RX Data Register

## TWI0 — Two Wire Interface (TWI)
Base 0x02510000
Same registers: TWI1 0x02511000, TWI2 0x02512000, TWI3 0x02513000, TWI4 0x02514000, TWI5 0x02515000
0x00 TWI_ADDR — TWI Slave Address Register
0x04 TWI_XADDR — TWI Extended Slave Address Register
0x08 TWI_DATA — TWI Data Byte Register
0x0C TWI_CNTR — TWI Control Register
0x10 TWI_STAT — TWI Status Register
0x14 TWI_CCR — TWI Clock Control Register
0x18 TWI_SRST — TWI Software Reset Register
0x1C TWI_EFR — TWI Enhance Feature Register
0x20 TWI_LCR — TWI Line Control Register
0x200 TWI_DRV_CTRL — TWI_DRV Control Register
0x204 TWI_DRV_CFG — TWI_DRV Transmission Configuration Register
0x208 TWI_DRV_SLV — TWI_DRV Slave ID Register
0x20C TWI_DRV_FMT — TWI_DRV Packet Format Register
0x210 TWI_DRV_BUS_CTRL — TWI_DRV Bus Control Register
0x214 TWI_DRV_INT_CTRL — TWI_DRV Interrupt Control Register
0x218 TWI_DRV_DMA_CFG — TWI_DRV DMA Configure Register
0x21C TWI_DRV_FIFO_CON — TWI_DRV FIFO Content Register
0x300 TWI_DRV_SEND_FIFO_ACC — TWI_DRV Send Data FIFO Access Register
0x304 TWI_DRV_RECV_FIFO_ACC — TWI_DRV Receive Data FIFO Access Register

## UART0
Base 0x02600000
Same registers: UART{n} {0x2600000+0x10000*n} (n=1..9)
0x00 UART_RBR_THR_DLL — UART Receive Buffer Register/Transmit Holding Register
0x04 UART_DLH_IER
0x08 UART_IIR_FCR — UART Interrupt Identity Register/UART FIFO Control Register
0x0C UART_LCR — UART Line Control Register
0x10 UART_MCR — UART Modem Control Register
0x14 UART_LSR — UART Line Status Register
0x18 UART_MSR — UART Modem Status Register
0x1C UART_SCH — UART Scratch Register
0x7C UART_USR — UART Status Register
0x80 UART_TFL — UART Transmit FIFO Level Register
0x84 UART_RFL — UART Receive FIFO Level Register
0x88 UART_HSK — UART DMA Handshake Configuration Register
0x8C UART_DMA_REQ_EN — UART DMA Request Enable Register
0xA4 UART_HALT — UART Halt TX Register
0xB0 UART_DBG_DLL — UART Debug DLL Register
0xB4 UART_DBG_DLH — UART Debug DLH Register
0xF0 UART_A_FCC — UART FIFO Clock Control Register
0x100 UART_A_RXDMA_CTRL — UART RXDMA Control Register
0x104 UART_A_RXDMA_STR — UART RXDMA Start Register
0x108 UART_A_RXDMA_STA — UART RXDMA Status Register
0x10C UART_A_RXDMA_LMT — UART RXDMA Limit Register
0x110 UART_A_RXDMA_SADDRL — UART RXDMA Buffer Start Address Low Register
0x114 UART_A_RXDMA_SADDRH — UART RXDMA Buffer Start Address High Register
0x118 UART_A_RXDMA_BL — UART RXDMA Buffer Length Register
0x120 UART_A_RXDMA_IE — UART RXDMA Interrupt Enable Register
0x124 UART_A_RXDMA_IS — UART RXDMA Interrupt Status Register
0x128 UART_A_RXDMA_WADDRL — UART RXDMA Write Address Low Register
0x12C UART_A_RXDMA_WADDRH — UART RXDMA Write Address high Register
0x130 UART_A_RXDMA_RADDRL — UART RXDMA Read Address Low Register
0x134 UART_A_RXDMA_RADDRH — UART RXDMA Read Address high Register
0x138 UART_A_RXDMA_DCNT — UART RADMA Data Count Register
