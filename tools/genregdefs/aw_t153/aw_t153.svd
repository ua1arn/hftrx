# aw_t153 register map
File version: 1.00
Registers are 32-bit, read-write, reset 0x0 unless marked. A register's access mark holds for its fields unless they carry their own. Offsets are from the block's base; [hi:lo] are bit positions; {n}, {i} and the like mark numbered series.

## CCU — Clock Controller Unit (CCU)
Base 0x02002000
0xA0 PLL_PERI0_CTRL_REG — PLL_PERI0 Control Register
0xA8 PLL_PERI0_PAT0_CTRL_REG — PLL_PERI0 Pattern0 Control Register
0xAC PLL_PERI0_PAT1_CTRL_REG — PLL_PERI0 Pattern1 Control Register
0xB0 PLL_PERI0_BIAS_REG — PLL_PERI0 Bias Register
0xC0 PLL_PERI1_CTRL_REG — PLL_PERI1 Control Register
0xC8 PLL_PERI1_PAT0_CTRL_REG — PLL_PERI1 Pattern0 Control Register
0xCC PLL_PERI1_PAT1_CTRL_REG — PLL_PERI1 Pattern1 Control Register
0xD0 PLL_PERI1_BIAS_REG — PLL_PERI1 Bias Register
0x120 PLL_VIDEO0_CTRL_REG — PLL_VIDEO0 Control Register
0x128 PLL_VIDEO0_PAT0_CTRL_REG — PLL_VIDEO0 Pattern0 Control Register
0x12C PLL_VIDEO0_PAT1_CTRL_REG — PLL_VIDEO0 Pattern1 Control Register
0x130 PLL_VIDEO0_BIAS_REG — PLL_VIDEO0 Bias Register
0x260 PLL_AUDIO0_CTRL_REG — PLL_AUDIO0 Control Register
0x268 PLL_AUDIO0_PAT0_CTRL_REG — PLL_AUDIO0 Pattern0 Control Register
0x26C PLL_AUDIO0_PAT1_CTRL_REG — PLL_AUDIO0 Pattern1 Control Register
0x270 PLL_AUDIO0_BIAS_REG — PLL_AUDIO0 Bias Register
0x340 PLL_CPU_CTRL_REG — PLL_CPU Control Register
0x344 PLL_CPU_PAT0_CTRL_REG — PLL_CPU Pattern0 Control Register
0x348 PLL_CPU_PAT1_CTRL_REG — PLL_CPU Pattern1 Control Register
0x34C PLL_CPU_BIAS_REG — PLL_CPU Bias Register
0x350 PLL_CPU_TUN1_REG — PLL_CPU Tuning1 Control Register
0x354 PLL_CPU_SSC_REG — PLL_CPU SSC Register
0x358 PLL_CPU_ECHO_REG — PLL_CPU Echo Register
0x500 AHB_CLK_REG — AHB Clock Register
0x510 APB0_CLK_REG — APB0 Clock Register
0x518 APB1_CLK_REG — APB1 Clock Register
0x538 APB_UART_CLK_REG — APB_UART Clock Register
0x588 MBUS_CLK_REG — MBUS Clock Register
0x5C0 AHB_MAT_CLK_GATE_EN_REG — AHB Master Clock Gate Enable Register
0x5D0 PERI_MAT_CLK_GATE_EN_REG — PERI Master Clock Gate Enable Register
0x5E0 MBUS_CLK_GATE_EN_REG — MBUS Clock Gate Enable Register
0x5E4 MBUS_MAT_CLK_GATE_EN_REG — MBUS Master Clock Gate Enable Register
0x5F0 AHB_MAT_CLK_AUTO_GATE_EN_REG — AHB Master Clock Auto Gate Enable Register
0x5F4 MBUS_MAT_CLK_AUTO_GATE_EN_REG — MBUS Master Clock Auto Gate Enable Register
0x5F8 AHB_MAT_CLK_GATE_STAT_REG — AHB Master Clock Gate Status Register
0x5FC MBUS_MAT_CLK_GATE_STAT_REG — MBUS Master Clock Gate Status Register
0x704 DMA0_GAR_REG — DMA0 Gating And Reset Register
0x70C DMA1_GAR_REG — DMA1 Gating And Reset Register
0x724 SPINLOCK_GAR_REG — SPINLOCK Gating And Reset Register
0x744 MSGBOX_CPUX_GAR_REG — MSGBOX_CPUX Gating And Reset Register
{0x74C+8i} MSGBOX_CORE{i}_GAR_REG (i=0..3) — MSGBOX_CORE{i} Gating And Reset Register
0x76C MSGBOX_MCU_GAR_REG — MSGBOX_MCU Gating And Reset Register
0x794 PWM2_GAR_REG — PWM2 Gating And Reset Register
0x7A4 DCU_GAR_REG — DCU Gating And Reset Register
0x7AC DAP_GAR_REG — DAP Gating And Reset Register
0x7C0 PWMCS0_CLK_REG — PWMCS0 Clock Register
0x7C4 PWMCS0_GAR_REG — PWMCS0 Gating And Reset Register
0x7C8 PWMCS1_CLK_REG — PWMCS1 Clock Register
0x7CC PWMCS1_GAR_REG — PWMCS1 Gating And Reset Register
{0x800+4i} TIMER0_CPUX_{i}_CLK_REG (i=0..7) — TIMER0_CPUX_{i} Clock Register
0x850 TIMER0_CPUX_GAR_REG — TIMER0_CPUX Gating And Reset Register
{0x860+4i} TIEMR0_MCU_{i}_CLK_REG (i=0..3) — TIEMR0_MCU_{i} Clock Register
0x870 TIMER0_MCU_GAR_REG — TIMER0_MCU Gating And Reset Register
0xA00 DE0_CLK_REG — DE0 Clock Register
0xA04 DE0_GAR_REG — DE0 Gating And Reset Register
0xA40 G2D_CLK_REG — G2D Clock Register
0xA44 G2D_GAR_REG — G2D Gating And Reset Register
0xAC0 CE_SYS_CLK_REG — CE_SYS Clock Register
0xAC4 CE_SYS_GAR_REG — CE_SYS Gating And Reset Register
0xB80 MCU_CORE_CLK_REG — MCU_CORE Clock Register
0xB88 MCU_TS_CLK_REG — MCU_TS Clock Register
0xB94 MCU_SYS_GAR_REG — MCU_SYS Gating And Reset Register
0xB9C MCU_CFG_GAR_REG — MCU_CFG Gating And Reset Register
0xC0C DRAMC_GAR_REG — DRAMC Gating And Reset Register
{0xD00+0x10*i} SMHC{i}_CLK_REG (i=0..3) — SMHC{i} Clock Register
{0xD0C+0x10*i} SMHC{i}_GAR_REG (i=0..3) — SMHC{i} Gating And Reset Register
{0xE00+4i} UART{i}_GAR_REG (i=0..6) — UART{i} Gating And Reset Register
{0xE04+4i} UART{i}_GAR_REG (i=7..9) — UART{i} Gating And Reset Register
{0xE80+4i} TWI{i}_GAR_REG (i=0..5) — TWI{i} Gating And Reset Register
{0xF00+8i} SPI{i}_CLK_REG (i=0..2) — SPI{i} Clock Register
{0xF04+8i} SPI{i}_GAR_REG (i=0..2) — SPI{i} Gating And Reset Register
0xF18 SPIF_CLK_REG — SPIF Clock Register
0xF1C SPIF_GAR_REG — SPIF Gating And Reset Register
0xF20 SPI3_CLK_REG — SPI3 Clock Register
0xF24 SPI3_GAR_REG — SPI3 Gating And Reset Register
0xF80 CAN0_CLK_REG — CAN0 Clock Register
0xF84 CAN0_GAR_REG — CAN0 Gating And Reset Register
0xF88 CAN1_CLK_REG — CAN1 Clock Register
0xF8C CAN1_GAR_REG — CAN1 Gating And Reset Register
0xFBC CAN_SYS_GAR_REG — CAN_SYS Gating And Reset Register
{0xFC0+8i} GPADC{i}_CLK_REG (i=0..2) — GPADC{i} Clock Register
{0xFC4+8i} GPADC{i}_GAR_REG (i=0..2) — GPADC{i} Gating And Reset Register
0xFD8 THS_ADC_CLK_REG — THS_ADC Clock Register
0xFDC THS_ADC_GAR_REG — THS_ADC Gating And Reset Register
0xFE4 THS_GAR_REG — THS Gating And Reset Register
0x1000 IR_RX0_CLK_REG — IR_RX0 Clock Register
0x1004 IR_RX0_GAR_REG — IR_RX0 Gating And Reset Register
0x1008 IR_TX_CLK_REG — IR_TX Clock Register
0x100C IR_TX_GAR_REG — IR_TX Gating And Reset Register
0x1030 TPADC_CLK_REG — TPADC Clock Register
0x1034 TPADC_GAR_REG — TPADC Gating And Reset Register
0x1040 LBC_CLK_REG — LBC Clock Register
0x104C LBC_GAR_REG — LBC Gating And Reset Register
{0x10F8+8i} IR_RX{i}_CLK_REG (i=1..3) — IR_RX{i} Clock Register
{0x10FC+8i} IR_RX{i}_GAR_REG (i=1..3) — IR_RX{i} Gating And Reset Register
{0x1200+0x10*i} I2S{i}_CLK_REG (i=0..2) — I2S{i} Clock Register
{0x120C+0x10*i} I2S{i}_GAR_REG (i=0..2) — I2S{i} Gating And Reset Register
0x1280 OWA0_TX_CLK_REG — OWA0 TX Clock Register
0x1284 OWA0_RX_CLK_REG — OWA0 RX Clock Register
0x128C OWA0_GAR_REG — OWA0 Gating And Reset Register
0x12C0 DMIC_CLK_REG — DMIC Clock Register
0x12CC DMIC_GAR_REG — DMIC Gating And Reset Register
0x12E0 AUDIOCODEC0_DAC_CLK_REG — AUDIOCODEC0 DAC Clock Register
0x12EC AUDIOCODEC0_GAR_REG — AUDIOCODEC0 Gating And Reset Register
0x1300 USB0_CLK_REG — USB0 Clock Register
0x1304 USB0_GAR_REG — USB0 Gating And Reset Register
0x1308 USB1_CLK_REG — USB1 Clock Register
0x130C USB1_GAR_REG — USB1 Gating And Reset Register
0x1340 USB2P0_SYS_PHY_REF_CLK_REG — USB2P0_SYS PHY Reference Clock Register
0x1344 USB2P0_SYS_GAR_REG — USB2P0_SYS Gating And Reset Register
{0x1400+0x10*i} GMAC{i}_PHY_CLK_REG (i=0..2) — GMAC{i} PHY Clock Register
{0x1404+0x10*i} GMAC{i}_PTP_REF_CLK_REG (i=0..2) — GMAC{i} PTP Reference Clock Register
{0x140C+0x10*i} GMAC{i}_GAR_REG (i=0..2) — GMAC{i} Gating And Reset Register
0x1500 TCON_LCD0_CLK_REG — TCON_LCD0 Clock Register
0x1504 TCON_LCD0_GAR_REG — TCON_LCD0 Gating And Reset Register
0x1544 LVDS0_GAR_REG — LVDS0 Gating And Reset Register
0x1580 MIPI_DSI0_CLK_REG — MIPI_DSI0 Clock Register
0x1584 MIPI_DSI0_GAR_REG — MIPI_DSI0 Gating And Reset Register
0x15C0 COMBOPHY0_CLK_REG — COMBOPHY0 Clock Register
0x16C4 VO0_REG_GAR_REG — VO0_REG Gating And Reset Register
0x16E4 VIDEO_OUT0_GAR_REG — VIDEO_OUT0 Gating And Reset Register
0x1700 LEDC_CLK_REG — LEDC Clock Register
0x1704 LEDC_GAR_REG — LEDC Gating And Reset Register
{0x1800+4i} CSI_MASTER{i}_CLK_REG (i=0..2) — CSI Master{i} Clock Register
0x1840 CSI_CLK_REG — CSI Clock Register
0x1860 ISP_CLK_REG — ISP Clock Register
0x1884 VIDEO_IN_GAR_REG — VIDEO_IN Gating And Reset Register
0x1908 PERI0PLL_GATE_EN_REG — PERI0PLL Gate Enable Register
0x190C PERI1PLL_GATE_EN_REG — PERI1PLL Gate Enable Register
0x1910 VIDEOPLL_GATE_EN_REG — VIDEOPLL Gate Enable Register
0x191C AUDIOPLL_GATE_EN_REG — AUDIOPLL Gate Enable Register
0x1988 PERI0PLL_GATE_STAT_REG — PERI0PLL Gate Status Register
0x198C PERI1PLL_GATE_STAT_REG — PERI1PLL Gate Status Register
0x1990 VIDEOPLL_GATE_STAT_REG — VIDEOPLL Gate Status Register
0x199C AUDIOPLL_GATE_STAT_REG — AUDIOPLL Gate Status Register
0x1A20 PLL_OPG_BYPASS_REG — PLL Output Gate Bypass Register
0x1C00 AXI_MON_GAR_REG — AXI MON Gating And Reset Register
0x1C04 AHB_MON_GAR_REG — AHB MON Gating And Reset Register
0x1F00 CCU_SEC_SWITCH_REG — CCU Security Switch Register
0x1F10 DAP_REQ_CTRL_REG — DAP REQ Control Register
{0x1F20+4i} PLL_CFG{i}_REG (i=0..2) — PLL Configuration{i} Register
0x1F30 CCU_FAN_GATE_REG — CCU Fanout Clock Gate Register
0x1F34 CLK27M_FAN_REG — CLK27M Fanout Register
0x1F38 CLK_FAN_REG — CLK Fanout Register
0x1F3C CCU_FAN_REG — CCU Fanout Register
0x1F50 CLK_DBG_REG — Clock Debug Register
0x1F60 FRE_DET_CTRL_REG — Frequency Detect Control Register
0x1F64 FRE_UP_LIM_REG — Frequency Up Limit Register
0x1F68 FRE_DOWN_LIM_REG — Frequency Down Limit Register
