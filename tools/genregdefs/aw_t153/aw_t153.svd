# aw_t153 register map
File version: 1.00
for test
Registers are 32-bit, read-write, reset 0x0 unless marked. A register's access mark holds for its fields unless they carry their own. Offsets are from the block's base; lines under a group give offsets from that group; [hi:lo] are bit positions; {n}, {i} and the like mark numbered series; 'fields as' and 'values as' point back to an identical list; <NAME> marks a mode.

## Memory map
0x02002000 CCU — Clock Controller Unit (CCU)
0x02510000 TWI0 — Two Wire Interface (TWI)
0x02511000 TWI1
0x02512000 TWI2
0x02513000 TWI3
0x02514000 TWI4
0x02515000 TWI5
{0x2600000+0x10000*n} UART{n} (n=0..9)
0x03006000 SID — Security ID
0x03604080 GPIOA — Port Controller
0x03604100 GPIOB
0x03604180 GPIOC
0x03604200 GPIOD
0x03604280 GPIOE
0x03604300 GPIOF
0x03604380 GPIOG
0x03604500 GPIOJ
0x03604580 GPIOK
0x04025000 SPI0 — Serial Peripheral Interface
0x04026000 SPI1
0x04027000 SPI2
0x04028000 SPI3
0x04508000 GAMC0_TOP
0x04518000 GAMC1_TOP
0x04528000 GAMC2_TOP
0x07010000 PRCM

## Interrupts
34 UART0 (UART{n} (n=0..9))
35 UART1 (UART{n} (n=0..9))
36 UART2 (UART{n} (n=0..9))
37 UART3 (UART{n} (n=0..9))
38 UART4 (UART{n} (n=0..9))
39 UART5 (UART{n} (n=0..9))
40 UART6 (UART{n} (n=0..9))
41 UART7 (UART{n} (n=0..9))
42 TWI0 (TWI{n} (n=0..5))
43 TWI1 (TWI{n} (n=0..5))
44 TWI2 (TWI{n} (n=0..5))
45 TWI3 (TWI{n} (n=0..5))
46 TWI4 (TWI{n} (n=0..5))
47 TWI5 (TWI{n} (n=0..5))
48 SPI0 (SPI{n} (n=0..3))
49 SPI1 (SPI{n} (n=0..3))
50 SPI2 (SPI{n} (n=0..3))
53 SPI3 (SPI{n} (n=0..3))
78 GMAC0_TOP (GAMC{n}_TOP (n=0..2))
79 GMAC1_TOP (GAMC{n}_TOP (n=0..2))
133 GMAC2_TOP (GAMC{n}_TOP (n=0..2))
180 UART8 (UART{n} (n=0..9))
181 UART9 (UART{n} (n=0..9))

## GAMC0_TOP
Base 0x04508000
Same registers: GAMC1_TOP 0x04518000, GAMC2_TOP 0x04528000
0x00 GMAC_CFG_REG — GMAC Config Register
0x40 GMAC_PTP_TIMESTAMP_LOW_REG — GMAC PTP Timestamp Low Register
0x48 GMAC_PTP_TIMESTAMP_HIGH_REG — GMAC PTP Timestamp High Register
0x4C GMAC_STAT_INT_REG — GMAC Low Power Interrupt Status Register
0x80 GMAC_CLK_GATE_CFG_REG — GMAC Clock Gate Config Register

## GPIOA — Port Controller
Base 0x03604080
Same registers: GPIOB 0x03604100, GPIOC 0x03604180, GPIOD 0x03604200, GPIOE 0x03604280, GPIOF 0x03604300, GPIOG 0x03604380, GPIOJ 0x03604500, GPIOK 0x03604580
{0x0+0x10*i} CFG[{i}] (i=0..3) — Configure Register
0x10 DATA
0x14 DATA_SET
0x18 DATA_CLR — Data Clear Register
{0x20+8i} DRV[{i}] (i=0..1) — Multi_Driving Register
{0x30+8i} PULL[{i}] (i=0..1)
{0x40+0x10*i} INT_CFG[{i}] (i=0..3) — External Interrupt Configure Register
0x50 INT_CTL — External Interrupt Control Register
0x54 INT_STA — External Interrupt Status Register
0x58 INT_DEB — External Debounce Configure Register
0x70 SECURE — SECURE Configure Register

## PRCM
Base 0x07010000
0x00 AHBS_CLK_REG — AHBS Clock Register
0x0C APBS0_CLK_REG — APBS0 Clock Register
0x12C TWD_BGR_REG — TWD Bus Gating Reset Register
0x20C RTC_BGR_REG — RTC Bus Gating Reset Register
0x22C CPUIDLE_BGR_REG — CPUIDLE Bus Gating Reset Register
0x240 PRCM_PLL_CTRL_REG0 — PRCM PLL Control Register 0
0x244 PRCM_PLL_CTRL_REG1 — PRCM PLL Control Register 1
0x254 ANA_PWR_RST_REG — ANALOG Power Off Gating Register
0x260 VDD_SYS_PWR_RST_REG — VDD_SYS Power Domain Reset Register
0x270 RAMP2P_CFG_REG — RAMP2P Configuration Register
0x274 RAM2P_CFG_REG — RAM2P Configuration Register
0x278 RAMSP_CFG_REG — RAMSP Configuration Register
0x27C ROM_CFG_REG — ROM Configuration Register
0x290 PRCM_SEC_SWITCH_REG — PRCM Security Switch Register
0x320 NMI_INT_CTRL_REG — NMI Interrupt Control Register
0x324 NMI_INT_EN_REG — NMI Interrupt Enable Register
0x328 NMI_INT_PEND_REG — NMI Interrupt Pending Register
0x33C BUS_ACG_REG — Bus Auto Clock Gating Register
0x378 AHBS_RDY_TOUT_CTRL_REG — AHBS Ready Timeout Control Register

## SID — Security ID
Base 0x03006000
0x40 SID_PRCTL
0x60 SID_RDKEY
{0x200+0x400*i} SID_DATA[{i}] (i=0..255) — SID data (xfel display as 'sid' replay)

## Notices in the file
Copyright (c) 2024 by Genadi V. Zawidowski. All rights reserved.
