# aw_t113s3 register map
File version: 1.00
Registers are 32-bit, read-write, reset 0x0 unless marked. A register's access mark holds for its fields unless they carry their own. Offsets are from the block's base; [hi:lo] are bit positions; {n}, {i} and the like mark numbered series.

## CCU — Clock Controller Unit (CCU)
Base 0x02001000
0x00 PLL_CPU_CTRL_REG — PLL_CPU Control Register
0x10 PLL_DDR_CTRL_REG — PLL_DDR Control Register
0x20 PLL_PERI_CTRL_REG — PLL_PERI Control Register
0x40 PLL_VIDEO0_CTRL_REG — PLL_VIDEO0 Control Register
0x48 PLL_VIDEO1_CTRL_REG — PLL_VIDEO1 Control Register
0x58 PLL_VE_CTRL_REG — PLL_VE Control Register
0x78 PLL_AUDIO0_CTRL_REG — PLL_AUDIO0 Control Register
0x80 PLL_AUDIO1_CTRL_REG — PLL_AUDIO1 Control Register
0x110 PLL_DDR_PAT0_CTRL_REG — PLL_DDR Pattern0 Control Register
0x114 PLL_DDR_PAT1_CTRL_REG — PLL_DDR Pattern1 Control Register
0x120 PLL_PERI_PAT0_CTRL_REG — PLL_PERI Pattern0 Control Register
0x124 PLL_PERI_PAT1_CTRL_REG — PLL_PERI Pattern1 Control Register
0x140 PLL_VIDEO0_PAT0_CTRL_REG — PLL_VIDEO0 Pattern0 Control Register
0x144 PLL_VIDEO0_PAT1_CTRL_REG — PLL_VIDEO0 Pattern1 Control Register
0x148 PLL_VIDEO1_PAT0_CTRL_REG — PLL_VIDEO1 Pattern0 Control Register
0x14C PLL_VIDEO1_PAT1_CTRL_REG — PLL_VIDEO1 Pattern1 Control Register
0x158 PLL_VE_PAT0_CTRL_REG — PLL_VE Pattern0 Control Register
0x15C PLL_VE_PAT1_CTRL_REG — PLL_VE Pattern1 Control Register
0x178 PLL_AUDIO0_PAT0_CTRL_REG — PLL_AUDIO0 Pattern0 Control Register
0x17C PLL_AUDIO0_PAT1_CTRL_REG — PLL_AUDIO0 Pattern1 Control Register
0x180 PLL_AUDIO1_PAT0_CTRL_REG — PLL_AUDIO1 Pattern0 Control Register
0x184 PLL_AUDIO1_PAT1_CTRL_REG — PLL_AUDIO1 Pattern1 Control Register
0x300 PLL_CPU_BIAS_REG — PLL_CPU Bias Register
0x310 PLL_DDR_BIAS_REG — PLL_DDR Bias Register
0x320 PLL_PERI_BIAS_REG — PLL_PERI Bias Register
0x340 PLL_VIDEO0_BIAS_REG — PLL_VIDEO0 Bias Register
0x348 PLL_VIDEO1_BIAS_REG — PLL_VIDEO1 Bias Register
0x358 PLL_VE_BIAS_REG — PLL_VE Bias Register
0x378 PLL_AUDIO0_BIAS_REG — PLL_AUDIO0 Bias Register
0x380 PLL_AUDIO1_BIAS_REG — PLL_AUDIO1 Bias Register
0x400 PLL_CPU_TUN_REG — PLL_CPU Tuning Register
0x500 CPU_AXI_CFG_REG — CPU_AXI Configuration Register
0x504 CPU_GATING_REG — CPU_GATING Configuration Register
0x510 PSI_CLK_REG — PSI Clock Register
0x520 APB0_CLK_REG — APB0 Clock Register
0x524 APB1_CLK_REG — APB1 Clock Register
0x540 MBUS_CLK_REG — MBUS Clock Register
0x600 DE_CLK_REG — DE Clock Register
0x60C DE_BGR_REG — DE Bus Gating Reset Register
0x620 DI_CLK_REG — DI Clock Register
0x62C DI_BGR_REG — DI Bus Gating Reset Register
0x630 G2D_CLK_REG — G2D Clock Register
0x63C G2D_BGR_REG — G2D Bus Gating Reset Register
0x680 CE_CLK_REG — CE Clock Register
0x68C CE_BGR_REG — CE Bus Gating Reset Register
0x690 VE_CLK_REG — VE Clock Register
0x69C VE_BGR_REG — VE Bus Gating Reset Register
0x70C DMA_BGR_REG — DMA Bus Gating Reset Register
0x71C MSGBOX_BGR_REG — MSGBOX Bus Gating Reset Register
0x72C SPINLOCK_BGR_REG — SPINLOCK Bus Gating Reset Register
0x73C HSTIMER_BGR_REG — HSTIMER Bus Gating Reset Register
0x740 AVS_CLK_REG — AVS Clock Register
0x78C DBGSYS_BGR_REG — DBGSYS Bus Gating Reset Register
0x7AC PWM_BGR_REG — PWM Bus Gating Reset Register
0x7BC IOMMU_BGR_REG — IOMMU Bus Gating Reset Register
0x800 DRAM_CLK_REG — DRAM Clock Register
0x804 MBUS_MAT_CLK_GATING_REG — MBUS Master Clock Gating Register
0x80C DRAM_BGR_REG — DRAM Bus Gating Reset Register
{0x830+4i} SMHC{i}_CLK_REG (i=0..2) — SMHC{i} Clock Register
0x84C SMHC_BGR_REG — SMHC Bus Gating Reset Register
0x90C UART_BGR_REG — UART Bus Gating Reset Register
0x91C TWI_BGR_REG — TWI Bus Gating Reset Register
0x92C CAN_BGR_REG — CAN Bus Gating Reset Register
0x940 SPI0_CLK_REG — SPI0 Clock Register
0x944 SPI1_CLK_REG — SPI1 Clock Register
0x96C SPI_BGR_REG — SPI Bus Gating Reset Register
0x970 EMAC_25M_CLK_REG — EMAC_25M Clock Register
0x97C EMAC_BGR_REG — EMAC Bus Gating Reset Register
0x9C0 IRTX_CLK_REG — IRTX Clock Register
0x9CC IRTX_BGR_REG — IRTX Bus Gating Reset Register
0x9EC GPADC_BGR_REG — GPADC Bus Gating Reset Register
0x9FC THS_BGR_REG — THS Bus Gating Reset Register
0xA14 I2S1_CLK_REG — I2S1 Clock Register
0xA18 I2S2_CLK_REG — I2S2 Clock Register
0xA1C I2S2_ASRC_CLK_REG — I2S2_ASRC Clock Register
0xA20 I2S_BGR_REG — I2S Bus Gating Reset Register
0xA24 OWA_TX_CLK_REG — OWA_TX Clock Register
0xA2C OWA_BGR_REG — OWA Bus Gating Reset Register
0xA40 DMIC_CLK_REG — DMIC Clock Register
0xA4C DMIC_BGR_REG — DMIC Bus Gating Reset Register
0xA50 AUDIO_CODEC_DAC_CLK_REG — AUDIO_CODEC_DAC Clock Register
0xA54 AUDIO_CODEC_ADC_CLK_REG — AUDIO_CODEC_ADC Clock Register
0xA5C AUDIO_CODEC_BGR_REG — AUDIO_CODEC Bus Gating Reset Register
0xA70 USB0_CLK_REG — USB0 Clock Register
0xA74 USB1_CLK_REG — USB1 Clock Register
0xA8C USB_BGR_REG — USB Bus Gating Reset Register
0xABC DPSS_TOP_BGR_REG — DPSS_TOP Bus Gating Reset Register
0xB24 DSI_CLK_REG — DSI Clock Register
0xB4C DSI_BGR_REG — DSI Bus Gating Reset Register
0xB60 TCONLCD_CLK_REG — TCONLCD Clock Register
0xB7C TCONLCD_BGR_REG — TCONLCD Bus Gating Reset Register
0xB80 TCONTV_CLK_REG — TCONTV Clock Register
0xB9C TCONTV_BGR_REG — TCONTV Bus Gating Reset Register
0xBAC LVDS_BGR_REG — LVDS Bus Gating Reset Register
0xBB0 TVE_CLK_REG — TVE Clock Register
0xBBC TVE_BGR_REG — TVE Bus Gating Reset Register
0xBC0 TVD_CLK_REG — TVD Clock Register
0xBDC TVD_BGR_REG — TVD Bus Gating Reset Register
0xBF0 LEDC_CLK_REG — LEDC Clock Register
0xBFC LEDC_BGR_REG — LEDC Bus Gating Reset Register
0xC04 CSI_CLK_REG — CSI Clock Register
0xC08 CSI_MASTER_CLK_REG — CSI Master Clock Register
0xC1C CSI_BGR_REG — CSI Bus Gating Reset Register
0xC50 TPADC_CLK_REG — TPADC Clock Register
0xC5C TPADC_BGR_REG — TPADC Bus Gating Reset Register
0xC70 DSP_CLK_REG — DSP Clock Register
0xC7C DSP_BGR_REG — DSP Bus Gating Reset Register
0xD00 RISC_CLK_REG — RISC Clock Register
0xD04 RISC_GATING_REG — RISC Gating Configuration Register
0xD0C RISC_CFG_BGR_REG — RISC_CFG Bus Gating Reset Register
0xF04 PLL_LOCK_DBG_CTRL_REG — PLL Lock Debug Control Register
0xF08 FRE_DET_CTRL_REG — Frequency Detect Control Register
0xF0C FRE_UP_LIM_REG — Frequency Up Limit Register
0xF10 FRE_DOWN_LIM_REG — Frequency Down Limit Register
0xF20 RISC_RST_REG — RISC LOCK RESET Register
0xF30 CCU_FAN_GATE_REG — CCU FANOUT CLOCK GATE Register
0xF34 CLK27M_FAN_REG — CLK27M FANOUT Register
0xF38 PCLK_FAN_REG — PCLK FANOUT Register
0xF3C CCU_FAN_REG — CCU FANOUT Register
