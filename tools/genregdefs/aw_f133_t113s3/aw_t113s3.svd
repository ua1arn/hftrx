# aw_t113s3 register map
File version: 1.00
Registers are 32-bit, read-write, reset 0x0 unless marked. A register's access mark holds for its fields unless they carry their own. Offsets are from the block's base; [hi:lo] are bit positions; lines under a group give offsets from that group; {n}, {i} and the like mark numbered series.

## SPINLOCK — Spin Lock module
Base 0x03005000
0x00 SPINLOCK_SYSTATUS_REG — Spinlock System Status Register
0x10 SPINLOCK_STATUS_REG — Spinlock Status Register
0x20 SPINLOCK_IRQ_EN_REG — Spinlock Interrupt Enable Register
0x40 SPINLOCK_IRQ_STA_REG — Spinlock Interrupt Status Register
{0x80+4i} SPINLOCK_LOCKID{i}_REG (i=0..4) — Spinlock Lockid{i} Register
{0x100+0x80*i} SPINLOCK_LOCK_REG[{i}] (i=0..31) — Spinlock Register N (N = 0 to 31)

## SYS_CFG
Base 0x03000000
0x08 DSP_BOOT_RAMMAP_REG — DSP Boot SRAM Remap Control Register
0x24 VER_REG — Version Register
0x30 EMAC_EPHY_CLK_REG0 — EMAC-EPHY Clock Register 0
0x150 SYS_LDO_CTRL_REG — System LDO Control Register
0x160 RESCAL_CTRL_REG — Resistor Calibration Control Register
0x168 RES240_CTRL_REG — 240ohms Resistor Manual Control Register
0x16C RESCAL_STATUS_REG — Resistor Calibration Status Register
0x21C SYS_LDOB_SID
0x228 SYS_EFUSE_REG

## TCON_LCD0 — Timing Controller_LCD (TCON_LCD)
Base 0x05461000
0x00 LCD_GCTL_REG — LCD Global Control Register
0x04 LCD_GINT0_REG — LCD Global Interrupt Register0
0x08 LCD_GINT1_REG — LCD Global Interrupt Register1
0x10 LCD_FRM_CTL_REG — LCD FRM Control Register
{0x14+0x18*i} LCD_FRM_SEED_REG[{i}] (i=0..5) — LCD FRM Seed Register (N=0,1,2,3,4,5)
{0x2C+0x10*i} LCD_FRM_TAB_REG[{i}] (i=0..3) — LCD FRM Table Register (N=0,1,2,3)
0x3C LCD_3D_FIFO_REG — LCD 3D FIFO Register
0x40 LCD_CTL_REG — LCD Control Register
0x44 LCD_DCLK_REG — LCD Data Clock Register
{0x48+4i} LCD_BASIC{i}_REG (i=0..3) — LCD Basic Timing Register{i}
0x58 LCD_HV_IF_REG — LCD HV Panel Interface Register
0x60 LCD_CPU_IF_REG — LCD CPU Panel Interface Register
0x64 LCD_CPU_WR_REG — LCD CPU Panel Write Data Register
0x68 LCD_CPU_RD0_REG — LCD CPU Panel Read Data Register0
0x6C LCD_CPU_RD1_REG — LCD CPU Panel Read Data Register1
0x84 LCD_LVDS_IF_REG — LCD LVDS Configure Register
0x88 LCD_IO_POL_REG — LCD IO Polarity Register
0x8C LCD_IO_TRI_REG — LCD IO Control Register
0xFC LCD_DEBUG_REG — LCD Debug Register
0x100 LCD_CEU_CTL_REG — LCD CEU Control Register
{0x110+0xC*i} LCD_CEU_COEF_MUL_REG[{i}] (i=0..2) — LCD CEU Coefficient Register0 0x0110+N*0x04 (N=0..10) N=0: Rr, N=1: Rg, N=2: Rb, N=4: Gr, N=5: Gg, N=6: Gb, N=8: Br, N=9: Bg, N=10: Bb
0x11C LCD_CEU_COEF_ADD0_REG — LCD CEU Coefficient Register1 0x011C+N*0x10 (N=0,1,2) N=0: Rc, N=1: Gc, N=2: Bc
0x12C LCD_CEU_COEF_ADD1_REG — LCD CEU Coefficient Register1 0x011C+N*0x10 (N=0,1,2)
0x13C LCD_CEU_COEF_ADD2_REG — LCD CEU Coefficient Register1 0x011C+N*0x10 (N=0,1,2)
{0x140+0xC*i} LCD_CEU_COEF_RANG_REG[{i}] (i=0..2) — LCD CEU Coefficient Register2 0x0140+N*0x04 (N=0,1,2)
{0x160+0x18*i} LCD_CPU_TRIx_REG[{i}] (i=0..5) — LCD CPU Panel Trigger Register0
0x180 LCD_CMAP_CTL_REG — LCD Color Map Control Register
0x190 LCD_CMAP_ODD0_REG — LCD Color Map Odd Line Register0
0x194 LCD_CMAP_ODD1_REG — LCD Color Map Odd Line Register1
0x198 LCD_CMAP_EVEN0_REG — LCD Color Map Even Line Register0
0x19C LCD_CMAP_EVEN1_REG — LCD Color Map Even Line Register1
0x1F0 LCD_SAFE_PERIOD_REG — LCD Safe Period Register
{0x220+8i} LCD_LVDS_ANA_REG[{i}] (i=0..1) — LCD LVDS Analog Register N
0x230 LCD_SYNC_CTL_REG — LCD Sync Control Register
0x234 LCD_SYNC_POS_REG — LCD Sync Position Register
0x238 LCD_SLAVE_STOP_POS_REG — LCD Slave Stop Position Register
{0x400+0x400*i} LCD_GAMMA_TABLE_REG[{i}] (i=0..255) — LCD Gamma Table Register

## TCON_TV0
Base 0x05470000
0x00 TV_GCTL_REG — TV Global Control Register
0x04 TV_GINT0_REG — TV Global Interrupt Register0
0x08 TV_GINT1_REG — TV Global Interrupt Register1
0x40 TV_SRC_CTL_REG — TV Source Control Register
0x90 TV_CTL_REG — TV Control Register
{0x94+4i} TV_BASIC{i}_REG (i=0..5) — TV Basic Timing Register{i}
0xB8 TV_IO_POL_REG — TV SYNC Signal Polarity Register was: 0x0088
0xBC TV_IO_TRI_REG — TV SYNC Signal IO Control Register was: 0x008C
0xFC TV_DEBUG_REG — TV Debug Register
0x100 TV_CEU_CTL_REG — TV CEU Control Register
{0x110+0x2C*i} TV_CEU_COEF_MUL_REG[{i}] (i=0..10) — TV CEU Coefficient Register0 0x0110+N*0x04(N=0-10)
{0x140+0xC*i} TV_CEU_COEF_RANG_REG[{i}] (i=0..2) — TV CEU Coefficient Register2 0x0140+N*0x04(N=0-2)
0x1F0 TV_SAFE_PERIOD_REG — TV Safe Period Register
0x300 TV_FILL_CTL_REG — TV Fill Data Control Register
{0x304+0x24*i} unnamed[{i}] (i=0..2) group
  0x00 TV_FILL_BEGIN_REG — TV Fill Data Begin Register 0x0304+N*0x0C(N=0–2)
  0x04 TV_FILL_END_REG — TV Fill Data End Register 0x0308+N*0x0C(N=0–2)
  0x08 TV_FILL_DATA_REG — TV Fill Data Value Register 0x030C+N*0x0C(N=0–2)
0x330 TV_DATA_IO_POL0_REG — TCON Data IO Polarity Control0
0x334 TV_DATA_IO_POL1_REG — TCON Data IO Polarity Control1
0x338 TV_DATA_IO_TRI0_REG — TCON Data IO Enable Control0
0x33C TV_DATA_IO_TRI1_REG — TCON Data IO Enable Control1
0x340 TV_PIXELDEPTH_MODE_REG — TV Pixeldepth Mode Control Register
