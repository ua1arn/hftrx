# aw_t113s3 register map
File version: 1.00
Registers are 32-bit, read-write, reset 0x0 unless marked. A register's access mark holds for its fields unless they carry their own. Offsets are from the block's base; [hi:lo] are bit positions; {n}, {i} and the like mark numbered series.

## USBPHY0
Base 0x04100400
Same registers: USBPHY1 0x04200800
0x00 USB_CTRL — HCI Interface Register (HCI_Interface)
0x04 USBPHY_PHYCTL
0x08 HCI_CTRL3 — HCI Control 3 Register (bist)
0x10 PHY_CTRL — PHY Control Register (PHY_Control)
0x20 PHY_OTGCTL — Control PHY routing to EHCI or OTG
0x24 PHY_STATUS
0x28 USB_SPDCR — HCI SIE Port Disable Control Register

## USBEHCI0
Base 0x04101000
Same registers: USBEHCI1 0x04200000
0x00 HCCAPBASE — EHCI Capability Register (HCIVERSION and CAPLENGTH) register
0x04 HCSPARAMS — EHCI Host Control Structural Parameter Register
0x08 HCCPARAMS — EHCI Host Control Capability Parameter Register
0x0C HCSPPORTROUTE — EHCI Companion Port Route Description
0x10 USBCMD — EHCI USB Command Register
0x14 USBSTS — EHCI USB Status Register
0x18 USBINTR — EHCI USB Interrupt Enable Register
0x1C FRINDEX — EHCI USB Frame Index Register
0x20 CTRLDSSEGMENT — EHCI 4G Segment Selector Register
0x24 PERIODICLISTBASE — EHCI Frame List Base Address Register
0x28 ASYNCLISTADDR — EHCI Next Asynchronous List Address Register

## USBOHCI0
Base 0x04101400
Same registers: USBOHCI1 0x04200400
0x00 O_HcRevision — OHCI Revision Register (not documented)
0x04 O_HcControl — OHCI Control Register
0x08 O_HcCommandStatus — OHCI Command Status Register
0x0C O_HcInterruptStatus — OHCI Interrupt Status Register
0x10 O_HcInterruptEnable — OHCI Interrupt Enable Register
0x14 O_HcInterruptDisable — OHCI Interrupt Disable Register
0x18 O_HcHCCA — OHCI HCCA Base
0x1C O_HcPeriodCurrentED — OHCI Period Current ED Base
0x20 O_HcControlHeadED — OHCI Control Head ED Base
0x24 O_HcControlCurrentED — OHCI Control Current ED Base
0x28 O_HcBulkHeadED — OHCI Bulk Head ED Base
0x2C O_HcBulkCurrentED — OHCI Bulk Current ED Base
0x30 O_HcDoneHead — OHCI Done Head Base
0x34 O_HcFmInterval — OHCI Frame Interval Register
0x38 O_HcFmRemaining — OHCI Frame Remaining Register
0x3C O_HcFmNumber — OHCI Frame Number Register
0x40 O_HcPerioddicStart — OHCI Periodic Start Register
0x44 O_HcLSThreshold — OHCI LS Threshold Register
0x48 O_HcRhDescriptorA — OHCI Root Hub Descriptor Register A
0x4C O_HcRhDesriptorB — OHCI Root Hub Descriptor Register B
0x50 O_HcRhStatus — OHCI Root Hub Status Register
{0x54+4i} O_HcRhPortStatus[{i}] (i=0..0) — OHCI Root Hub Port Status Register

## VENCODER — Video Encoding
Base 0x01C0E000
0x00 VE_CTRL
0xF0 VE_VERSION
0x100 VE_MPEG_PIC_HDR
0x108 VE_MPEG_SIZE
0x10C VE_MPEG_FRAME_SIZE
0x114 VE_MPEG_CTRL
0x118 VE_MPEG_TRIGGER
0x11C VE_MPEG_STATUS
0x128 VE_MPEG_VLD_ADDR
0x12C VE_MPEG_VLD_OFFSET
0x130 VE_MPEG_VLD_LEN
0x134 VE_MPEG_VLD_END
0x148 VE_MPEG_REC_LUMA
0x14C VE_MPEG_REC_CHROMA
0x150 VE_MPEG_FWD_LUMA
0x154 VE_MPEG_FWD_CHROMA
0x158 VE_MPEG_BACK_LUMA
0x15C VE_MPEG_BACK_CHROMA
0x180 VE_MPEG_IQ_MIN_INPUT
0x1B8 VE_MPEG_JPEG_SIZE
0x1C0 VE_MPEG_JPEG_RES_INT
0x1CC VE_MPEG_ROT_LUMA
0x1D0 VE_MPEG_ROT_CHROMA
0x1D4 VE_MPEG_SDROT_CTRL
0x1E0 VE_MPEG_RAM_WRITE_PTR
0x1E4 VE_MPEG_RAM_WRITE_DATA
0x200 VE_H264_FRAME_SIZE
0x204 VE_H264_PIC_HDR
0x208 VE_H264_SLICE_HDR
0x20C VE_H264_SLICE_HDR2
0x210 VE_H264_PRED_WEIGHT
0x21C VE_H264_QP_PARAM
0x220 VE_H264_CTRL
0x224 VE_H264_TRIGGER
0x228 VE_H264_STATUS
0x22C VE_H264_CUR_MB_NUM
0x230 VE_H264_VLD_ADDR
0x234 VE_H264_VLD_OFFSET
0x238 VE_H264_VLD_LEN
0x23C VE_H264_VLD_END
0x240 VE_H264_SDROT_CTRL
0x24C VE_H264_OUTPUT_FRAME_IDX
0x250 VE_H264_EXTRA_BUFFER1
0x254 VE_H264_EXTRA_BUFFER2
0x2DC VE_H264_BASIC_BITS
0x2E0 VE_H264_RAM_WRITE_PTR
0x2E4 VE_H264_RAM_WRITE_DATA
0x400 VE_SRAM_H264_FRAMEBUFFER_LIST
0x640 VE_SRAM_H264_REF_LIST0
0x664 VE_SRAM_H264_REF_LIST1
0x800 VE_SRAM_H264_SCALING_LISTS
0xA00 VE_ISP_PIC_SIZE
0xA04 VE_ISP_PIC_STRIDE
0xA08 VE_ISP_CTRL
0xA78 VE_ISP_PIC_LUMA
0xA7C VE_ISP_PIC_CHROMA
0xB04 VE_AVC_PARAM
0xB08 VE_AVC_QP
0xB10 VE_AVC_MOTION_EST
0xB14 VE_AVC_CTRL
0xB18 VE_AVC_TRIGGER
0xB1C VE_AVC_STATUS
0xB20 VE_AVC_BASIC_BITS
0xB80 VE_AVC_VLE_ADDR
0xB84 VE_AVC_VLE_END
0xB88 VE_AVC_VLE_OFFSET
0xB8C VE_AVC_VLE_MAX
0xB90 VE_AVC_VLE_LENGTH
0xBA0 VE_AVC_REF_LUMA
0xBA4 VE_AVC_REF_CHROMA
0xBB0 VE_AVC_REC_LUMA
0xBB4 VE_AVC_REC_CHROMA
0xBB8 VE_AVC_REF_SLUMA
0xBBC VE_AVC_REC_SLUMA
0xBC0 VE_AVC_MB_INFO
0xBE0 VE_AVC_SDRAM_INDEX
0xBE4 VE_AVC_SDRAM_DATA
