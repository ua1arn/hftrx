# aw_t113s3 register map
File version: 1.00
Registers are 32-bit, read-write, reset 0x0 unless marked. A register's access mark holds for its fields unless they carry their own. Offsets are from the block's base; [hi:lo] are bit positions; {n}, {i} and the like mark numbered series.

## R_CCU
Base 0x07010000
Same registers: R_PRCM 0x07010000
0x250 VDD_SYS_PWROFF_GATING_REG
0x254 ANALOG_PWROFF_GATING_REG

## R_CPUCFG
Base 0x07000400
0x00 REGxx — Bit 31 and bit 0 R/W, bit 0 can be related to RISC-C vore
0x1C0 HOTPLUGFLAG — The Hotplug Flag Register is 0x070005C0.
{0x1C4+0x10*i} SOFTENTRY[{i}] (i=0..3) — The Soft Entry Address Register of CPUx (x=0..1)
0x1D4 SUP_STAN_FLAG — Super Standby Flag (bit 16)
0x1DC RV_HOTPLUGFLAG — RV The Hotplug Flag Register (key value 0xFA50392F)
{0x1E0+0x10*i} RC_SOFTENTRY[{i}] (i=0..3) — RV The Soft Entry Address Register

## SID — Security ID
Base 0x03006000
{0x0+4i} SID_RKEY{i} (i=0..3) — Securiy root key[{32i+31}:{32i}]
0x14 SID_THS — [27:16]: The calibration value of the T-sensor.
{0x200+0x10*i} SID_DATA[{i}] (i=0..3) — SID data (xfel display as 'sid' replay)
0x210 BOOT_MODE — [27:16]: eFUSE boot select status, [0]: 0: GPIO boot select, 1: eFuse boot select
{0x214+0x7EC*i} SID_UNDOC[{i}] (i=0..506)

## SMHC0 — SD-MMC Host Controller
Base 0x04020000
Same registers: SMHC1 0x04021000, SMHC2 0x04022000
0x00 SMHC_CTRL — Control Register
0x04 SMHC_CLKDIV — Clock Control Register
0x08 SMHC_TMOUT — Time Out Register
0x0C SMHC_CTYPE — Bus Width Register
0x10 SMHC_BLKSIZ — Block Size Register
0x14 SMHC_BYTCNT — Byte Count Register
0x18 SMHC_CMD — Command Register
0x1C SMHC_CMDARG — Command Argument Register
{0x20+4i} SMHC_RESP{i} (i=0..3) — Response {i} Register
0x30 SMHC_INTMASK — Interrupt Mask Register
0x34 SMHC_MINTSTS — Masked Interrupt Status Register
0x38 SMHC_RINTSTS — Raw Interrupt Status Register
0x3C SMHC_STATUS — Status Register
0x40 SMHC_FIFOTH — FIFO Water Level Register
0x44 SMHC_FUNS — FIFO Function Select Register
0x48 SMHC_TCBCNT — Transferred Byte Count between Controller and Card
0x4C SMHC_TBBCNT — Transferred Byte Count between Host Memory and Internal FIFO
0x50 SMHC_DBGC — Current Debug Control Register
0x54 SMHC_CSDC — CRC Status Detect Control Registers
0x58 SMHC_A12A — Auto Command 12 Argument Register
0x5C SMHC_NTSR — SD New Timing Set Register
0x78 SMHC_HWRST — Hardware Reset Register
0x80 SMHC_IDMAC — IDMAC Control Register
0x84 SMHC_DLBA — Descriptor List Base Address Register
0x88 SMHC_IDST — IDMAC Status Register
0x8C SMHC_IDIE — IDMAC Interrupt Enable Register
0x100 SMHC_THLD — Card Threshold Control Register
0x104 SMHC_SFC — Sample FIFO Control Register
0x108 SMHC_A23A — Auto Command 23 Argument Register
0x10C EMMC_DDR_SBIT_DET — eMMC4.5 DDR Start Bit Detection Control Register
0x138 SMHC_EXT_CMD — Extended Command Register
0x13C SMHC_EXT_RESP — Extended Response Register
0x140 SMHC_DRV_DL — Drive Delay Control Register
0x144 SMHC_SAMP_DL — Sample Delay Control Register
0x148 SMHC_DS_DL — Data Strobe Delay Control Register
0x14C SMHC_HS400_DL — HS400 Delay Control Register
0x200 SMHC_FIFO — Read/Write FIFO

## SPI0 — Serial Peripheral Interface
Base 0x04025000
Same registers: SPI1 0x04026000, SPI_DBI 0x04026000
0x04 SPI_GCR — SPI Global Control Register
0x08 SPI_TCR — SPI Transfer Control Register
0x10 SPI_IER — SPI Interrupt Control Register
0x14 SPI_ISR — SPI Interrupt Status Register
0x18 SPI_FCR — SPI FIFO Control Register
0x1C SPI_FSR — SPI FIFO Status Register
0x20 SPI_WCR — SPI Wait Clock Register
0x28 SPI_SAMP_DL — SPI Sample Delay Control Register
0x30 SPI_MBC — SPI Master Burst Counter Register
0x34 SPI_MTC — SPI Master Transmit Counter Register
0x38 SPI_BCC — SPI Master Burst Control Register
0x40 SPI_BATCR — SPI Bit-Aligned Transfer Configure Register
0x44 SPI_BA_CCR — SPI Bit-Aligned Clock Configuration Register
0x48 SPI_TBR — SPI TX Bit Register
0x4C SPI_RBR — SPI RX Bit Register
0x88 SPI_NDMA_MODE_CTL — SPI Normal DMA Mode Control Register
{0x100+4i} DBI_CTL_{i} (i=0..2) — DBI Control Register {i}
0x10C DBI_TIMER — DBI Timer Control Register
0x110 DBI_VIDEO_SZIE — DBI Video Size Configuration Register
0x120 DBI_INT — DBI Interrupt Register
0x124 DBI_DEBUG_0 — DBI BEBUG 0 Register
0x128 DBI_DEBUG_1 — DBI BEBUG 1 Register
0x200 SPI_TXD — SPI TX Data Register
0x300 SPI_RXD — SPI RX Data Register
