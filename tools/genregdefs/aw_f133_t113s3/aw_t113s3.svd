# aw_t113s3 register map
File version: 1.00
Registers are 32-bit, read-write, reset 0x0 unless marked. A register's access mark holds for its fields unless they carry their own. Offsets are from the block's base; [hi:lo] are bit positions; lines under a group give offsets from that group; {n}, {i} and the like mark numbered series.

## G2D_VSU — Graphic 2D Video Scaler
Base 0x05418000
0x00 VS_CTRL
0x40 VS_OUT_SIZE
0x44 VS_GLB_ALPHA
0x80 VS_Y_SIZE
0x88 VS_Y_HSTEP
0x8C VS_Y_VSTEP
0x90 VS_Y_HPHASE
0x98 VS_Y_VPHASE0
0xC0 VS_C_SIZE
0xC8 VS_C_HSTEP
0xCC VS_C_VSTEP
0xD0 VS_C_HPHASE
0xD8 VS_C_VPHASE0
{0x200+0x100*i} VS_Y_HCOEF[{i}] (i=0..63) — VS_Y_HCOEF[N]. N=0..31
{0x300+0x100*i} VS_Y_VCOEF[{i}] (i=0..63) — VS_Y_VCOEF[N]. N=0..31
{0x400+0x100*i} VS_C_HCOEF[{i}] (i=0..63) — VS_C_HCOEF[N]. N=0..31

## G2D_WB — Graphic 2D (G2D) Engine Write Back
Base 0x05413000
0x00 WB_ATT
0x04 WB_SIZE
{0x8+4i} WB_PITCH{i} (i=0..2)
{0x14+8i} WB_LADD{i} (i=0..2)
{0x18+8i} WB_HADD{i} (i=0..2)

## GPADC
Base 0x02009000
0x00 GP_SR_CON — GPADC Sample Rate Configure Register
0x04 GP_CTRL — GPADC Control Register
0x08 GP_CS_EN — GPADC Compare and Select Enable Register
0x0C GP_FIFO_INTC — GPADC FIFO Interrupt Control Register
0x10 GP_FIFO_INTS — GPADC FIFO Interrupt Status Register
0x14 GP_FIFO_DATA — GPADC FIFO Data Register
0x18 GP_CDATA — GPADC Calibration Data Register
0x20 GP_DATAL_INTC — GPADC Data Low Interrupt Configure Register
0x24 GP_DATAH_INTC — GPADC Data High Interrupt Configure Register
0x28 GP_DATA_INTC — GPADC Data Interrupt Configure Register
0x30 GP_DATAL_INTS — GPADC Data Low Interrupt Status Register
0x34 GP_DATAH_INTS — GPADC Data High Interrupt Status Register
0x38 GP_DATA_INTS — GPADC Data Interrupt Status Register
0x40 GP_CH0_CMP_DATA — GPADC CH0 Compare Data Register
0x80 GP_CH0_DATA — GPADC CH0 Data Register

## GPIOB
Base 0x02000030
Same registers: GPIOC 0x02000060, GPIOD 0x02000090, GPIOE 0x020000C0, GPIOF 0x020000F0, GPIOG 0x02000120
{0x0+0x10*i} CFG[{i}] (i=0..3) — Configure Register
0x10 DATA
{0x14+0x10*i} DRV[{i}] (i=0..3) — Multi_Driving Register
{0x24+8i} PULL[{i}] (i=0..1)

## GPIOBLOCK
Base 0x02000000
{0x0+0x150*i} unnamed[{i}] (i=0..6) group
  {0x0+0x10*j} CFG[{j}] (j=0..3) — Configure Register
  0x10 DATA
  {0x14+0x10*j} DRV[{j}] (j=0..3) — Multi_Driving Register
  {0x24+8j} PULL[{j}] (j=0..1)
{0x200+0xE0*i} unnamed[{i}] (i=0..6) group
  {0x0+0x10*j} EINT_CFG[{j}] (j=0..3) — External Interrupt Configure Registers
  0x10 EINT_CTL — External Interrupt Control Register
  0x14 EINT_STATUS — External Interrupt Status Register
  0x18 EINT_DEB — External Interrupt Debounce Register
0x340 PIO_POW_MOD_SEL — PIO Group Withstand Voltage Mode Select Register
0x344 PIO_POW_MS_CTL — PIO Group Withstand Voltage Mode Select Control Register
0x348 PIO_POW_VAL — PIO Group Power Value Register

## GPIOINTB
Base 0x02000220
Same registers: GPIOINTC 0x02000240, GPIOINTD 0x02000260, GPIOINTE 0x02000280, GPIOINTF 0x020002A0, GPIOINTG 0x020002C0
{0x0+0x10*i} EINT_CFG[{i}] (i=0..3) — External Interrupt Configure Registers
0x10 EINT_CTL — External Interrupt Control Register
0x14 EINT_STATUS — External Interrupt Status Register
0x18 EINT_DEB — External Interrupt Debounce Register

## HSTIMER — High Speed Timer (HSTimer)
Base 0x03008000
0x00 HS_TMR_IRQ_EN_REG — HS Timer IRQ Enable Register
0x04 HS_TMR_IRQ_STAS_REG — HS Timer Status Register
0x20 HS_TMR0_CTRL_REG — HS Timer0 Control Register
0x24 HS_TMR0_INTV_LO_REG — HS Timer0 Interval Value Low Register
0x28 HS_TMR0_INTV_HI_REG — HS Timer0 Interval Value High Register
0x2C HS_TMR0_CURNT_LO_REG — HS Timer0 Current Value Low Register
0x30 HS_TMR0_CURNT_HI_REG — HS Timer0 Current Value High Register
0x40 HS_TMR1_CTRL_REG — HS Timer1 Control Register
0x44 HS_TMR1_INTV_LO_REG — HS Timer1 Interval Value Low Register
0x48 HS_TMR1_INTV_HI_REG — HS Timer1 Interval Value High Register
0x4C HS_TMR1_CURNT_LO_REG — HS Timer1 Current Value Low Register
0x50 HS_TMR1_CURNT_HI_REG — HS Timer1 Current Value High Register
