# aw_t113s3 register map
File version: 1.00
Registers are 32-bit, read-write, reset 0x0 unless marked. A register's access mark holds for its fields unless they carry their own. Offsets are from the block's base; [hi:lo] are bit positions; lines under a group give offsets from that group; {n}, {i} and the like mark numbered series.

## CPUX_MSGBOX — Message Box
Base 0x03003000
Same registers: DSP_MSGBOX 0x01701000
{0x20+0x200*i} unnamed[{i}] (i=0..1) group
  0x00 MSGBOX_RD_IRQ_EN_REG — 0x0020+N*0x0100 (N=0-1) MSGBOX Read IRQ Enable Register
  0x04 MSGBOX_RD_IRQ_STATUS_REG — 0x0024+N*0x0100 (N=0-1) MSGBOX Read IRQ Status Register
  0x10 MSGBOX_WR_IRQ_EN_REG — 0x0030+N*0x0100 (N=0-1) MSGBOX Write IRQ Enable Register
  0x14 MSGBOX_WR_IRQ_STATUS_REG — 0x0034+N*0x0100 (N=0-1) MSGBOX Write IRQ Status Register
  0x20 MSGBOX_DEBUG_REG — 0x0040+N*0x0100 (N=0-1) MSGBOX Debug Register
  {0x30+0x10*j} MSGBOX_FIFO_STATUS_REG[{j}] (j=0..3) — 0x0050+N*0x0100+P*0x0004 (N=0-1)(P=0-3) MSGBOX FIFO Status Register
  {0x40+0x10*j} MSGBOX_MSG_STATUS_REG[{j}] (j=0..3) — 0x0060+N*0x0100+P*0x0004 (N=0-1)(P=0-3) MSGBOX Message Status Register
  {0x50+0x10*j} MSGBOX_MSG_REG[{j}] (j=0..3) — 0x0070+N*0x0100+P*0x0004 (N=0-1)(P=0-3) MSGBOX Message Queue Register
  {0x60+0x10*j} MSGBOX_WR_INT_THRESHOLD_REG[{j}] (j=0..3) — 0x0080+N*0x0100+P*0x0004 (N=0-1)(P=0-3) MSGBOX Write IRQ Threshold Register

## OWA — One Wire Audio (TX only)
Base 0x02036000
0x00 OWA_GEN_CTL — OWA General Control Register
0x04 OWA_TX_CFIG — OWA TX Configuration Register
0x0C OWA_ISTA — OWA Interrupt Status Register
0x14 OWA_FCTL — OWA FIFO Control Register
0x18 OWA_FSTA — OWA FIFO Status Register
0x1C OWA_INT — OWA Interrupt Control Register
0x20 OWA_TX_FIFO
0x24 OWA_TX_CNT — OWA TX Counter Register
0x2C OWA_TX_CHSTA0 — OWA TX Channel Status Register0
0x30 OWA_TX_CHSTA1 — OWA TX Channel Status Register1

## PWM — Pulse Width Modulation module
Base 0x02000C00
0x00 PIER — PWM IRQ Enable Register
0x04 PISR — PWM IRQ Status Register
0x10 CIER — Capture IRQ Enable Register
0x14 CISR — Capture IRQ Status Register
{0x20+0x10*i} PCCR[{i}] (i=0..3) — PWM01, PWM23, PWM45, PWM67 Clock Configuration Register
0x40 PCGR — PWM Clock Gating Register
{0x60+0x10*i} PDZCR[{i}] (i=0..3) — PWM01, PWM23, PWM45, PWM67 Dead Zone Control Register
0x80 PER — PWM Enable Register
{0x90+0x10*i} PGR0[{i}] (i=0..3) — PWM Group0, Group1, Group2, Group3 Register
0xC0 CER — Capture Enable Register
{0x100+0x100*i} unnamed[{i}] (i=0..7) group
  0x00 PCR — PWM Control Register
  0x04 PPR — PWM Period Register
  0x08 PCNTR — PWM Count Register
  0x0C PPCNTR — PWM Pulse Count Register
  0x10 CCR — Capture Control Register
  0x14 CRLR — Capture Rise Lock Register
  0x18 CFLR — Capture Fall Lock Register

## RISC_CFG — RISC-V core configuration register
Base 0x06010000
0x04 RISC_STA_ADD0_REG — RISC Start Address0 Register
0x08 RISC_STA_ADD1_REG — RISC Start Address1 Register
0x10 RF1P_CFG_REG — RF1P Configuration Register
0x1C ROM_CFG_REG — ROM Configuration Register
0x20 WAKEUP_EN_REG — Wakeup Enable Register
{0x24+0x14*i} WAKEUP_MASK_REG[{i}] (i=0..4) — Wakeup Mask0..Mask4 Register
0x40 TS_TMODE_SEL_REG — Timestamp Test Mode Select Register
0x44 SRAM_ADDR_TWIST_REG — SRAM Address Twist Register
0x48 WORK_MODE_REG — Work Mode Register
0x50 RETITE_PC0_REG — Retire PC0 Register
0x54 RETITE_PC1_REG — Retire PC1 Register
{0x60+0x14*i} IRQ_MODE_REG[{i}] (i=0..4) — IRQ Mode0..Mode4 Register
0x104 RISC_AXI_PMU_CTRL — RISC AXI PMU Control Register
0x108 RISC_AXI_PMU_PRD — RISC AXI PMU Period Register
0x10C RISC_AXI_PMU_LAT_RD — RISC AXI PMU Read Latency Register
0x110 RISC_AXI_PMU_LAT_WR — RISC AXI PMU Write Latency Register
0x114 RISC_AXI_PMU_REQ_RD — RISC AXI PMU Read Request Register
0x118 RISC_AXI_PMU_REQ_WR — RISC AXI PMU Write Request Register
0x11C RISC_AXI_PMU_BW_RD — RISC AXI PMU Read Bandwidth Register
0x120 RISC_AXI_PMU_BW_WR — RISC AXI PMU Write Bandwidth Register

## RTC — Real Time Clock
Base 0x07090000
0x00 LOSC_CTRL_REG — Low Oscillator Control Register
0x04 LOSC_AUTO_SWT_STA_REG — Low Oscillator Auto Switch Status Register
0x08 INTOSC_CLK_PRESCAL_REG — Internal OSC Clock Pre-scaler Register
0x10 RTC_DAY_REG — RTC Year-Month-Day Register
0x14 RTC_HH_MM_SS_REG — RTC Hour-Minute-Second Register
0x20 ALARM0_DAY_SET_REG — Alarm 0 Day Setting Register
0x24 ALARM0_CUR_VLU_REG — Alarm 0 Counter Current Value Register
0x28 ALARM0_ENABLE_REG — Alarm 0 Enable Register
0x2C ALARM0_IRQ_EN — Alarm 0 IRQ Enable Register
0x30 ALARM0_IRQ_STA_REG — Alarm 0 IRQ Status Register
0x50 ALARM_CONFIG_REG — Alarm Configuration Register
0x60 F32K_FOUT_CTRL_GATING_REG — 32K Fanout Control Gating Register
{0x100+0x20*i} GP_DATA_REG[{i}] (i=0..7) — General Purpose Register (N=0 to 7)
0x120 FBOOT_INFO_REG0 — Fast Boot Information Register0
0x124 FBOOT_INFO_REG1 — Fast Boot Information Register1
0x160 DCXO_CTRL_REG — DCXO Control Register
0x190 RTC_VIO_REG — RTC_VIO Regulation Register
0x1F0 IC_CHARA_REG — IC Characteristic Register
0x1F4 VDD_OFF_GATING_CTRL_REG — VDD Off Gating Control Register
0x204 EFUSE_HV_PWRSWT_CTRL_REG — Efuse High Voltage Power Switch Control Register
0x310 RTC_SPI_CLK_CTRL_REG — RTC SPI Clock Control Register
