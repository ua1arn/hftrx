# aw_t113s3 register map
File version: 1.00
Registers are 32-bit, read-write, reset 0x0 unless marked. A register's access mark holds for its fields unless they carry their own. Offsets are from the block's base; [hi:lo] are bit positions; lines under a group give offsets from that group; {n}, {i} and the like mark numbered series.

## CSIC_TOP
Base 0x05800800
0x00 CSIC_TOP_EN_REG — CSIC TOP Enable Register
0x04 CSIC_PTN_GEN_EN_REG — CSIC Pattern Generation Enable Register
0x08 CSIC_PTN_CTRL_REG — CSIC Pattern Control Register
0x20 CSIC_PTN_LEN_REG — CSIC Pattern Generation Length Register
0x24 CSIC_PTN_ADDR_REG — CSIC Pattern Generation Address Register
0x28 CSIC_PTN_ISP_SIZE_REG — CSIC Pattern ISP Size Register
0xA0 CSIC_DMA0_INPUT_SEL_REG — CSIC DMA0 Input Select Register
0xA4 CSIC_DMA1_INPUT_SEL_REG — CSIC DMA1 Input Select Register
0xDC CSIC_BIST_CS_REG — CSIC BIST CS Register
0xE0 CSIC_BIST_CONTROL_REG — CSIC BIST Control Register
0xE4 CSIC_BIST_START_REG — CSIC BIST Start Register
0xE8 CSIC_BIST_END_REG — CSIC BIST End Register
0xEC CSIC_BIST_DATA_MASK_REG — CSIC BIST Data Mask Register
0xF0 CSIC_MBUS_REQ_MAX_REG — CSIC MBUS REQ MAX Register
0x100 CSIC_MULF_MOD_REG — CSIC Multi-Frame Mode Register
0x104 CSIC_MULF_INT_REG — CSIC Multi-Frame Interrupt Register

## DDRPHYC
Base 0x03103000
0x00 PHYC_REG_000 — Reg_000
0x04 PHYC_REG_004 — Reg_004
0x0C PHYC_REG_00C — Reg_00C
0x10 PHYC_REG_010 — Reg_010
0x18 PHYC_REG_018 — Reg_018
0x2C PHYC_REG_02C — Reg_02C
0x30 PHYC_REG_030 — Reg_030
0x34 PHYC_REG_034 — Reg_034
0x38 PHYC_REG_038 — Reg_038
0x3C PHYC_REG_03C — Reg_03C
0x50 PHYC_REG_050 — Reg_050
0x54 PHYC_REG_054 — Reg_054
0x58 PHYC_REG_058 — Reg_058
0x5C PHYC_REG_05C — Reg_05C
0x60 PHYC_REG_060 — Reg_060
0x64 PHYC_REG_064 — Reg_064
0x68 PHYC_REG_068 — Reg_068
0x6C PHYC_REG_06C — Reg_06C
0x78 PHYC_REG_078 — Reg_078
0x7C PHYC_REG_07C — Reg_07c
0x80 PHYC_REG_080 — Reg_080
0x8C PHYC_REG_08C — Reg_08C
0x90 PHYC_REG_090 — Reg_090
0x94 PHYC_REG_094 — Reg_094
0x9C PHYC_REG_09C — Reg_09C
0xA0 PHYC_REG_0A0 — Reg_0a0
0xB8 PHYC_REG_0B8 — Reg_0B8
0xBC PHYC_REG_0BC — Reg_0BC
0xC0 PHYC_REG_0C0 — Reg_0C0
0x100 PHYC_REG_100 — Reg_100
0x108 PHYC_REG_108 — Reg_108
0x10C PHYC_REG_10C — Reg_10C
0x110 PHYC_REG_110 — Reg_110
0x114 PHYC_REG_114 — Reg_114
0x11C PHYC_REG_11C — Reg_11C
0x120 PHYC_REG_120 — Reg_120
0x140 PHYC_REG_140 — Reg_140
0x208 PHYC_REG_208 — Reg_208
0x218 PHYC_REG_218 — Reg_218
0x21C PHYC_REG_21C — Reg_21C
{0x228+0x18*i} PHYC_REG_228[{i}] (i=0..5) — Reg_228
{0x240+0x40*i} PHYC_REG_240[{i}] (i=0..15) — Reg_240
0x280 PHYC_REG_280 — Reg_280
{0x310+0x24*i} PHYC_REG_310[{i}] (i=0..8) — Reg_310 Rank 0
0x334 PHYC_REG_334 — Reg_334 Rank 0
0x338 PHYC_REG_338 — Reg_338 Rank 0
0x33C PHYC_REG_33C — Reg_33C Rank 0
0x344 PHYC_REG_344 — Reg_344 Rank 0
0x348 PHYC_REG_348 — Reg_348 Rank 0
{0x390+0x24*i} PHYC_REG_390[{i}] (i=0..8) — Reg_390
0x3B4 PHYC_REG_3B4 — Reg_3B4 Rank 1
0x3B8 PHYC_REG_3B8 — Reg_3B8 Rank 1
0x3BC PHYC_REG_3BC — Reg_3BC Rank 1
0x3C4 PHYC_REG_3C4 — Reg_3C4 Rank 1
0x3C8 PHYC_REG_3C8 — Reg_3C8 Rank 1

## DE_MIXER0_BLD — Display Engine (DE) - Blender
Base 0x05101000
Same registers: DE_MIXER1_BLD 0x05201000
0x00 BLD_EN_COLOR_CTL — BLD_FILL_COLOR_CTL Offset 0x000 BLD fill color control register
{0x4+0x60*i} unnamed[{i}] (i=0..5) group
  0x00 BLD_FILL_COLOR
  0x04 BLD_CH_ISIZE — BLD input memory size register
  0x08 BLD_CH_OFFSET — BLD input memory offset register
0x80 ROUTE — BLD_CH_RTCTL BLD routing control register (default value 0x00543210)
0x84 PREMULTIPLY — BLD pre-multiply control register
0x88 BKCOLOR
0x8C OUTPUT_SIZE
{0x90+0x18*i} BLD_MODE[{i}] (i=0..5) — BLD_CTL SUN8I_MIXER_BLEND_MODE
0xB0 CK_CTL
0xB4 CK_CFG
{0xC0+0x10*i} CK_MAX[{i}] (i=0..3)
{0xE0+0x10*i} CK_MIN[{i}] (i=0..3)
0xFC OUT_CTL

## DE_MIXER0_DEP — DRC (dynamic range controller)
Base 0x051A0000
{0x0+0x8000*i} CFG[{i}] (i=0..0)

## DE_MIXER0_GLB — Display Engine (DE) - Global Control
Base 0x05100000
Same registers: DE_MIXER1_GLB 0x05200000
0x00 GLB_CTL — Global control register
0x04 GLB_STS — Global status register
0x08 GLB_DBUFFER — Global double buffer control register
0x0C GLB_SIZE — Global size register
