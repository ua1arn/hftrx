# aw_v853x register map
File version: 1.00
Registers are 32-bit, read-write, reset 0x0 unless marked. A register's access mark holds for its fields unless they carry their own. Offsets are from the block's base; [hi:lo] are bit positions; lines under a group give offsets from that group; {n}, {i} and the like mark numbered series.

## DE_MIXER0_BLD — Display Engine (DE) - Blender
Base 0x05101000
Same registers: DE_MIXER1_BLD 0x05201000
0x00 BLD_EN_COLOR_CTL — BLD_FILL_COLOR_CTL Offset 0x000 BLD fill color control register
{0x4+0x60*i} unnamed[{i}] (i=0..5) group
  0x00 BLD_FILL_COLOR
  0x04 BLD_CH_ISIZE — BLD input memory size register
  0x08 BLD_CH_OFFSET — BLD input memory offset register
0x80 ROUTE — BLD_CH_RTCTL BLD routing control register (default value 0x00543210)
0x84 PREMULTIPLY — BLD pre-multiply control register
0x88 BKCOLOR
0x8C OUTPUT_SIZE
{0x90+0x18*i} BLD_MODE[{i}] (i=0..5) — BLD_CTL SUN8I_MIXER_BLEND_MODE
0xB0 CK_CTL
0xB4 CK_CFG
{0xC0+0x10*i} CK_MAX[{i}] (i=0..3)
{0xE0+0x10*i} CK_MIN[{i}] (i=0..3)
0xFC OUT_CTL

## DE_MIXER0_DEP — DRC (dynamic range controller)
Base 0x051A0000
{0x0+0x8000*i} CFG[{i}] (i=0..0)

## DE_MIXER0_GLB — Display Engine (DE) - Global Control
Base 0x05100000
Same registers: DE_MIXER1_GLB 0x05200000
0x00 GLB_CTL — Global control register
0x04 GLB_STS — Global status register
0x08 GLB_DBUFFER — Global double buffer control register
0x0C GLB_SIZE — Global size register

## DE_TOP — Display Engine (DE) TOP
Base 0x05000000
0x00 GATE_CFG — SCLK_GATE DE SCLK Gating Register
0x04 BUS_CFG — ? HCLK_GATE ? DE HCLK Gating Register
0x08 RST_CFG — AHB_RESET DE AHB Reset register
0x0C DIV_CFG — SCLK_DIV DE SCLK Division register
0x10 SEL_CFG — ? DE2TCON ? MUX register
0x24 DE_IP_CFG — DE IP Configure Register

## DE_MIXER0_UI1 — Display Engine (DE) - UI surface
Base 0x05103000
{0x0+0x80*i} unnamed[{i}] (i=0..3) group
  0x00 ATTR
  0x04 SIZE
  0x08 COORD
  0x0C PITCH
  0x10 TOP_LADDR
  0x14 BOT_LADDR
  0x18 FCOLOR
0x80 TOP_HADDR
0x84 BOT_HADDR
0x88 OVL_SIZE

## DE_MIXER0_VEP0 — Fresh and Contrast Enhancement (FCE), Peak, Chrominance transient improvement (CTI) LCTI, Blue Level Stretch (BLS), ancy color curvature (FCC), VEP_TOP blocks
Base 0x05120000
Same registers: DE_MIXER0_VEP1 0x05140000, DE_MIXER1_VEP0 0x05220000
{0x0+0x800*i} CFG[{i}] (i=0..0)
{0x800+0x800*i} CFG[{i}] (i=0..0)
{0x1000+0x800*i} CFG[{i}] (i=0..0)
{0x1800+0x800*i} CFG[{i}] (i=0..0)
{0x2000+0x800*i} CFG[{i}] (i=0..0)
{0x7000+0x1000*i} CFG[{i}] (i=0..0)

## DE_MIXER0_VI1 — Display Engine (DE) - VI surface
Base 0x05102000
Same registers: DE_MIXER1_VI1 0x05202000
{0x0+0xC0*i} unnamed[{i}] (i=0..3) group
  0x00 ATTR
  0x04 SIZE
  0x08 COORD
  {0xC+0xC*j} PITCH[{j}] (j=0..2) — ix=0: Y, ix=1: U/UV channel, ix=3: V channel
  {0x18+0xC*j} TOP_LADDR[{j}] (j=0..2)
  {0x24+0xC*j} BOT_LADDR[{j}] (j=0..2)
{0xC0+0x10*i} FCOLOR[{i}] (i=0..3)
{0xD0+0xC*i} TOP_HADDR[{i}] (i=0..2)
{0xDC+0xC*i} BOT_HADDR[{i}] (i=0..2)
0xE8 OVL_SIZE — OVL_V overlay window size register
{0xF0+8i} HORI[{i}] (i=0..1) — OVL_V horizontal down sample control register
{0xF8+8i} VERT[{i}] (i=0..1) — OVL_V vertical down sample control register

## DISPLAY_TOP — display interface top (DISPLAY_TOP)
Base 0x05460000
0x00 TV_CLK_SRC_RGB_SRC — TCON_TV Clock Select and RGB Source Select Register
0x1C DE_PORT_PERH_SEL — DE Source Select TCON R Register
0x20 MODULE_GATING — TCON Output to LVDS/DSI/TVE/HDMI Gating RRegister

## DMAC
Base 0x03002000
0x00 DMAC_IRQ_EN_REG0 — DMAC IRQ Enable Register 0
0x04 DMAC_IRQ_EN_REG1 — DMAC IRQ Enable Register 1
0x10 DMAC_IRQ_PEND_REG0 — DMAC IRQ Pending Register 0
0x14 DMAC_IRQ_PEND_REG1 — DMAC IRQ Pending Register 1
0x28 DMAC_AUTO_GATE_REG — DMAC Auto Gating Register
0x30 DMAC_STA_REG — DMAC Status Register
{0x100+0x400*i} unnamed[{i}] (i=0..15) group
  0x00 DMAC_EN_REGN — DMAC Channel Enable Register N (N = 0 to 15) 0x0100 + N*0x0040
  0x04 DMAC_PAU_REGN — DMAC Channel Pause Register N (N = 0 to 15) 0x0104 + N*0x0040
  0x08 DMAC_DESC_ADDR_REGN — DMAC Channel Start Address Register N (N = 0 to 15) 0x0108 + N*0x0040
  0x0C DMAC_CFG_REGN — DMAC Channel Configuration Register N (N = 0 to 15) 0x010C + N*0x0040
  0x10 DMAC_CUR_SRC_REGN — DMAC Channel Current Source Register N (N = 0 to 15) 0x0110 + N*0x0040
  0x14 DMAC_CUR_DEST_REGN — DMAC Channel Current Destination Register N (N = 0 to 15) 0x0114 + N*0x0040
  0x18 DMAC_BCNT_LEFT_REGN — DMAC Channel Byte Counter Left Register N (N = 0 to 15) 0x0118 + N*0x0040
  0x1C DMAC_PARA_REGN — DMAC Channel Parameter Register N (N = 0 to 15) 0x011C + N*0x0040
  0x28 DMAC_MODE_REGN — DMAC Mode Register N (N = 0 to 15) 0x0128 + N*0x0040
  0x2C DMAC_FDESC_ADDR_REGN — DMAC Former Descriptor Address Register N (N = 0 to 15) 0x012C + N*0x0040
  0x30 DMAC_PKG_NUM_REGN — DMAC Package Number Register N (N = 0 to 15) 0x0130 + N*0x0040
