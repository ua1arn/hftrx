# aw_v853x register map
File version: 1.00
Registers are 32-bit, read-write, reset 0x0 unless marked. A register's access mark holds for its fields unless they carry their own. Offsets are from the block's base; [hi:lo] are bit positions; {n}, {i} and the like mark numbered series.

## CSIC_DMA0
Base 0x05830000
Same registers: CSIC_DMA1 0x05831000, CSIC_DMA2 0x05832000, CSIC_DMA3 0x05833000
0x00 CSIC_DMA_TOP_REG — CSIC DMA TOP Register
0x04 CSIC_DMA_MUL_CH_CFG_REG — CSIC DMA Multi-Channel Configuration Register
0x10 CSIC_DMA_FRM_CLK_CNT_REG — CSIC DMA Frame Rate Clock Counter Register
0x14 CSIC_DMA_ACC_ITNL_CLK_CNT_REG — CSIC DMA Accumulated and Internal Clock Counter Register
0x20 CSIC_DMA_FS_FRM_CNT_REG — CSIC DMA Fsync Frame Counter Register
0x40 CSIC_DMA_VI_TO_TH0_REG — CSIC DMA Video Input Timeout Threshold0 Register
0x44 CSIC_DMA_VI_TO_TH1_REG — CSIC DMA Video Input Timeout Threshold1 Register
0x48 CSIC_DMA_VI_TO_CNT_VAL_REG — CSIC DMA Video Input Timeout Counter Value Register
0x50 CSIC_DMA_VE_FRM_CNT_REG — CSIC DMA VE Frame Counter Value Register
0x54 CSIC_DMA_VE_LINE_CNT_REG — CSIC DMA VE Line Counter Value Register
0x58 CSIC_DMA_VE_CUR_FRM_ADDR_REG — CSIC DMA VE Current Frame Address Register
0x5C CSIC_DMA_VE_LAST_FRM_ADDR_REG — CSIC DMA VE Last Frame Address Register
0x80 CSIC_DMA_FIFO_STAT_REG — CSIC DMA FIFO Statistic Register
0x84 CSIC_DMA_FIFO_THRS_REG — CSIC DMA FIFO Threshold Register
0x100 CSIC_DMA_TOP_INT_EN_REG — CSIC DMA TOP Interrupt Enable Register
0x104 CSIC_DMA_TOP_INT_STA_REG — CSIC DMA TOP Interrupt Status Register
0x1F4 CSIC_DMA_FEATURE_REG — CSIC DMA Feature List Register
{0x200+0x200*i} CSIC_DMA_CH{i}_EN_REG (i=0..3) — CSIC DMA Channel{i} Enable Register
{0x204+0x200*i} CSIC_DMA_CH{i}_CFG_REG (i=0..3) — CSIC DMA Channel{i} Configuration Register
{0x208+0x200*i} CSIC_DMA_CH{i}_FRM_LOST_CNT_REG (i=0..3) — CSIC DMA Channel{i} Frame Lost Counter Register
{0x210+0x200*i} CSIC_DMA_CH{i}_HSIZE_REG (i=0..3) — CSIC DMA Channel{i} Horizontal Size Register
{0x214+0x200*i} CSIC_DMA_CH{i}_VSIZE_REG (i=0..3) — CSIC DMA Channel{i} Vertical Size Register
{0x220+0x200*i} CSIC_DMA_CH{i}_F0_BUFA_REG (i=0..3) — CSIC DMA Channel{i} FIFO 0 Output Buffer-A Address Register
{0x224+0x200*i} CSIC_DMA_CH{i}_F0_BUFA_RESULT_REG (i=0..3) — CSIC DMA Channel{i} FIFO 0 Output Buffer-A Address Result Register
{0x228+0x200*i} CSIC_DMA_CH{i}_F1_BUFA_REG (i=0..3) — CSIC DMA Channel{i} FIFO 1 Output Buffer-A Address Register
{0x22C+0x200*i} CSIC_DMA_CH{i}_F1_BUFA_RESULT_REG (i=0..3) — CSIC DMA Channel{i} FIFO 1 Output Buffer-A Address Result Register
{0x230+0x200*i} CSIC_DMA_CH{i}_F2_BUFA_REG (i=0..3) — CSIC DMA Channel{i} FIFO 2 Output Buffer-A Address Register
{0x234+0x200*i} CSIC_DMA_CH{i}_F2_BUFA_RESULT_REG (i=0..3) — CSIC DMA Channel{i} FIFO 2 Output Buffer-A Address Result Register
{0x238+0x200*i} CSIC_DMA_CH{i}_BUF_LEN_REG (i=0..3) — CSIC DMA Channel{i} Buffer Length Register
{0x23C+0x200*i} CSIC_DMA_CH{i}_FLIP_SIZE_REG (i=0..3) — CSIC DMA Channel{i} Flip Size Register
{0x24C+0x200*i} CSIC_DMA_CH{i}_CAP_STA_REG (i=0..3) — CSIC DMA Channel{i} Capture Status Register
{0x250+0x200*i} CSIC_DMA_CH{i}_INT_EN_REG (i=0..3) — CSIC DMA Channel{i} Interrupt Enable Register
{0x254+0x200*i} CSIC_DMA_CH{i}_INT_STA_REG (i=0..3) — CSIC DMA Channel{i} Interrupt Status Register
{0x258+0x200*i} CSIC_DMA_CH{i}_LINE_CNT_REG (i=0..3) — CSIC DMA Channel{i} Line Counter Register
{0x268+0x200*i} CSIC_DMA_CH{i}_LINE_STAT_REG (i=0..3) — CSIC DMA Channel{i} Line Statistic Register
{0x270+0x200*i} CSIC_DMA_CH{i}_PCLK_STAT_REG (i=0..3) — CSIC DMA Channel{i} PCLK Statistic Register
{0x300+0x200*i} CSIC_LBC_CH{i}_CONFIG_REG (i=0..3) — CSIC LBC Channel{i} Configure Register
{0x304+0x200*i} CSIC_LBC_CH{i}_LINE_TAR_BIT0_REG (i=0..3) — CSIC LBC Channel{i} Line Target Bit0 Register
{0x308+0x200*i} CSIC_LBC_CH{i}_LINE_TAR_BIT1_REG (i=0..3) — CSIC LBC Channel{i} Line Target Bit1 Register
{0x30C+0x200*i} CSIC_LBC_CH{i}_RC_ADV_REG (i=0..3) — CSIC LBC Channel{i} RC ADV Register
{0x310+0x200*i} CSIC_LBC_CH{i}_MB_MIN_REG (i=0..3) — CSIC LBC Channel{i} MB MIN Register
