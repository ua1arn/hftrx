# aw_f133 register map
File version: 1.00
Registers are 32-bit, read-write, reset 0x0 unless marked. A register's access mark holds for its fields unless they carry their own. Offsets are from the block's base; [hi:lo] are bit positions; {n}, {i} and the like mark numbered series.

## SPI0 — Serial Peripheral Interface
Base 0x04025000
Same registers: SPI1 0x04026000, SPI_DBI 0x04026000
0x04 SPI_GCR — SPI Global Control Register
0x08 SPI_TCR — SPI Transfer Control Register
0x10 SPI_IER — SPI Interrupt Control Register
0x14 SPI_ISR — SPI Interrupt Status Register
0x18 SPI_FCR — SPI FIFO Control Register
0x1C SPI_FSR — SPI FIFO Status Register
0x20 SPI_WCR — SPI Wait Clock Register
0x28 SPI_SAMP_DL — SPI Sample Delay Control Register
0x30 SPI_MBC — SPI Master Burst Counter Register
0x34 SPI_MTC — SPI Master Transmit Counter Register
0x38 SPI_BCC — SPI Master Burst Control Register
0x40 SPI_BATCR — SPI Bit-Aligned Transfer Configure Register
0x44 SPI_BA_CCR — SPI Bit-Aligned Clock Configuration Register
0x48 SPI_TBR — SPI TX Bit Register
0x4C SPI_RBR — SPI RX Bit Register
0x88 SPI_NDMA_MODE_CTL — SPI Normal DMA Mode Control Register
{0x100+4i} DBI_CTL_{i} (i=0..2) — DBI Control Register {i}
0x10C DBI_TIMER — DBI Timer Control Register
0x110 DBI_VIDEO_SZIE — DBI Video Size Configuration Register
0x120 DBI_INT — DBI Interrupt Register
0x124 DBI_DEBUG_0 — DBI BEBUG 0 Register
0x128 DBI_DEBUG_1 — DBI BEBUG 1 Register
0x200 SPI_TXD — SPI TX Data Register
0x300 SPI_RXD — SPI RX Data Register

## SYS_CFG
Base 0x03000000
0x08 DSP_BOOT_RAMMAP_REG — DSP Boot SRAM Remap Control Register
0x24 VER_REG — Version Register
0x30 EMAC_EPHY_CLK_REG0 — EMAC-EPHY Clock Register 0
0x150 SYS_LDO_CTRL_REG — System LDO Control Register
0x160 RESCAL_CTRL_REG — Resistor Calibration Control Register
0x168 RES240_CTRL_REG — 240ohms Resistor Manual Control Register
0x16C RESCAL_STATUS_REG — Resistor Calibration Status Register
0x21C SYS_LDOB_SID
0x228 SYS_EFUSE_REG

## TCON_LCD0 — Timing Controller_LCD (TCON_LCD)
Base 0x05461000
0x00 LCD_GCTL_REG — LCD Global Control Register
0x04 LCD_GINT0_REG — LCD Global Interrupt Register0
0x08 LCD_GINT1_REG — LCD Global Interrupt Register1
0x10 LCD_FRM_CTL_REG — LCD FRM Control Register
{0x14+0x18*i} LCD_FRM_SEED_REG[{i}] (i=0..5) — LCD FRM Seed Register (N=0,1,2,3,4,5)
{0x2C+0x10*i} LCD_FRM_TAB_REG[{i}] (i=0..3) — LCD FRM Table Register (N=0,1,2,3)
0x3C LCD_3D_FIFO_REG — LCD 3D FIFO Register
0x40 LCD_CTL_REG — LCD Control Register
0x44 LCD_DCLK_REG — LCD Data Clock Register
{0x48+4i} LCD_BASIC{i}_REG (i=0..3) — LCD Basic Timing Register{i}
0x58 LCD_HV_IF_REG — LCD HV Panel Interface Register
0x60 LCD_CPU_IF_REG — LCD CPU Panel Interface Register
0x64 LCD_CPU_WR_REG — LCD CPU Panel Write Data Register
0x68 LCD_CPU_RD0_REG — LCD CPU Panel Read Data Register0
0x6C LCD_CPU_RD1_REG — LCD CPU Panel Read Data Register1
0x84 LCD_LVDS_IF_REG — LCD LVDS Configure Register
0x88 LCD_IO_POL_REG — LCD IO Polarity Register
0x8C LCD_IO_TRI_REG — LCD IO Control Register
0xFC LCD_DEBUG_REG — LCD Debug Register
0x100 LCD_CEU_CTL_REG — LCD CEU Control Register
{0x110+0xC*i} LCD_CEU_COEF_MUL_REG[{i}] (i=0..2) — LCD CEU Coefficient Register0 0x0110+N*0x04 (N=0..10) N=0: Rr, N=1: Rg, N=2: Rb, N=4: Gr, N=5: Gg, N=6: Gb, N=8: Br, N=9: Bg, N=10: Bb
0x11C LCD_CEU_COEF_ADD0_REG — LCD CEU Coefficient Register1 0x011C+N*0x10 (N=0,1,2) N=0: Rc, N=1: Gc, N=2: Bc
0x12C LCD_CEU_COEF_ADD1_REG — LCD CEU Coefficient Register1 0x011C+N*0x10 (N=0,1,2)
0x13C LCD_CEU_COEF_ADD2_REG — LCD CEU Coefficient Register1 0x011C+N*0x10 (N=0,1,2)
{0x140+0xC*i} LCD_CEU_COEF_RANG_REG[{i}] (i=0..2) — LCD CEU Coefficient Register2 0x0140+N*0x04 (N=0,1,2)
{0x160+0x18*i} LCD_CPU_TRIx_REG[{i}] (i=0..5) — LCD CPU Panel Trigger Register0
0x180 LCD_CMAP_CTL_REG — LCD Color Map Control Register
0x190 LCD_CMAP_ODD0_REG — LCD Color Map Odd Line Register0
0x194 LCD_CMAP_ODD1_REG — LCD Color Map Odd Line Register1
0x198 LCD_CMAP_EVEN0_REG — LCD Color Map Even Line Register0
0x19C LCD_CMAP_EVEN1_REG — LCD Color Map Even Line Register1
0x1F0 LCD_SAFE_PERIOD_REG — LCD Safe Period Register
{0x220+8i} LCD_LVDS_ANA_REG[{i}] (i=0..1) — LCD LVDS Analog Register N
0x230 LCD_SYNC_CTL_REG — LCD Sync Control Register
0x234 LCD_SYNC_POS_REG — LCD Sync Position Register
0x238 LCD_SLAVE_STOP_POS_REG — LCD Slave Stop Position Register
{0x400+0x400*i} LCD_GAMMA_TABLE_REG[{i}] (i=0..255) — LCD Gamma Table Register
