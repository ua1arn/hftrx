# aw_f133 register map
File version: 1.00
Registers are 32-bit, read-write, reset 0x0 unless marked. A register's access mark holds for its fields unless they carry their own. Offsets are from the block's base; [hi:lo] are bit positions; lines under a group give offsets from that group; {n}, {i} and the like mark numbered series.

## TCON_TV0
Base 0x05470000
0x00 TV_GCTL_REG — TV Global Control Register
0x04 TV_GINT0_REG — TV Global Interrupt Register0
0x08 TV_GINT1_REG — TV Global Interrupt Register1
0x40 TV_SRC_CTL_REG — TV Source Control Register
0x90 TV_CTL_REG — TV Control Register
{0x94+4i} TV_BASIC{i}_REG (i=0..5) — TV Basic Timing Register{i}
0xB8 TV_IO_POL_REG — TV SYNC Signal Polarity Register was: 0x0088
0xBC TV_IO_TRI_REG — TV SYNC Signal IO Control Register was: 0x008C
0xFC TV_DEBUG_REG — TV Debug Register
0x100 TV_CEU_CTL_REG — TV CEU Control Register
{0x110+0x2C*i} TV_CEU_COEF_MUL_REG[{i}] (i=0..10) — TV CEU Coefficient Register0 0x0110+N*0x04(N=0-10)
{0x140+0xC*i} TV_CEU_COEF_RANG_REG[{i}] (i=0..2) — TV CEU Coefficient Register2 0x0140+N*0x04(N=0-2)
0x1F0 TV_SAFE_PERIOD_REG — TV Safe Period Register
0x300 TV_FILL_CTL_REG — TV Fill Data Control Register
{0x304+0x24*i} unnamed[{i}] (i=0..2) group
  0x00 TV_FILL_BEGIN_REG — TV Fill Data Begin Register 0x0304+N*0x0C(N=0–2)
  0x04 TV_FILL_END_REG — TV Fill Data End Register 0x0308+N*0x0C(N=0–2)
  0x08 TV_FILL_DATA_REG — TV Fill Data Value Register 0x030C+N*0x0C(N=0–2)
0x330 TV_DATA_IO_POL0_REG — TCON Data IO Polarity Control0
0x334 TV_DATA_IO_POL1_REG — TCON Data IO Polarity Control1
0x338 TV_DATA_IO_TRI0_REG — TCON Data IO Enable Control0
0x33C TV_DATA_IO_TRI1_REG — TCON Data IO Enable Control1
0x340 TV_PIXELDEPTH_MODE_REG — TV Pixeldepth Mode Control Register

## THS — Thermal Sensor
Base 0x02009400
0x00 THS_CTRL — THS Control Register
0x04 THS_EN — THS Enable Register
0x08 THS_PER — THS Period Control Register
0x10 THS_DATA_INTC — THS Data Interrupt Control Register
0x14 THS_SHUT_INTC — THS Shut Interrupt Control Register
0x18 THS_ALARM_INTC — THS Alarm Interrupt Control Register
0x20 THS_DATA_INTS — THS Data Interrupt Status Register
0x24 THS_SHUT_INTS — THS Shut Interrupt Status Register
0x28 THS_ALARMO_INTS — THS Alarm off Interrupt Status Register
0x2C THS_ALARM_INTS — THS Alarm Interrupt Status Register
0x30 THS_FILTER — THS Median Filter Control Register
0x40 THS_ALARM_CTRL — THS Alarm Threshold Control Register
0x80 THS_SHUTDOWN_CTRL — THS Shutdown Threshold Control Register
0xA0 THS_CDATA — THS Calibration Data
0xC0 THS_DATA

## TIMER
Base 0x02050000
0x00 TMR_IRQ_EN_REG — Timer IRQ Enable Register
0x04 TMR_IRQ_STA_REG — Timer Status Register
{0x10+0x20*i} unnamed[{i}] (i=0..1) group
  0x00 CTRL_REG — Timer n Control Register
  0x04 INTV_VALUE_REG — Timer n Interval Value Register
  0x08 CUR_VALUE_REG — Timer n Current Value Register
0xA0 WDOG_IRQ_EN_REG — Watchdog IRQ Enable Register
0xA4 WDOG_IRQ_STA_REG — Watchdog Status Register
0xA8 WDOG_SOFT_RST_REG — Watchdog Software Reset Register
0xB0 WDOG_CTRL_REG — Watchdog Control Register
0xB4 WDOG_CFG_REG — Watchdog Configuration Register
0xB8 WDOG_MODE_REG — Watchdog Mode Register
0xBC WDOG_OUTPUT_CFG_REG — Watchdog Output Configuration Register
0xC0 AVS_CNT_CTL_REG — AVS Control Register
0xC4 AVS_CNT0_REG — AVS Counter 0 Register
0xC8 AVS_CNT1_REG — AVS Counter 1 Register
0xCC AVS_CNT_DIV_REG — AVS Divisor Register

## TPADC
Base 0x02009C00
{0x0+4i} TP_CTRL_REG{i} (i=0..3) — TP Control Register {i}
0x10 TP_INT_FIFO_CTRL_REG — TP Interrupt FIFO Control Register
0x14 TP_INT_FIFO_STAT_REG — TP Interrupt FIFO Status Register
0x1C TP_CALI_DATA_REG — TP Calibration Data Register
0x24 TP_DATA_REG — TP Data Register

## TVD0 — Video Decoding
Base 0x05C01000
0x00 TVD_EN — TVD MODULE CONTROL Register
0x04 TVD_MODE — TVD MODE CONTROL Register
0x08 TVD_CLAMP_AGC1 — TVD CLAMP & AGC CONTROL Register1
0x0C TVD_CLAMP_AGC2 — TVD CLAMP & AGC CONTROL Register2
{0xC+4i} TVD_HLOCK{i} (i=1..5) — TVD HLOCK CONTROL Register{i}
0x24 TVD_VLOCK1 — TVD VLOCK CONTROL Register1
0x28 TVD_VLOCK2 — TVD VLOCK CONTROL Register2
0x30 TVD_CLOCK1 — TVD CHROMA LOCK CONTROL Register1
0x34 TVD_CLOCK2 — TVD CHROMA LOCK CONTROL Register2
0x40 TVD_YC_SEP1 — TVD YC SEPERATION CONROL Register1
0x44 TVD_YC_SEP2 — TVD YC SEPERATION CONROL Register2
{0x4C+4i} TVD_ENHANCE{i} (i=1..3) — TVD ENHANCEMENT CONTROL Register{i}
{0x5C+4i} TVD_WB{i} (i=1..4) — TVD WB DMA CONTROL Register{i}
0x80 TVD_IRQ_CTL — TVD DMA Interrupt Control Register
0x90 TVD_IRQ_STATUS — TVD DMA Interrupt Status Register
0x100 TVD_DEBUG1 — TVD DEBUG CONTROL Register1
{0x17C+4i} TVD_STATUS{i} (i=1..6) — TVD DEBUG STATUS Register{i}
