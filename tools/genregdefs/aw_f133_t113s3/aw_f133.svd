# aw_f133 register map
File version: 1.00
Registers are 32-bit, read-write, reset 0x0 unless marked. A register's access mark holds for its fields unless they carry their own. Offsets are from the block's base; [hi:lo] are bit positions; lines under a group give offsets from that group; {n}, {i} and the like mark numbered series.

## TVD_TOP — Video Decoding
Base 0x05C00000
0x00 TVD_TOP_MAP
{0x4+4i} TVD_3D_CTL{i} (i=1..5) — TVD 3D DMA CONTROL Register{i}
{0x20+0x80*i} unnamed[{i}] (i=0..3) group
  0x04 TVD_TOP_CTL — TVD TOP CONTROL Register
  0x08 TVD_ADC_CTL — TVD ADC CONTROL Register
  0x0C TVD_ADC_CFG — TVD ADC CONFIGURATION Register

## TVE_TOP — TV Output (TV_Encoder)
Base 0x05600000
0x20 TVE_DAC_MAP — TV Encoder DAC MAP Register
0x24 TVE_DAC_STATUS — TV Encoder DAC STAUTS Register
{0x28+4i} TVE_DAC_CFG{i} (i=0..2) — TV Encoder DAC CFG{i} Register
0x34 TVE_DAC_CFG3 — TV Encoder DAC CFG2 Register
0xF0 TVE_DAC_TEST — TV Encoder DAC TEST Register

## TV_Encoder — TV Encoder (display out interface = CVBS OUT)
Base 0x05604000
0x00 TVE_000_REG — TV Encoder Clock Gating Register
0x04 TVE_004_REG — TV Encoder Configuration Register
0x08 TVE_008_REG — TV Encoder DAC Register1
0x0C TVE_00C_REG — TV Encoder Notch and DAC Delay Register
0x10 TVE_010_REG — TV Encoder Chroma Frequency Register
0x14 TVE_014_REG — TV Encoder Front/Back Porch Register
0x18 TVE_018_REG — TV Encoder HD Mode VSYNC Register
0x1C TVE_01C_REG — TV Encoder Line Number Register
0x20 TVE_020_REG — TV Encoder Level Register
0x24 TVE_024_REG — TV Encoder DAC Register2
0x30 TVE_030_REG — TV Encoder Auto Detection Enable Register
0x34 TVE_034_REG — TV Encoder Auto Detection Interrupt Status Register
0x38 TVE_038_REG — TV Encoder Auto Detection Status Register
0x3C TVE_03C_REG — TV Encoder Auto Detection De-bounce Setting Register
0xF8 TVE_0F8_REG — TV Encoder Auto Detect Configuration Register0
0xFC TVE_0FC_REG — TV Encoder Auto Detect Configuration Register1
0x100 TVE_100_REG — TV Encoder Color Burst Phase Reset Configuration Register
0x104 TVE_104_REG — TV Encoder VSYNC Number Register
0x108 TVE_108_REG — TV Encoder Notch Filter Frequency Register
0x10C TVE_10C_REG — TV Encoder Cb/Cr Level/Gain Register
0x110 TVE_110_REG — TV Encoder Tint and Color Burst Phase Register
0x114 TVE_114_REG — TV Encoder Burst Width Register
0x118 TVE_118_REG — TV Encoder Cb/Cr Gain Register
0x11C TVE_11C_REG — TV Encoder Sync and VBI Level Register
0x120 TVE_120_REG — TV Encoder White Level Register
0x124 TVE_124_REG — TV Encoder Video Active Line Register
0x128 TVE_128_REG — TV Encoder Video Chroma BW and CompGain Register
0x12C TVE_12C_REG — TV Encoder Register
0x130 TVE_130_REG — TV Encoder Re-sync Parameters Register
0x134 TVE_134_REG — TV Encoder Slave Parameter Register
0x138 TVE_138_REG — TV Encoder Configuration Register0
0x13C TVE_13C_REG — TV Encoder Configuration Register1
0x380 TVE_380_REG — TV Encoder Low Pass Control Register
0x384 TVE_384_REG — TV Encoder Low Pass Filter Control Register
0x388 TVE_388_REG — TV Encoder Low Pass Gain Register
0x38C TVE_38C_REG — TV Encoder Low Pass Gain Control Register
0x390 TVE_390_REG — TV Encoder Low Pass Shoot Control Register
0x394 TVE_394_REG — TV Encoder Low Pass Coring Register
0x3A0 TVE_3A0_REG — TV Encoder Noise Reduction Register

## TWI0
Base 0x02502000
Same registers: TWI1 0x02502400, TWI2 0x02502800, TWI3 0x02502C00
0x00 TWI_ADDR — TWI Slave Address Register
0x04 TWI_XADDR — TWI Extended Slave Address Register
0x08 TWI_DATA — TWI Data Byte Register
0x0C TWI_CNTR — TWI Control Register
0x10 TWI_STAT — TWI Status Register
0x14 TWI_CCR — TWI Clock Control Register
0x18 TWI_SRST — TWI Software Reset Register
0x1C TWI_EFR — TWI Enhance Feature Register
0x20 TWI_LCR — TWI Line Control Register
0x200 TWI_DRV_CTRL — TWI_DRV Control Register
0x204 TWI_DRV_CFG — TWI_DRV Transmission Configuration Register
0x208 TWI_DRV_SLV — TWI_DRV Slave ID Register
0x20C TWI_DRV_FMT — TWI_DRV Packet Format Register
0x210 TWI_DRV_BUS_CTRL — TWI_DRV Bus Control Register
0x214 TWI_DRV_INT_CTRL — TWI_DRV Interrupt Control Register
0x218 TWI_DRV_DMA_CFG — TWI_DRV DMA Configure Register
0x21C TWI_DRV_FIFO_CON — TWI_DRV FIFO Content Register
0x300 TWI_DRV_SEND_FIFO_ACC — TWI_DRV Send Data FIFO Access Register
0x304 TWI_DRV_RECV_FIFO_ACC — TWI_DRV Receive Data FIFO Access Register
