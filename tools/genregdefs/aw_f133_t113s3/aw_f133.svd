# aw_f133 register map
File version: 1.00
Registers are 32-bit, read-write, reset 0x0 unless marked. A register's access mark holds for its fields unless they carry their own. Offsets are from the block's base; [hi:lo] are bit positions; lines under a group give offsets from that group; {n}, {i} and the like mark numbered series.

## DE_MIXER0_VI1 — Display Engine (DE) - VI surface
Base 0x05102000
Same registers: DE_MIXER1_VI1 0x05202000
{0x0+0xC0*i} unnamed[{i}] (i=0..3) group
  0x00 ATTR
  0x04 SIZE
  0x08 COORD
  {0xC+0xC*j} PITCH[{j}] (j=0..2) — ix=0: Y, ix=1: U/UV channel, ix=3: V channel
  {0x18+0xC*j} TOP_LADDR[{j}] (j=0..2)
  {0x24+0xC*j} BOT_LADDR[{j}] (j=0..2)
{0xC0+0x10*i} FCOLOR[{i}] (i=0..3)
{0xD0+0xC*i} TOP_HADDR[{i}] (i=0..2)
{0xDC+0xC*i} BOT_HADDR[{i}] (i=0..2)
0xE8 OVL_SIZE — OVL_V overlay window size register
{0xF0+8i} HORI[{i}] (i=0..1) — OVL_V horizontal down sample control register
{0xF8+8i} VERT[{i}] (i=0..1) — OVL_V vertical down sample control register

## DISPLAY_TOP — display interface top (DISPLAY_TOP)
Base 0x05460000
0x00 TV_CLK_SRC_RGB_SRC — TCON_TV Clock Select and RGB Source Select Register
0x1C DE_PORT_PERH_SEL — DE Source Select TCON R Register
0x20 MODULE_GATING — TCON Output to LVDS/DSI/TVE/HDMI Gating RRegister

## DMAC
Base 0x03002000
0x00 DMAC_IRQ_EN_REG0 — DMAC IRQ Enable Register 0
0x04 DMAC_IRQ_EN_REG1 — DMAC IRQ Enable Register 1
0x10 DMAC_IRQ_PEND_REG0 — DMAC IRQ Pending Register 0
0x14 DMAC_IRQ_PEND_REG1 — DMAC IRQ Pending Register 1
0x28 DMAC_AUTO_GATE_REG — DMAC Auto Gating Register
0x30 DMAC_STA_REG — DMAC Status Register
{0x100+0x400*i} unnamed[{i}] (i=0..15) group
  0x00 DMAC_EN_REGN — DMAC Channel Enable Register N (N = 0 to 15) 0x0100 + N*0x0040
  0x04 DMAC_PAU_REGN — DMAC Channel Pause Register N (N = 0 to 15) 0x0104 + N*0x0040
  0x08 DMAC_DESC_ADDR_REGN — DMAC Channel Start Address Register N (N = 0 to 15) 0x0108 + N*0x0040
  0x0C DMAC_CFG_REGN — DMAC Channel Configuration Register N (N = 0 to 15) 0x010C + N*0x0040
  0x10 DMAC_CUR_SRC_REGN — DMAC Channel Current Source Register N (N = 0 to 15) 0x0110 + N*0x0040
  0x14 DMAC_CUR_DEST_REGN — DMAC Channel Current Destination Register N (N = 0 to 15) 0x0114 + N*0x0040
  0x18 DMAC_BCNT_LEFT_REGN — DMAC Channel Byte Counter Left Register N (N = 0 to 15) 0x0118 + N*0x0040
  0x1C DMAC_PARA_REGN — DMAC Channel Parameter Register N (N = 0 to 15) 0x011C + N*0x0040
  0x28 DMAC_MODE_REGN — DMAC Mode Register N (N = 0 to 15) 0x0128 + N*0x0040
  0x2C DMAC_FDESC_ADDR_REGN — DMAC Former Descriptor Address Register N (N = 0 to 15) 0x012C + N*0x0040
  0x30 DMAC_PKG_NUM_REGN — DMAC Package Number Register N (N = 0 to 15) 0x0130 + N*0x0040

## DMIC
Base 0x02031000
0x00 DMIC_EN — DMIC Enable Control Register
0x04 DMIC_SR — DMIC Sample Rate Register
0x08 DMIC_CTR — DMIC Control Register
0x10 DMIC_DATA
0x14 DMIC_INTC — MIC Interrupt Control Register
0x18 DMIC_INTS — DMIC Interrupt Status Register
0x1C DMIC_RXFIFO_CTR — DMIC RXFIFO Control Register
0x20 DMIC_RXFIFO_STA — DMIC RXFIFO Status Register
0x24 DMIC_CH_NUM — DMIC Channel Numbers Register
0x28 DMIC_CH_MAP — DMIC Channel Mapping Register
0x2C DMIC_CNT — DMIC Counter Register
0x30 DATA0_DATA1_VOL_CTR — Data0 and Data1 Volume Control Register
0x34 DATA2_DATA3_VOL_CTR — Data2 And Data3 Volume Control Register
0x38 HPF_EN_CTR — High Pass Filter Enable Control Register
0x3C HPF_COEF_REG — High Pass Filter Coefficient Register
0x40 HPF_GAIN_REG — High Pass Filter Gain Register

## DSI0 — MIPI DSI Display Interface
Base 0x05450000
0x00 DSI_CTL — dsi_gctl 0x00 - 0x0c
0x04 DSI_GINT0
0x08 DSI_GINT1
0x0C DSI_BASIC_CTL
0x10 DSI_BASIC_CTL0 — dsi_basic_ctl0 0x10 - 0x1c
0x14 DSI_BASIC_CTL1
0x18 DSI_BASIC_SIZE0
0x1C DSI_BASIC_SIZE1
{0x20+0x20*i} DSI_BASIC_INST0[{i}] (i=0..7) — dsi_inst_func[8] 0x20 - 0x3c
0x40 DSI_INST_LOOP_SEL — dsi_inst_loop_sel 0x40 - 0x5c
0x44 DSI_INST_LOOP_NUM
0x48 DSI_INST_JUMP_SEL
{0x4C+8i} DSI_INST_JUMP_CFG[{i}] (i=0..1) — dsi_inst_jump_cfg[2]
0x54 DSI_INST_LOOP_NUM2
0x60 DSI_TRANS_START — dsi_trans_start 0x60 - 0x6c
0x78 DSI_TRANS_ZERO
0x7C DSI_TCON_DRQ
0x80 DSI_PIXEL_CTL0 — dsi_pixel_ctl0 0x80 - 0x8c
0x84 DSI_PIXEL_CTL1
0x90 DSI_PIXEL_PH — dsi_pixel_ph 0x90 - 0x9c
0x94 DSI_PIXEL_PD
0x98 DSI_PIXEL_PF0
0x9C DSI_PIXEL_PF1
0xB0 DSI_SYNC_HSS — dsi_sync_hss 0xb0 - 0xbc
0xB4 DSI_SYNC_HSE
0xB8 DSI_SYNC_VSS
0xBC DSI_SYNC_VSE
0xC0 DSI_BLK_HSA0 — dsi_blk_hsa0 0xc0 - 0xcc
0xC4 DSI_BLK_HSA1
0xC8 DSI_BLK_HBP0
0xCC DSI_BLK_HBP1
0xD0 DSI_BLK_HFP0 — dsi_blk_hfp0 0xd0 - 0xdc
0xD4 DSI_BLK_HFP1
0xE0 DSI_BLK_HBLK0 — dsi_blk_hblk0 0xe0 - 0xec
0xE4 DSI_BLK_HBLK1
0xE8 DSI_BLK_VBLK0
0xEC DSI_BLK_VBLK1
0xF0 DSI_BURST_LINE — dsi_burst_line 0xf0 - 0x1fc
0xF4 DSI_BURST_DRQ
0x200 DSI_CMD_CTL — dsi_cmd_ctl 0x200 - 0x23c
{0x240+0x20*i} DSI_CMD_RX[{i}] (i=0..7) — dsi_cmd_rx[8] 0x240 - 0x2dc
0x2E0 DSI_DEBUG_VIDEO0 — dsi_debug_video0 0x2e0 - 0x2ec
0x2E4 DSI_DEBUG_VIDEO1
0x2F0 DSI_DEBUG_INST — dsi_debug_inst 0x2f0 - 0x2fc
0x2F4 DSI_DEBUG_FIFO
0x2F8 DSI_DEBUG_DATA
{0x300+0x100*i} DSI_CMD_TX[{i}] (i=0..63) — dsi_cmd_tx[64] 0x300 - 0x3fc
