# aw_f133 register map
File version: 1.00
Registers are 32-bit, read-write, reset 0x0 unless marked. A register's access mark holds for its fields unless they carry their own. Offsets are from the block's base; [hi:lo] are bit positions; lines under a group give offsets from that group; {n}, {i} and the like mark numbered series.

## MCTL_PHY
Base 0x03103000
0x00 MCTL_PHY_PIR
0x04 MCTL_PHY_PWRCTL
0x08 MCTL_PHY_MRCTRL0
0x0C MCTL_PHY_CLKEN
0x10 MCTL_PHY_PGSR0
0x14 MCTL_PHY_PGSR1
0x18 MCTL_PHY_STATR
0x2C MCTL_PHY_LP3MR11
{0x30+4i} MCTL_PHY_DRAM_MR{i} (i=0..3)
0x44 MCTL_PHY_PTR0
{0x44+4i} MCTL_PHY_PTR{i} (i=2..4)
{0x58+4i} MCTL_PHY_DRAMTMG{i} (i=0..8)
0x7C MCTL_PHY_ODTCFG
0x80 MCTL_PHY_PITMG0
0x84 MCTL_PHY_PITMG1
0x88 MCTL_PHY_LPTPR
0x8C MCTL_PHY_RFSHCTL0
0x90 MCTL_PHY_RFSHTMG
0x94 MCTL_PHY_RFSHCTL1
0x98 MCTL_PHY_PWRTMG
0x9C MCTL_PHY_ASRC
0xA0 MCTL_PHY_ASRTC
0xB8 MCTL_PHY_VTFCR
0xBC MCTL_PHY_DQSGMR
0xC0 MCTL_PHY_DTCR
0xC4 MCTL_PHY_DTAR0
{0x100+4i} MCTL_PHY_PGCR{i} (i=0..3)
0x110 MCTL_PHY_IOVCR0
0x114 MCTL_PHY_IOVCR1
0x11C MCTL_PHY_DXCCR
0x120 MCTL_PHY_ODTMAP
0x124 MCTL_PHY_ZQCTL0
0x128 MCTL_PHY_ZQCTL1
0x140 MCTL_PHY_ZQCR
0x144 MCTL_PHY_ZQSR
{0x148+4i} MCTL_PHY_ZQDR{i} (i=0..2)
0x1C0 MCTL_PHY_SCHED
0x1C4 MCTL_PHY_PERFHPR0
0x1C8 MCTL_PHY_PERFHPR1
0x1CC MCTL_PHY_PERFLPR0
0x1D0 MCTL_PHY_PERFLPR1
0x1D4 MCTL_PHY_PERFWR0
0x1D8 MCTL_PHY_PERFWR1
0x200 MCTL_PHY_ACMDLR
0x204 MCTL_PHY_ACLDLR
0x208 MCTL_PHY_ACIOCR0
{0x210+0x40*i} MCTL_PHY_ACIOCR1[{i}] (i=0..15) — 0x210 + 0x4 * x

## OWA — One Wire Audio (TX only)
Base 0x02036000
0x00 OWA_GEN_CTL — OWA General Control Register
0x04 OWA_TX_CFIG — OWA TX Configuration Register
0x0C OWA_ISTA — OWA Interrupt Status Register
0x14 OWA_FCTL — OWA FIFO Control Register
0x18 OWA_FSTA — OWA FIFO Status Register
0x1C OWA_INT — OWA Interrupt Control Register
0x20 OWA_TX_FIFO
0x24 OWA_TX_CNT — OWA TX Counter Register
0x2C OWA_TX_CHSTA0 — OWA TX Channel Status Register0
0x30 OWA_TX_CHSTA1 — OWA TX Channel Status Register1

## PLIC — Platform-Level Interrupt Controller (PLIC)
Base 0x10000000
{0x0+0x1000*i} PLIC_PRIO_REGn[{i}] (i=0..1023) — (0<n<256) PLIC Priority Register n - Interrupt Source Priority
{0x1000+0x80*i} PLIC_IP_REGn[{i}] (i=0..31) — (0≤n<9) PLIC Interrupt Pending Register n - Interrupt Pending Bits
{0x2000+0x80*i} PLIC_MIE_REGn[{i}] (i=0..31) — (0≤n<9) PLIC Machine Mode Interrupt Enable Register n - Machine Interrupt Enable Bits
{0x2080+0x80*i} PLIC_SIE_REGn[{i}] (i=0..31) — (0≤n<9) PLIC Superuser Mode Interrupt Enable Register n - Superuser Interrupt Enable Bits
0x1FFFFC PLIC_CTRL_REG — PLIC Control Register
0x200000 PLIC_MTH_REG — PLIC Machine Threshold Register - Priority Threshold for context 0
0x200004 PLIC_MCLAIM_REG — PLIC Machine Claim Register (EOI) - Interrupt Claim Process for context 0
0x201000 PLIC_STH_REG — PLIC Superuser Threshold Register - Priority Threshold for context 1
0x201004 PLIC_SCLAIM_REG — PLIC Superuser Claim Register (EOI) - Interrupt Claim Process for context 1

## PWM — Pulse Width Modulation module
Base 0x02000C00
0x00 PIER — PWM IRQ Enable Register
0x04 PISR — PWM IRQ Status Register
0x10 CIER — Capture IRQ Enable Register
0x14 CISR — Capture IRQ Status Register
{0x20+0x10*i} PCCR[{i}] (i=0..3) — PWM01, PWM23, PWM45, PWM67 Clock Configuration Register
0x40 PCGR — PWM Clock Gating Register
{0x60+0x10*i} PDZCR[{i}] (i=0..3) — PWM01, PWM23, PWM45, PWM67 Dead Zone Control Register
0x80 PER — PWM Enable Register
{0x90+0x10*i} PGR0[{i}] (i=0..3) — PWM Group0, Group1, Group2, Group3 Register
0xC0 CER — Capture Enable Register
{0x100+0x100*i} unnamed[{i}] (i=0..7) group
  0x00 PCR — PWM Control Register
  0x04 PPR — PWM Period Register
  0x08 PCNTR — PWM Count Register
  0x0C PPCNTR — PWM Pulse Count Register
  0x10 CCR — Capture Control Register
  0x14 CRLR — Capture Rise Lock Register
  0x18 CFLR — Capture Fall Lock Register

## RISC_CFG — RISC-V core configuration register
Base 0x06010000
0x04 RISC_STA_ADD0_REG — RISC Start Address0 Register
0x08 RISC_STA_ADD1_REG — RISC Start Address1 Register
0x10 RF1P_CFG_REG — RF1P Configuration Register
0x1C ROM_CFG_REG — ROM Configuration Register
0x20 WAKEUP_EN_REG — Wakeup Enable Register
{0x24+0x14*i} WAKEUP_MASK_REG[{i}] (i=0..4) — Wakeup Mask0..Mask4 Register
0x40 TS_TMODE_SEL_REG — Timestamp Test Mode Select Register
0x44 SRAM_ADDR_TWIST_REG — SRAM Address Twist Register
0x48 WORK_MODE_REG — Work Mode Register
0x50 RETITE_PC0_REG — Retire PC0 Register
0x54 RETITE_PC1_REG — Retire PC1 Register
{0x60+0x14*i} IRQ_MODE_REG[{i}] (i=0..4) — IRQ Mode0..Mode4 Register
0x104 RISC_AXI_PMU_CTRL — RISC AXI PMU Control Register
0x108 RISC_AXI_PMU_PRD — RISC AXI PMU Period Register
0x10C RISC_AXI_PMU_LAT_RD — RISC AXI PMU Read Latency Register
0x110 RISC_AXI_PMU_LAT_WR — RISC AXI PMU Write Latency Register
0x114 RISC_AXI_PMU_REQ_RD — RISC AXI PMU Read Request Register
0x118 RISC_AXI_PMU_REQ_WR — RISC AXI PMU Write Request Register
0x11C RISC_AXI_PMU_BW_RD — RISC AXI PMU Read Bandwidth Register
0x120 RISC_AXI_PMU_BW_WR — RISC AXI PMU Write Bandwidth Register
