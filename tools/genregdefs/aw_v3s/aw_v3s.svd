# aw_v3s register map
File version: 1.00
Registers are 32-bit, read-write, reset 0x0 unless marked. A register's access mark holds for its fields unless they carry their own. Offsets are from the block's base; [hi:lo] are bit positions; lines under a group give offsets from that group; {n}, {i} and the like mark numbered series.

## DMAC
Base 0x01C02000
0x00 DMAC_IRQ_EN_REG — DMAC IRQ Enable Register
0x10 DMAC_IRQ_PEND_REG — DMAC IRQ Pending Register
0x20 DMAC_AUTO_GATE_REG — DMAC Auto Gating Register
0x30 DMAC_STA_REG — DMAC Status Register
{0x100+0x200*i} unnamed[{i}] (i=0..7) group
  0x00 DMAC_EN_REGN — DMAC Channel Enable Register N (N = 0 to 7) 0x0100 + N*0x0040
  0x04 DMAC_PAU_REGN — DMAC Channel Pause Register N (N = 0 to 7) 0x0104 + N*0x0040
  0x08 DMAC_DESC_ADDR_REGN — DMAC Channel Start Address Register N (N = 0 to 7) 0x0108 + N*0x0040
  0x0C DMAC_CFG_REGN — DMAC Channel Configuration Register N (N = 0 to 7) 0x010C + N*0x0040
  0x10 DMAC_CUR_SRC_REGN — DMAC Channel Current Source Register N (N = 0 to 7) 0x0110 + N*0x0040
  0x14 DMAC_CUR_DEST_REGN — DMAC Channel Current Destination Register N (N = 0 to 7) 0x0114 + N*0x0040
  0x18 DMAC_BCNT_LEFT_REGN — DMAC Channel Byte Counter Left Register N (N = 0 to 7) 0x0118 + N*0x0040
  0x1C DMAC_PARA_REGN — DMAC Channel Parameter Register N (N = 0 to 7) 0x011C + N*0x0040

## GPIOB
Base 0x01C20824
Same registers: GPIOC 0x01C20848, GPIOE 0x01C20890, GPIOF 0x01C208B4, GPIOG 0x01C208D8
{0x0+0x10*i} CFG[{i}] (i=0..3) — Configure Register
0x10 DATA
{0x14+8i} DRV[{i}] (i=0..1) — Multi_Driving Register
{0x1C+8i} PULL[{i}] (i=0..1)

## GPIOBLOCK
Base 0x01C20800
{0x0+0xFC*i} unnamed[{i}] (i=0..6) group
  {0x0+0x10*j} CFG[{j}] (j=0..3) — Configure Register
  0x10 DATA
  {0x14+8j} DRV[{j}] (j=0..1) — Multi_Driving Register
  {0x1C+8j} PULL[{j}] (j=0..1)
{0x200+0xE0*i} unnamed[{i}] (i=0..6) group
  {0x0+0x10*j} EINT_CFG[{j}] (j=0..3) — External Interrupt Configure Registers
  0x10 EINT_CTL — External Interrupt Control Register
  0x14 EINT_STATUS — External Interrupt Status Register
  0x18 EINT_DEB — External Interrupt Debounce Register

## GPIOINTB
Base 0x01C20820
Same registers: GPIOINTC 0x01C20840, GPIOINTE 0x01C20880, GPIOINTF 0x01C208A0, GPIOINTG 0x01C208C0
{0x0+0x10*i} EINT_CFG[{i}] (i=0..3) — External Interrupt Configure Registers
0x10 EINT_CTL — External Interrupt Control Register
0x14 EINT_STATUS — External Interrupt Status Register
0x18 EINT_DEB — External Interrupt Debounce Register

## PWM
Base 0x01C21400
0x00 PWM_CH_CTRL — PWM Control Register
0x04 PWM_CH0_PERIOD — PWM Channel 0 Period Register
0x08 PWM_CH1_PERIOD — PWM Channel 1 Period Registe

## RTC
Base 0x01C20400
0x00 LOSC_CTRL_REG — Low Oscillator Control Register l
0x04 LOSC_AUTO_SWT_STA_REG — LOSC Auto Switch Status Register
0x10 RTC_YY_MM_DD_REG — RTC Year-Month-Day Register
0x14 RTC_HH_MM_SS_REG — RTC Hour-Minute-Second Register
0x20 ALARM0_COUNTER_REG — Alarm 0 Counter Register
0x24 ALARM0_CUR_VLU_REG — Alarm 0 Counter Current Value Register
0x28 ALARM0_ENABLE_REG — Alarm 0 Enable Register
0x2C ALARM0_IRQ_EN — Alarm 0 IRQ Enable Register
0x30 ALARM0_IRQ_STA_REG — Alarm 0 IRQ Status Register
0x40 ALARM1_WK_HH_MM_SS — Alarm 1 Week HMS Register
0x44 ALARM1_ENABLE_REG — Alarm 1 Enable Register
0x48 ALARM1_IRQ_EN — Alarm 1 IRQ Enable Register
0x4C ALARM1_IRQ_STA_REG — Alarm 1 IRQ Status Register
0x50 ALARM_CONFIG_REG — Alarm Config Register
0x60 LOSC_OUT_GATING_REG — LOSC output gating register
{0x100+0x20*i} GP_DATA_REG[{i}] (i=0..7) — General Purpose Register (N=0~7)
0x190 VDD_RTC_REG — VDD RTC Regulate Register
0x1F0 IC_CHARA_REG — IC Characteristic Register

## SPI — Serial Peripheral Interface
Base 0x01C68000
0x04 SPI_GCR — SPI Global Control Register
0x08 SPI_TCR — SPI Transfer Control Register
0x10 SPI_IER — SPI Interrupt Control Register
0x14 SPI_ISR — SPI Interrupt Status Register
0x18 SPI_FCR — SPI FIFO Control Register
0x1C SPI_FSR — SPI FIFO Status Register
0x20 SPI_WCR — SPI Wait Clock Register
0x24 SPI_CCR — SPI Clock Rate Control register
0x30 SPI_MBC — SPI Master Burst Counter Register
0x34 SPI_MTC — SPI Master Transmit Counter Register
0x38 SPI_BCC — SPI Master Burst Control Register
0x200 SPI_TXD — SPI TX Data Register
0x300 SPI_RXD — SPI RX Data Register
