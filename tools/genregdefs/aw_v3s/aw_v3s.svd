# aw_v3s register map
File version: 1.00
for test
Registers are 32-bit, read-write, reset 0x0 unless marked. A register's access mark holds for its fields unless they carry their own. Offsets are from the block's base; lines under a group give offsets from that group; [hi:lo] are bit positions; {n}, {i} and the like mark numbered series; 'fields as' and 'values as' point back to an identical list; <NAME> marks a mode.

## Memory map
0x01C00000 SYS_CFG
0x01C02000 DMAC
0x01C0E000 VENCODER — Video Encoding
0x01C19000 USBOTG — USB OTG Dual-Role Device controller
0x01C1A000 USBEHCI
0x01C1A400 USBOHCI
0x01C1A800 USBPHY
0x01C20000 CCU
0x01C20400 RTC
0x01C20800 GPIOBLOCK
0x01C20820 GPIOINTB
0x01C20824 GPIOB
0x01C20840 GPIOINTC
0x01C20848 GPIOC
0x01C20880 GPIOINTE
0x01C20890 GPIOE
0x01C208A0 GPIOINTF
0x01C208B4 GPIOF
0x01C208C0 GPIOINTG
0x01C208D8 GPIOG
0x01C20C00 TIMER
0x01C21400 PWM
0x01C28000 UART0
0x01C28400 UART1
0x01C28800 UART2
0x01C2AC00 TWI0
0x01C2B000 TWI1
0x01C68000 SPI — Serial Peripheral Interface

## CCU
Base 0x01C20000
0x00 PLL_CPU_CTRL_REG — PLL_CPU Control Register
0x08 PLL_AUDIO_CTRL_REG — PLL_AUDIO Control Register
0x10 PLL_VIDEO_CTRL_REG — PLL_VIDEO Control Register
0x18 PLL_VE_CTRL_REG — PLL_VE Control Register
0x20 PLL_DDR0_CTRL_REG — PLL_DDR0 Control Register
0x28 PLL_PERIPH0_CTRL_REG — PLL_PERIPH0 Control Register
0x2C PLL_ISP_CTRL_REG — PLL_ISP Control Register
0x44 PLL_PERIPH1_CTRL_REG — PLL_PERIPH1 Control Register
0x4C PLL_DDR1_CTRL_REG — PLL_DDR1 Control Register
0x50 CPU_AXI_CFG_REG — CPU/AXI Configuration Register
0x54 AHB1_APB1_CFG_REG — AHB/APB0 Configuration Register (AHB_APB0_CFG_REG)
0x58 APB2_CFG_REG — APB2 Configuration Register
0x5C AHB2_CFG_REG — AHB2 Configuration Register
{0x60+4i} BUS_CLK_GATING_REG{i} (i=0..3) — Bus Clock Gating Register {i}
0x70 BUS_CLK_GATING_REG4 — Bus Clock Gating Register4
{0x88+4i} SDMMC{i}_CLK_REG (i=0..2) — SDMMC{i} Clock Register
0x9C SS_CLK_REG — SS Clock Register
0xA0 SPI_CLK_REG — SPI Clock Register
0xB0 I2S_PCM_CLK_REG — I2S/PCM Clock Register
0xCC USBPHY_CFG_REG — USBPHY Configuration Register
0xF4 DRAM_CFG_REG — DRAM Configuration Register
0xF8 PLL_DDR1_CFG_REG — PLL_DDR Configuration Register
0xFC MBUS_RST_REG — MBUS Reset Register
0x100 DRAM_CLK_GATING_REG — DRAM Clock Gating Register
0x104 DE_CLK_REG — DE Clock Register
0x118 TCON_CLK_REG — TCON Clock Register
0x130 CSI_MISC_CLK_REG — CSI_MISC Clock Register
0x134 CSI_CLK_REG — CSI Clock Register
0x13C VE_CLK_REG — VE Clock Register
0x140 AC_DIG_CLK_REG — AC Digital Clock Register
0x144 AVS_CLK_REG — AVS Clock Register
0x15C MBUS_CLK_REG — MBUS Clock Register
0x16C MIPI_CSI_REG — MIPI_CSI Register
0x200 PLL_STABLE_TIME_REG0 — PLL Stable Time Register0
0x204 PLL_STABLE_TIME_REG1 — PLL Stable Time Register1
0x220 PLL_CPU_BIAS_REG — PLL_CPU Bias Register
0x224 PLL_AUDIO_BIAS_REG — PLL_AUDIO Bias Register
0x228 PLL_VIDEO_BIAS_REG — PLL_VIDEO Bias Register
0x22C PLL_VE_BIAS_REG — PLL_VE Bias Register
0x230 PLL_DDR0_BIAS_REG — PLL_DDR0 Bias Register
0x234 PLL_PERIPH0_BIAS_REG — PLL_PERIPH0 Bias Register
0x238 PLL_ISP_BIAS_REG — PLL_ISP Bias Register
0x244 PLL_PERIPH1_BIAS_REG — PLL_PERIPH1 Bias Register
0x24C PLL_DDR1_BIAS_REG — PLL_DDR1 Bias Register
0x250 PLL_CPU_TUN_REG — PLL_CPU Tuning Register
0x260 PLL_DDR0_TUN_REG — PLL_DDR0 Tuning Register
0x280 PLL_CPU_PAT_CTRL_REG — PLL_CPU Pattern Control Register
0x284 PLL_AUDIO_PAT_CTRL_REG — PLL_AUDIO Pattern Control Register
0x288 PLL_VIDEO_PAT_CTRL_REG — PLL_VIDEO Pattern Control Register
0x28C PLL_VE_PAT_CTRL_REG — PLL_VE Pattern Control Register
0x290 PLL_DDR0_PAT_CTRL_REG — PLL_DDR0 Pattern Control Register
0x298 PLL_ISP_PAT_CTRL_REG — PLL_ISP Pattern Control Register
0x2A4 PLL_PERIPH1_PAT_CTRL_REG — PLL_PERIPH1 Pattern Control Register
0x2AC PLL_DDR1_PAT_CTRL_REG0 — PLL_DDR1 Pattern Control Register0
0x2B0 PLL_DDR1_PAT_CTRL_REG1 — PLL_DDR1 Pattern Control Register1
{0x2C0+4i} BUS_SOFT_RST_REG{i} (i=0..2) — Bus Software Reset Register {i}
0x2D0 BUS_SOFT_RST_REG3 — Bus Software Reset Register 3
0x2D8 BUS_SOFT_RST_REG4 — Bus Software Reset Register 4
0x300 PS_CTRL_REG — PS Control Register
0x304 PS_CNT_REG — PS Counter Register

## Notices in the file
Copyright (c) 2024 by Genadi V. Zawidowski. All rights reserved.
