# aw_t507 register map
File version: 1.00
Registers are 32-bit, read-write, reset 0x0 unless marked. A register's access mark holds for its fields unless they carry their own. Offsets are from the block's base; [hi:lo] are bit positions; {n}, {i} and the like mark numbered series.

## IOMMU — IOMMU (I/O Memory management unit)
Base 0x030F0000
0x10 IOMMU_RESET_REG — IOMMU ResetRegister
0x20 IOMMU_ENABLE_REG — IOMMU EnableRegister
0x30 IOMMU_BYPASS_REG — IOMMU BypassRegister
0x40 IOMMU_AUTO_GATING_REG — IOMMU Auto GatingRegister
0x44 IOMMU_WBUF_CTRL_REG — IOMMU Write Buffer Control Register
0x48 IOMMU_OOO_CTRL_REG — IOMMU Out Of Order Control Register
0x4C IOMMU_4KB_BDY_PRT_CTRL_REG — IOMMU 4KB Boundary Protect Control Register
0x50 IOMMU_TTB_REG — IOMMU Translation Table BaseRegister
0x60 IOMMU_TLB_ENABLE_REG — IOMMU TLB EnableRegister
0x70 IOMMU_TLB_PREFETCH_REG — IOMMU TLB PrefetchRegister
0x80 IOMMU_TLB_FLUSH_ENABLE_REG — IOMMU TLB Flush Enable Register
0x84 IOMMU_TLB_IVLD_MODE_SEL_REG — IOMMU TLB Invalidation Mode Select Register
0x88 IOMMU_TLB_IVLD_STA_ADDR_REG — IOMMU TLB Invalidation Start Address Register
0x8C IOMMU_TLB_IVLD_END_ADDR_REG — IOMMU TLB Invalidation End Address Register
0x90 IOMMU_TLB_IVLD_ADDR_REG — IOMMU TLB Invalidation Address Register
0x94 IOMMU_TLB_IVLD_ADDR_MASK_REG — IOMMU TLB Invalidation Address Mask Register
0x98 IOMMU_TLB_IVLD_ENABLE_REG — IOMMU TLB Invalidation Enable Register
0xA0 IOMMU_PC_IVLD_ADDR_REG — IOMMU PC Invalidation Address Register
0xA8 IOMMU_PC_IVLD_ENABLE_REG — IOMMU
{0xB0+4i} IOMMU_DM_AUT_CTRL_REG{i} (i=0..7) — IOMMU Domain Authority Control Register {i}
0xD0 IOMMU_DM_AUT_OVWT_REG — IOMMU Domain Authority Overwrite Register
0x100 IOMMU_INT_ENABLE_REG — IOMMU Interrupt Enable Register
0x104 IOMMU_INT_CLR_REG — IOMMU Interrupt Clear Register
0x108 IOMMU_INT_STA_REG — IOMMU Interrupt Status Register
{0x110+4i} IOMMU_INT_ERR_ADDR_REG{i} (i=0..6) — IOMMU Interrupt Error Address Register {i}
0x130 IOMMU_INT_ERR_ADDR_REG7 — IOMMU Interrupt Error Address Register 7
0x134 IOMMU_INT_ERR_ADDR_REG8 — IOMMU Interrupt Error Address Register 8
{0x150+4i} IOMMU_INT_ERR_DATA_REG{i} (i=0..6) — IOMMU Interrupt Error Data Register {i}
0x170 IOMMU_INT_ERR_DATA_REG7 — IOMMU Interrupt Error Data Register 7
0x174 IOMMU_INT_ERR_DATA_REG8 — IOMMU Interrupt Error Data Register 8
0x180 IOMMU_L1PG_INT_REG — IOMMU L1 Page Table Interrupt Register
0x184 IOMMU_L2PG_INT_REG — IOMMU L2 Page Table Interrupt Register
0x190 IOMMU_VA_REG — IOMMU Virtual Address Register
0x194 IOMMU_VA_DATA_REG — IOMMU Virtual Address Data Register
0x198 IOMMU_VA_CONFIG_REG — IOMMU Virtual Address Configuration Register
0x200 IOMMU_PMU_ENABLE_REG — IOMMU PMU Enable Register
0x210 IOMMU_PMU_CLR_REG — IOMMU PMU Clear Register
{0x230+0x10*i} IOMMU_PMU_ACCESS_LOW_REG{i} (i=0..6) — IOMMU PMU Access Low Register {i}
{0x234+0x10*i} IOMMU_PMU_ACCESS_HIGH_REG{i} (i=0..6) — IOMMU PMU Access High Register {i}
{0x238+0x10*i} IOMMU_PMU_HIT_LOW_REG{i} (i=0..6) — IOMMU PMU Hit Low Register {i}
{0x23C+0x10*i} IOMMU_PMU_HIT_HIGH_REG{i} (i=0..6) — IOMMU PMU Hit High Register {i}
0x2D0 IOMMU_PMU_ACCESS_LOW_REG7 — IOMMU PMU Access Low Register 7
0x2D4 IOMMU_PMU_ACCESS_HIGH_REG7 — IOMMU PMU Access High Register 7
0x2D8 IOMMU_PMU_HIT_LOW_REG7 — IOMMU PMU Hit Low Register 7
0x2DC IOMMU_PMU_HIT_HIGH_REG7 — IOMMU PMU Hit High Register 7
0x2E0 IOMMU_PMU_ACCESS_LOW_REG8 — IOMMU PMU Access Low Register 8
0x2E4 IOMMU_PMU_ACCESS_HIGH_REG8 — IOMMU PMU Access High Register 8
0x2E8 IOMMU_PMU_HIT_LOW_REG8 — IOMMU PMU Hit Low Register 8
0x2EC IOMMU_PMU_HIT_HIGH_REG8 — IOMMU PMU Hit High Register 8
{0x300+0x10*i} IOMMU_PMU_TL_LOW_REG{i} (i=0..6) — IOMMU Total Latency Low Register {i}
{0x304+0x10*i} IOMMU_PMU_TL_HIGH_REG{i} (i=0..6) — IOMMU Total Latency High Register {i}
{0x308+0x10*i} IOMMU_PMU_ML_REG{i} (i=0..6) — IOMMU Max Latency Register {i}

## LRADC — The Low Rate ADC(LRADC
Base 0x05070800
0x00 LRADC_CTRL — LRADC Control Register
0x04 LRADC_INTC — LRADC Interrupt Control Register
0x08 LRADC_INTS — LRADC Interrupt Status Register
0x0C LRADC_DATA0 — LRADC Data Register0
