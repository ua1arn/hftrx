# aw_t507 register map
File version: 1.00
Registers are 32-bit, read-write, reset 0x0 unless marked. A register's access mark holds for its fields unless they carry their own. Offsets are from the block's base; [hi:lo] are bit positions; lines under a group give offsets from that group; {n}, {i} and the like mark numbered series.

## THS — Thermal Sensor
Base 0x05070400
0x00 THS_CTRL — THS Control Register
0x04 THS_EN — THS Enable Register
0x08 THS_PER — THS Period Control Register
0x10 THS_DATA_INTC — THS Data Interrupt Control Register
0x14 THS_SHUT_INTC — THS Shut Interrupt Control Register
0x18 THS_ALARM_INTC — THS Alarm Interrupt Control Register
0x20 THS_DATA_INTS — THS Data Interrupt Status Register
0x24 THS_SHUT_INTS — THS Shut Interrupt Status Register
0x28 THS_ALARMO_INTS — THS Alarm off Interrupt Status Register
0x2C THS_ALARM_INTS — THS Alarm Interrupt Status Register
0x30 THS_FILTER — THS Median Filter Control Register
{0x40+0x10*i} THSx_ALARM_CTRL[{i}] (i=0..3) — THS0..THS3 Alarm Threshold Control Register
{0x80+8i} THSx_SHUTDOWN_CTRL[{i}] (i=0..1) — THS0 & THS1, HS2 & THS3 Shutdown Threshold Control Register
{0xA0+8i} THSx_CDATA[{i}] (i=0..1) — THS0 & THS1, THS2 & THS3 Calibration Data
{0xC0+0x10*i} THSx_DATA[{i}] (i=0..3) — THS0..THS3 Data Register

## TIMER
Base 0x03009000
0x00 TMR_IRQ_EN_REG — Timer IRQ Enable Register
0x04 TMR_IRQ_STA_REG — Timer Status Register
{0x10+0x20*i} unnamed[{i}] (i=0..1) group
  0x00 CTRL_REG — Timer n Control Register
  0x04 INTV_VALUE_REG — Timer n Interval Value Register
  0x08 CUR_VALUE_REG — Timer n Current Value Register
0xA0 WDOG_IRQ_EN_REG — Watchdog IRQ Enable Register
0xA4 WDOG_IRQ_STA_REG — Watchdog Status Register
0xB0 WDOG_CTRL_REG — Watchdog Control Register
0xB4 WDOG_CFG_REG — Watchdog Configuration Register
0xB8 WDOG_MODE_REG — Watchdog Mode Register
0xC0 AVS_CNT_CTL_REG — AVS Control Register
0xC4 AVS_CNT0_REG — AVS Counter 0 Register
0xC8 AVS_CNT1_REG — AVS Counter 1 Register
0xCC AVS_CNT_DIV_REG — AVS Divisor Register

## TIMESTAMP_CTRL
Base 0x08120000
0x00 TSTAMP_CTRL_REG — Timestamp Control Register
0x08 CNT_CTRL_LOW_REG — Counter Low Register
0x0C CNT_CTRL_HI_REG — Counter High Register
0x20 CNT_FREQID_REG — Counter Base Frequency ID Register

## TIMESTAMP_STA
Base 0x08110000
0x00 CNT_LOW_REG — Counter Low Register
0x04 CNT_HI_REG — Counter High Register

## TS0 — Transport Stream Controller
Base 0x05060000
0x10 TSC_PCTLR — TSC Port Control Register
0x14 TSC_PPARR — TSC Port Parameter Register
0x20 TSC_TSFMUXR — TSC TSF Input Multiplex Control Register
0x28 TSC_OUTMUXR — TSC Port Output Multiplex Control Register

## TSD0 — Transport Stream Controller
Base 0x05060180
0x00 TSD_CTLR — TSD Control Register
0x04 TSD_STAR — TSD Status Register
0x1C TSD_CWIR — TSD Control Word Index Register
0x20 TSD_CWR — TSD Control Word Register

## TSF0 — Transport Stream Controller
Base 0x05060100
0x00 TSF_CTLR — TSF Control Register
0x04 TSF_PPR — TSF Packet Parameter Register
0x08 TSF_STAR — TSF Status Register
0x10 TSF_DIER — TSF DMA Interrupt Enable Register
0x14 TSF_OIER — TSF Overlap Interrupt Enable Register
0x18 TSF_DISR — TSF DMA Interrupt Status Register
0x1C TSF_OISR — TSF Overlap Interrupt Status Register
0x20 TSF_PCRCR — TSF PCR Control Register
0x24 TSF_PCRDR — TSF PCR Data Register
0x30 TSF_CENR — TSF Channel Enable Register
0x34 TSF_CPER — TSF Channel PES Enable Register
0x38 TSF_CDER — TSF Channel Descramble Enable Register
0x3C TSF_CINDR — TSF Channel Index Register
0x40 TSF_CCTLR — TSF Channel Control Register
0x44 TSF_CSTAR — TSF Channel Status Register
0x48 TSF_CCWIR — TSF Channel CW Index Register
0x4C TSF_CPIDR — TSF Channel PID Register
0x50 TSF_CBBAR — TSF Channel Buffer Base Address Register
0x54 TSF_CBSZR — TSF Channel Buffer Size Register
0x58 TSF_CBWPR — TSF Channel Buffer Write Pointer Register
0x5C TSF_CBRPR — TSF Channel Buffer Read Pointer Register

## TSG0 — Transport Stream Controller
Base 0x05060040
0x00 TSG_CTLR — TSG Control Register
0x04 TSG_PPR — TSG Packet Parameter Register
0x08 TSG_STAR — TSG Status Register
0x0C TSG_CCR — TSG Clock Control Register
0x10 TSG_BBAR — TSG Buffer Base Address Register
0x14 TSG_BSZR — TSG Buffer Size Register
0x18 TSG_BPR — TSG Buffer Pointer Register
