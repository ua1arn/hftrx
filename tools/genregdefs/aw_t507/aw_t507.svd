# aw_t507 register map
File version: 1.00
for test
Registers are 32-bit, read-write, reset 0x0 unless marked. A register's access mark holds for its fields unless they carry their own. Offsets are from the block's base; lines under a group give offsets from that group; [hi:lo] are bit positions; {n}, {i} and the like mark numbered series; 'fields as' and 'values as' point back to an identical list; <NAME> marks a mode.

## Memory map
0x01008000 DE_TOP — Display Engine (DE) TOP (APB)
0x01008100 DE_MIXER0_GLB — Display Engine (DE) - Global Control
0x01008140 DE_MIXER1_GLB
0x01008200 RTWB_RCQ
0x01101000 DE_VI1 — Display Engine (DE) - VI surface
0x01104000 DE_UIS1 — UI Scaler(UIS) provides RGB format image resizing function
0x01104000 DE_VSU1 — Video Scaler Unit (VSU)
0x01110000 DE_FCE1 — Fresh and Contrast Enhancement (FCE)
0x01111000 DE_BLS1 — Blue Level Stretch (BLS)
0x01111400 DE_FCC1 — Fancy color curvature (FCC)
0x01114000 DE_DNS1 — Denoise (DNS)
0x01121000 DE_VI2
0x01124000 DE_UIS2
0x01124000 DE_VSU2
0x01130000 DE_FCE2
0x01131000 DE_BLS2
0x01131400 DE_FCC2
0x01134000 DE_DNS2
0x01141000 DE_VI3
0x01144000 DE_UIS3
0x01144000 DE_VSU3
0x01150000 DE_FCE3
0x01151000 DE_BLS3
0x01151400 DE_DNS3
0x01151400 DE_FCC3
0x011C1000 DE_UI1 — Display Engine (DE) - UI surface
0x011C4000 DE_UIS4
0x011C4000 DE_VSU4
0x011D0000 DE_FCE4
0x011D1000 DE_BLS4
0x011D1400 DE_FCC4
0x011D4000 DE_DNS4
0x011E1000 DE_UI2
0x011E4000 DE_UIS5
0x011E4000 DE_VSU5
0x011F0000 DE_FCE5
0x011F1000 DE_BLS5
0x011F1400 DE_FCC5
0x011F4000 DE_DNS5
0x01201000 DE_UI3
0x01204000 DE_UIS6
0x01204000 DE_VSU6
0x01210000 DE_FCE6
0x01211000 DE_BLS6
0x01211400 DE_FCC6
0x01214000 DE_DNS6
0x01281000 DE_MIXER0_BLD — Display Engine (DE) - Blender
0x012A1000 DE_MIXER1_BLD
0x01480000 G2D — Graphic 2D top
0x01480000 G2D_TOP
0x014A8000 G2D_ROT — Graphic 2D Rotate
0x01800000 GPU_CONTROL
0x01801000 GPU_JOB_CONTROL
0x01802000 GPU_MMU
0x01904000 CE_NS — The Crypto Engine (CE) module
0x01904800 CE_S
0x01C0E000 VENCODER — Video Encoding
0x03000000 SYS_CFG
0x03001000 CCU — Clock Controller Unit (CCU)
0x03002000 DMAC
0x03005000 HSTIMER — High Speed Timer (HSTimer)
0x03006000 SID — Security ID
0x03007000 SMC
0x03008000 SPC — Secure Peripherals Control
0x03009000 TIMER
0x0300A000 PWM — Pulse Width Modulation module
0x0300B000 GPIOA — Port Controller
0x0300B000 GPIOBLOCK — Port Controller
0x0300B048 GPIOC
0x0300B06C GPIOD
0x0300B090 GPIOE
0x0300B0B4 GPIOF
0x0300B0D8 GPIOG
0x0300B0FC GPIOH
0x0300B120 GPIOI
0x0300B200 GPIOINTA
0x0300B240 GPIOINTC
0x0300B260 GPIOINTD
0x0300B280 GPIOINTE
0x0300B2A0 GPIOINTF
0x0300B2C0 GPIOINTG
0x0300B2E0 GPIOINTH
0x0300B300 GPIOINTI
0x03024000 GICVSELF
0x03025000 GICV
0x030F0000 IOMMU — IOMMU (I/O Memory management unit)
0x04011000 NAND0 — Nand Flash Controller
0x04020000 SMHC0 — SD-MMC Host Controller
0x04021000 SMHC1
0x04022000 SMHC2
0x047FA000 MSI_CTRL
0x047FB000 DRAM_CTRL
0x04800000 DRAM_PHY — PHY_CTRL
0x05000000 UART0
0x05000400 UART1
0x05000800 UART2
0x05000C00 UART3
0x05001000 UART4
0x05001400 UART5
0x05002000 TWI0
0x05002400 TWI1
0x05002800 TWI2
0x05002C00 TWI3
0x05003000 TWI4
0x05010000 SPI0 — Serial Peripheral Interface
0x05011000 SPI1
0x05020000 EMAC0 — The Ethernet Medium Access Controller (EMAC) enables a host to transmi
0x05030000 EMAC1
0x05060000 TS0 — Transport Stream Controller
0x05060040 TSG0 — Transport Stream Controller
0x05060100 TSF0 — Transport Stream Controller
0x05060180 TSD0 — Transport Stream Controller
0x05070000 GPADC — General Purpose ADC
0x05070400 THS — Thermal Sensor
0x05070800 LRADC — The Low Rate ADC(LRADC
0x05093000 OWA — One Wire Audio
0x05095000 DMIC — Digital Microphone Interface
0x05096000 AUDIO_CODEC
0x05097000 AHUB — Audio HUB
0x05097200 I2S0
0x05097300 I2S1
0x05097400 I2S2
0x05097500 I2S3
0x05100000 USB20_OTG_DEVICE — USB OTG Dual-Role Device controller
0x05100400 USB20_OTG_PHYC — HCI Contgroller and PHY Interface Description
0x05101000 USB20_HOST0_EHCI
0x05101400 USB20_HOST0_OHCI
0x05101800 USBPHYC0
0x05200000 USB20_HOST1_EHCI
0x05200400 USB20_HOST1_OHCI
0x05200800 USBPHYC1
0x05310000 USB20_HOST2_EHCI
0x05310400 USB20_HOST2_OHCI
0x05310800 USBPHYC2
0x05311000 USB20_HOST3_EHCI
0x05311400 USB20_HOST3_OHCI
0x05311800 USBPHYC3
0x06000000 HDMI_TX0
0x06510000 DISP_IF_TOP — display interface top (DISP_IF_TOP)
0x06511000 TCON_LCD0 — Timing Controller_LCD (TCON_LCD)
0x06512000 TCON_LCD1
0x06515000 TCON_TV0 — TV Output
0x06516000 TCON_TV1
0x06520000 TVE_TOP — TV Encoder (display out interface = CVBS OUT)
0x06524000 TVE0 — TV Encoder (display out interface = CVBS OUT)
0x06600000 CSIC
0x06600000 CSIC_CCU
0x06600800 CSIC_TOP
0x06601000 CSIC_PARSER0
0x06602000 CSIC_PARSER1
0x06609000 CSIC_DMA0
0x06609200 CSIC_DMA1
0x06609400 CSIC_DMA2
0x06609600 CSIC_DMA3
0x06609800 CSIC_DMA4
0x06609A00 CSIC_DMA5
0x06614000 CSIC_CCI0
0x06614400 CSIC_CCI1
0x07000000 RTC — Real Time Clock
0x07000400 R_CPUCFG
0x07010000 PRCM — Power Reset Clock Management module
0x07022000 GPIOL
0x07080000 R_UART
0x07081400 S_TWI0
0x07082000 R_CAN0 — Car Area Network controller
0x08100000 CPU_SUBSYS_CTRL — T507/H618 CPU Subsystem Control Register List
0x08100000 CPU_SUBSYS_CTRL_H616 — H616 CPU Subsystem Control Register List
0x08110000 TIMESTAMP_STA
0x08120000 TIMESTAMP_CTRL
0x09010000 C0_CPUX_CFG — T507/H618 Cluster 0 Configuration Register List
0x09010000 C0_CPUX_CFG_H616 — H616 Cluster 0 Configuration Register List

## Interrupts
32 UART0 (UART{n} (n=0..5), R_UART)
33 UART1 (UART{n} (n=0..5), R_UART)
34 UART2 (UART{n} (n=0..5), R_UART)
35 UART3 (UART{n} (n=0..5), R_UART)
36 UART4 (UART{n} (n=0..5), R_UART)
37 UART5 (UART{n} (n=0..5), R_UART)
38 TWI0 (TWI{n} (n=0..4), S_TWI0)
39 TWI1 (TWI{n} (n=0..4), S_TWI0)
40 TWI2 (TWI{n} (n=0..4), S_TWI0)
41 TWI3 (TWI{n} (n=0..4), S_TWI0)
42 TWI4 (TWI{n} (n=0..4), S_TWI0)
44 SPI0 (SPI0, SPI1)
45 SPI1 (SPI0, SPI1)
46 EMAC0 (EMAC0, EMAC1)
47 EMAC1 (EMAC0, EMAC1)
48 PWM
49 TS0
50 GPADC
51 THS
52 LRADC
53 OWA
54 DMIC
55 AudioCodec_ADC (AUDIO_CODEC)
56 AHUB
57 USB20_OTG_DEVICE
58 USB20_HOST0_EHCI (USB20_HOST{n}_EHCI (n=0..3))
59 USB20_HOST0_OHCI (USB20_HOST{n}_OHCI (n=0..3))
60 USB20_HOST1_EHCI (USB20_HOST{n}_EHCI (n=0..3))
61 USB20_HOST1_OHCI (USB20_HOST{n}_OHCI (n=0..3))
62 USB20_HOST2_EHCI (USB20_HOST{n}_EHCI (n=0..3))
63 USB20_HOST2_OHCI (USB20_HOST{n}_OHCI (n=0..3))
64 USB20_HOST3_EHCI (USB20_HOST{n}_EHCI (n=0..3))
65 USB20_HOST3_OHCI (USB20_HOST{n}_OHCI (n=0..3))
66 NAND0
67 SMHC0 (SMHC{n} (n=0..2))
68 SMHC1 (SMHC{n} (n=0..2))
69 SMHC2 (SMHC{n} (n=0..2))
70 MSI (MSI_CTRL)
72 DRAM_PHY
73 CLK_DET (CCU)
74 DMAC
75 GPIOE (GPIOINTA, GPIOINTC, GPIOINTD, GPIOINTE, GPIOINTF, GPIOINTG, GPIOINTH, GPIOINTI)
77 HSTIMER0 (HSTIMER)
78 HSTIMER1 (HSTIMER)
79 SMC
80 TIMER0 (TIMER)
81 TIMER1 (TIMER)
82 WATCHDOG (TIMER)
83 GPIOA (GPIOINTA, GPIOINTC, GPIOINTD, GPIOINTE, GPIOINTF, GPIOINTG, GPIOINTH, GPIOINTI)
84 GPIOC (GPIOINTA, GPIOINTC, GPIOINTD, GPIOINTE, GPIOINTF, GPIOINTG, GPIOINTH, GPIOINTI)
85 GPIOD (GPIOINTA, GPIOINTC, GPIOINTD, GPIOINTE, GPIOINTF, GPIOINTG, GPIOINTH, GPIOINTI)
86 GPIOF (GPIOINTA, GPIOINTC, GPIOINTD, GPIOINTE, GPIOINTF, GPIOINTG, GPIOINTH, GPIOINTI)
87 GPIOG (GPIOINTA, GPIOINTC, GPIOINTD, GPIOINTE, GPIOINTF, GPIOINTG, GPIOINTH, GPIOINTI)
88 GPIOH (GPIOINTA, GPIOINTC, GPIOINTD, GPIOINTE, GPIOINTF, GPIOINTG, GPIOINTH, GPIOINTI)
89 GPIOI (GPIOINTA, GPIOINTC, GPIOINTD, GPIOINTE, GPIOINTF, GPIOINTG, GPIOINTH, GPIOINTI)
90 AudioCodec_DAC (AUDIO_CODEC)
93 IOMMU
95 HDMI_TX0
96 TCON_LCD0 (TCON_LCD0, TCON_LCD1)
97 TCON_LCD1 (TCON_LCD0, TCON_LCD1)
98 TCON_TV0 (TCON_TV0, TCON_TV1)
99 TCON_TV1 (TCON_TV0, TCON_TV1)
100 TVE (TVE_TOP)
101 CSI_DMA0 (CSIC_DMA{n} (n=0..5))
102 CSI_DMA1 (CSIC_DMA{n} (n=0..5))
103 CSI_DMA2 (CSIC_DMA{n} (n=0..5))
104 CSI_DMA3 (CSIC_DMA{n} (n=0..5))
107 CSI_CCI0 (CSIC_CCI0, CSIC_CCI1)
108 CSI_CCI1 (CSIC_CCI0, CSIC_CCI1)
109 CSI_MIPI0_RX (CSIC)
111 CSI_DMA4 (CSIC_DMA{n} (n=0..5))
112 CSI_DMA5 (CSIC_DMA{n} (n=0..5))
120 DE (DE_TOP)
122 G2D (G2D, G2D_TOP)
123 CE_NS (CE_NS, CE_S)
124 CE_S (CE_NS, CE_S)
125 VE (VENCODER)
127 GPU_JOB (GPU_JOB_CONTROL)
128 GPU_MMU
135 NMI (C0_CPUX_CFG)
136 ALARM0 (RTC)
137 S_TWI0 (TWI{n} (n=0..4), S_TWI0)
139 R_CPU_IDLE (TIMER)
140 TWD (TIMER)
144 R_UART (UART{n} (n=0..5), R_UART)
160 C0_CTI0 (C0_CPUX_CFG)
161 C0_CTI1 (C0_CPUX_CFG)
162 C0_CTI2 (C0_CPUX_CFG)
163 C0_CTI3 (C0_CPUX_CFG)
164 C0_COMMTX0 (C0_CPUX_CFG)
165 C0_COMMTX1 (C0_CPUX_CFG)
166 C0_COMMTX2 (C0_CPUX_CFG)
167 C0_COMMTX3 (C0_CPUX_CFG)
168 C0_COMMRX0 (C0_CPUX_CFG)
169 C0_COMMRX1 (C0_CPUX_CFG)
170 C0_COMMRX2 (C0_CPUX_CFG)
171 C0_COMMRX3 (C0_CPUX_CFG)
172 C0_PMU0 (C0_CPUX_CFG)
173 C0_PMU1 (C0_CPUX_CFG)
174 C0_PMU2 (C0_CPUX_CFG)
175 C0_PMU3 (C0_CPUX_CFG)
176 C0_AXI_ERROR (C0_CPUX_CFG)
177 AXI_WR_IRQ (C0_CPUX_CFG)
178 AXI_RD_IRQ (C0_CPUX_CFG)
179 DBGRSTREQ0 (C0_CPUX_CFG)
180 DBGRSTREQ1 (C0_CPUX_CFG)
181 DBGRSTREQ2 (C0_CPUX_CFG)
182 DBGRSTREQ3 (C0_CPUX_CFG)
183 nVCPUMNTIRQ0 (C0_CPUX_CFG)
184 nVCPUMNTIRQ1 (C0_CPUX_CFG)
185 nVCPUMNTIRQ2 (C0_CPUX_CFG)
186 nVCPUMNTIRQ3 (C0_CPUX_CFG)
187 nCOMMIRQ0 (C0_CPUX_CFG)
188 nCOMMIRQ1 (C0_CPUX_CFG)
189 nCOMMIRQ2 (C0_CPUX_CFG)
190 nCOMMIRQ3 (C0_CPUX_CFG)
191 DBGPWRUPREQ_out (C0_CPUX_CFG)

## Notices in the file
Copyright (c) 2024 by Genadi V. Zawidowski. All rights reserved.
