# aw_t507 register map
File version: 1.00
Registers are 32-bit, read-write, reset 0x0 unless marked. A register's access mark holds for its fields unless they carry their own. Offsets are from the block's base; [hi:lo] are bit positions.

## GPU_CONTROL
Base 0x01800000
0x00 ID — (RO) GPU and revision identifier
0x04 L2_FEATURES — (RO) Level 2 cache features
0x08 CORE_FEATURES — (RO) Shader Core Features ???
0x0C TILER_FEATURES — (RO) Tiler Features
0x10 MEM_FEATURES — (RO) Memory system features
0x14 MMU_FEATURES — (RO) MMU features
0x18 AS_PRESENT — (RO) Address space slots present
0x20 GPU_IRQ_RAWSTAT — (RW)
0x24 GPU_IRQ_CLEAR — (WO)
0x28 GPU_IRQ_MASK — (RW)
0x2C GPU_IRQ_STATUS — (RO)
0x30 GPU_COMMAND — (WO)
0x34 GPU_STATUS — (RO)
0x3C GPU_FAULTSTATUS — (RO) GPU exception type and fault status
0x40 GPU_FAULTADDRESS_LO — (RO) GPU exception fault address, low word
0x44 GPU_FAULTADDRESS_HI — (RO) GPU exception fault address, high word
0x48 L2_CONFIG — (RW) Level 2 cache configuration
0x50 PWR_KEY — (WO) Power manager key register
0x54 PWR_OVERRIDE0 — (RW) Power manager override settings
0x58 PWR_OVERRIDE1 — (RW) Power manager override settings
0x90 CYCLE_COUNT_LO — (RO) Cycle counter, low word
0x94 CYCLE_COUNT_HI — (RO) Cycle counter, high word
0x98 TIMESTAMP_LO — (RO) Global time stamp counter, low word
0x9C TIMESTAMP_HI — (RO) Global time stamp counter, high word
0xA0 THREAD_MAX_THREADS — (RO) Maximum number of threads per core
0xA4 THREAD_MAX_WORKGROUP_SIZE — (RO) Maximum workgroup size
0xA8 THREAD_MAX_BARRIER_SIZE — (RO) Maximum threads waiting at a barrier
0xAC THREAD_FEATURES — (RO) Thread features
0xB0 TEXTURE_FEATURES_0 — (RO) Support flags for indexed texture formats 0..31
0xB4 TEXTURE_FEATURES_1 — (RO) Support flags for indexed texture formats 32..63
0xB8 TEXTURE_FEATURES_2 — (RO) Support flags for indexed texture formats 64..95
0xBC TEXTURE_FEATURES_3 — (RO) Support flags for texture order
0x100 SHADER_PRESENT_LO — (RO) Shader core present bitmap, low word
0x104 SHADER_PRESENT_HI — (RO) Shader core present bitmap, high word
0x110 TILER_PRESENT_LO — (RO) Tiler core present bitmap, low word
0x114 TILER_PRESENT_HI — (RO) Tiler core present bitmap, high word
0x120 L2_PRESENT_LO — (RO) Level 2 cache present bitmap, low word
0x124 L2_PRESENT_HI — (RO) Level 2 cache present bitmap, high word
0x140 SHADER_READY_LO — (RO) Shader core ready bitmap, low word
0x144 SHADER_READY_HI — (RO) Shader core ready bitmap, high word
0x150 TILER_READY_LO — (RO) Tiler core ready bitmap, low word
0x154 TILER_READY_HI — (RO) Tiler core ready bitmap, high word
0x160 L2_READY_LO — (RO) Level 2 cache ready bitmap, low word
0x164 L2_READY_HI — (RO) Level 2 cache ready bitmap, high word
0x180 SHADER_PWRON_LO — (WO) Shader core power on bitmap, low word
0x184 SHADER_PWRON_HI — (WO) Shader core power on bitmap, high word
0x190 TILER_PWRON_LO — (WO) Tiler core power on bitmap, low word
0x194 TILER_PWRON_HI — (WO) Tiler core power on bitmap, high word
0x1A0 L2_PWRON_LO — (WO) Level 2 cache power on bitmap, low word
0x1A4 L2_PWRON_HI — (WO) Level 2 cache power on bitmap, high word
0x1C0 SHADER_PWROFF_LO — (WO) Shader core power off bitmap, low word
0x1C4 SHADER_PWROFF_HI — (WO) Shader core power off bitmap, high word
0x1D0 TILER_PWROFF_LO — (WO) Tiler core power off bitmap, low word
0x1D4 TILER_PWROFF_HI — (WO) Tiler core power off bitmap, high word
0x1E0 L2_PWROFF_LO — (WO) Level 2 cache power off bitmap, low word
0x1E4 L2_PWROFF_HI — (WO) Level 2 cache power off bitmap, high word
0x200 SHADER_PWRTRANS_LO — (RO) Shader core power transition bitmap, low word
0x204 SHADER_PWRTRANS_HI — (RO) Shader core power transition bitmap, high word
0x210 TILER_PWRTRANS_LO — (RO) Tiler core power transition bitmap, low word
0x214 TILER_PWRTRANS_HI — (RO) Tiler core power transition bitmap, high word
0x220 L2_PWRTRANS_LO — (RO) Level 2 cache power transition bitmap, low word
0x224 L2_PWRTRANS_HI — (RO) Level 2 cache power transition bitmap, high word
0x240 SHADER_PWRACTIVE_LO — (RO) Shader core active bitmap, low word
0x244 SHADER_PWRACTIVE_HI — (RO) Shader core active bitmap, high word
0x250 TILER_PWRACTIVE_LO — (RO) Tiler core active bitmap, low word
0x254 TILER_PWRACTIVE_HI — (RO) Tiler core active bitmap, high word
0x260 L2_PWRACTIVE_LO — (RO) Level 2 cache active bitmap, low word
0x264 L2_PWRACTIVE_HI — (RO) Level 2 cache active bitmap, high word
0x300 COHERENCY_FEATURES — (RO) Coherency features present
0x304 COHERENCY_ENABLE — (RW) Coherency enable
0x310 THREAD_TLS_ALLOC — (RO) Number of threads per core that TLS must be allocated for
0xE00 STACK_PRESENT_LO — (RO) Core stack present bitmap, low word
0xE04 STACK_PRESENT_HI — (RO) Core stack present bitmap, high word
0xE10 STACK_READY_LO — (RO) Core stack ready bitmap, low word
0xE14 STACK_READY_HI — (RO) Core stack ready bitmap, high word
0xE20 STACK_PWRON_LO — (RO) Core stack power on bitmap, low word
0xE24 STACK_PWRON_HI — (RO) Core stack power on bitmap, high word
0xE30 STACK_PWROFF_LO — (RO) Core stack power off bitmap, low word
0xE34 STACK_PWROFF_HI — (RO) Core stack power off bitmap, high word
0xE40 STACK_PWRTRANS_LO — (RO) Core stack power transition bitmap, low word
0xE44 STACK_PWRTRANS_HI — (RO) Core stack power transition bitmap, high word
0xF04 SHADER_CONFIG — (RW) Shader core configuration (implementation-specific)
0xF08 TILER_CONFIG — (RW) Tiler core configuration (implementation-specific)
0xF0C L2_MMU_CONFIG — (RW) L2 cache and MMU configuration (implementation-specific)

## Notices in the file
Copyright (c) 2024 by Genadi V. Zawidowski. All rights reserved.
