# aw_t507 register map
File version: 1.00
Registers are 32-bit, read-write, reset 0x0 unless marked. A register's access mark holds for its fields unless they carry their own. Offsets are from the block's base; [hi:lo] are bit positions; lines under a group give offsets from that group; {n}, {i} and the like mark numbered series.

## DE_TOP — Display Engine (DE) TOP (APB)
Base 0x01008000
0x00 DE_SCLK_GATE — DE SCLK Gating Register
0x04 DE_HCLK_GATE — DE HCLK Gating Register
0x08 DE_AHB_RESET — DE AHB Reset Register DE_MBUS_CLOCK_ADDR
0x0C DE_SCLK_DIV — DE SCLK Division Register
0x10 DE2TCON_MUX — DE MUX Register DE2TCON_MUX_OFFSET
0x14 DE_VER_CTL — DE_VER_CTL_OFFSET
0x20 DE_RTWB_MUX — DE_RTWB_MUX_OFFSET
0x24 DE_CHN2CORE_MUX — DE_CHN2CORE_MUX_OFFSET
{0x28+0x10*i} DE_PORT2CHN_MUX[{i}] (i=0..3) — DE_PORT2CHN_MUX_OFFSET(disp) (0x8028 + (disp) * 0x4)
0xE0 DE_DEBUG_CTL — DE_DEBUG_CTL_OFFSET

## DE_UI1 — Display Engine (DE) - UI surface
Base 0x011C1000
Same registers: DE_UI2 0x011E1000, DE_UI3 0x01201000
{0x0+0x80*i} unnamed[{i}] (i=0..3) group
  0x00 ATTR
  0x04 SIZE
  0x08 COORD
  0x0C PITCH
  0x10 TOP_LADDR
  0x14 BOT_LADDR
  0x18 FCOLOR
0x80 TOP_HADDR
0x84 BOT_HADDR
0x88 OVL_SIZE

## DE_UIS1 — UI Scaler(UIS) provides RGB format image resizing function
Base 0x01104000
Same registers: DE_UIS2 0x01124000, DE_UIS3 0x01144000, DE_UIS4 0x011C4000, DE_UIS5 0x011E4000, DE_UIS6 0x01204000
0x00 UIS_CTRL_REG — Control register
0x08 UIS_STATUS_REG — Status register
0x0C UIS_FIELD_CTRL_REG — Field control register
0x10 UIS_BIST_REG — BIST control register
0x40 UIS_OUT_SIZE_REG — Output size register
0x44 UIS_GLOBAL_ALPHA_REG — VSU Output Global Alpha Register
0x80 UIS_Y_INSIZE_REG — Y Channel Input size register
0x88 UIS_Y_HSTEP_REG — Y Channel Horizontal step register
0x8C UIS_Y_VSTEP_REG — Y Channel Vertical step register
0x90 UIS_Y_HPHASE_REG — Y Channel Horizontal initial phase register
0x98 UIS_Y_VPHASE_REG — Y Channel Vertical initial phase 0 register
0xC0 UIS_C_INSIZE_REG — C Channel Input size register
0xC8 UIS_C_HSTEP_REG — C Channel Horizontal step register
0xCC UIS_C_VSTEP_REG — C Channel Vertical step register
0xD0 UIS_C_HPHASE_REG — C Channel Horizontal initial phase register
0xD8 UIS_C_VPHASE_REG — C Channel Vertical initial phase 0 register
{0x200+0x100*i} UIS_Y_HCOEF0_REGN[{i}] (i=0..63) — 0x200+N*4 Y Channel Horizontal Filter Coefficient0 Register N N = M 1))
{0x400+0x100*i} UIS_Y_VCOEF_REGN[{i}] (i=0..63) — 0x400+N*4 Y Channel Vertical Filter Coefficient Register N N = M 1))
{0x600+0x100*i} UIS_C_HCOEF0_REGN[{i}] (i=0..63) — 0x600+N*4 C Channel Horizontal Filter Coefficient0 Register N N = M 1))

## DE_VI1 — Display Engine (DE) - VI surface
Base 0x01101000
Same registers: DE_VI2 0x01121000, DE_VI3 0x01141000
{0x0+0xC0*i} unnamed[{i}] (i=0..3) group
  0x00 ATTR
  0x04 SIZE
  0x08 COORD
  {0xC+0xC*j} PITCH[{j}] (j=0..2) — ix=0: Y, ix=1: U/UV channel, ix=3: V channel
  {0x18+0xC*j} TOP_LADDR[{j}] (j=0..2)
  {0x24+0xC*j} BOT_LADDR[{j}] (j=0..2)
{0xC0+0x10*i} FCOLOR[{i}] (i=0..3)
{0xD0+0xC*i} TOP_HADDR[{i}] (i=0..2)
{0xDC+0xC*i} BOT_HADDR[{i}] (i=0..2)
{0xE8+8i} OVL_SIZE[{i}] (i=0..1) — OVL_Y, OVL_UV overlay window size register
{0xF0+8i} HORI[{i}] (i=0..1) — OVL_V horizontal down sample control register
{0xF8+8i} VERT[{i}] (i=0..1) — OVL_V vertical down sample control register
0x300 FBD_V_CTL — OVL_V FBD control register

## DE_VSU1 — Video Scaler Unit (VSU)
Base 0x01104000
Same registers: DE_VSU2 0x01124000, DE_VSU3 0x01144000, DE_VSU4 0x011C4000, DE_VSU5 0x011E4000, DE_VSU6 0x01204000
0x00 VSU_CTRL_REG — VSU Module Control Register
0x08 VSU_STATUS_REG — VSU Status Register
0x0C VSU_FIELD_CTRL_REG — VSU Field Control Register
0x10 VSU_SCALE_MODE_REG — VSU Scale Mode Setting Register
0x20 VSU_DIRECTION_THR_REG — VSU Direction Detection Threshold Register
0x24 VSU_EDGE_THR_REG — VSU Edge Detection Setting Register
0x28 VSU_EDSCALER_CTRL_REG — VSU Edge-Direction Scaler Control Register
0x2C VSU_ANGLE_THR_REG — VSU Angle Reliability Setting Register
0x30 VSU_SHARP_EN_REG — VSU Sharpness Control Enable Register
0x34 VSU_SHARP_CORING_REG — VSU Sharpness Control Coring Setting Register
0x38 VSU_SHARP_GAIN0_REG — VSU Sharpness Control Gain Setting 0 Register
0x3C VSU_SHARP_GAIN1_REG — VSU Sharpness Control Gain Setting 1 Register
0x40 VSU_OUT_SIZE_REG — VSU Output Size Register
0x44 VSU_GLOBAL_ALPHA_REG — VSU Output Global Alpha Register
0x80 VSU_Y_SIZE_REG — VSU Y Channel Size Register
0x88 VSU_Y_HSTEP_REG — VSU Y Channel Horizontal Step Register
0x8C VSU_Y_VSTEP_REG — VSU Y Channel Vertical Step Register
0x90 VSU_Y_HPHASE_REG — VSU Y Channel Horizontal Initial Phase Register
0x98 VSU_Y_VPHASE0_REG — VSU Y Channel Vertical Initial Phase 0 Register
0x9C VSU_Y_VPHASE1_REG — VSU Y Channel Vertical Initial Phase 1 Register
0xC0 VSU_C_SIZE_REG — VSU C Channel Size Register
0xC8 VSU_C_HSTEP_REG — VSU C Channel Horizontal Step Register
0xCC VSU_C_VSTEP_REG — VSU C Channel Vertical Step Register
0xD0 VSU_C_HPHASE_REG — VSU C Channel Horizontal Initial Phase Register
0xD8 VSU_C_VPHASE0_REG — VSU C Channel Vertical Initial Phase 0 Register
0xDC VSU_C_VPHASE1_REG — VSU C Channel Vertical Initial Phase 1 Register
{0x200+0x100*i} VSU_Y_HCOEF0_REGN[{i}] (i=0..63) — 0x200+N*4 VSU Y Channel Horizontal Filter Coefficient0 Register N N = M 1))
{0x300+0x100*i} VSU_Y_HCOEF1_REGN[{i}] (i=0..63) — 0x300+N*4 VSU Y Channel Horizontal Filter Coefficient1 Register N N = M 1))
{0x400+0x100*i} VSU_Y_VCOEF_REGN[{i}] (i=0..63) — 0x400+N*4 VSU Y Channel Vertical Filter Coefficient Register N N = M 1))
{0x600+0x100*i} VSU_C_HCOEF0_REGN[{i}] (i=0..63) — 0x600+N*4 VSU C Channel Horizontal Filter Coefficient0 Register N N = M 1))
{0x700+0x100*i} VSU_C_HCOEF1_REGN[{i}] (i=0..63) — 0x700+N*4 VSU C Channel Horizontal Filter Coefficient1 Register N N = M 1))
{0x800+0x100*i} VSU_C_VCOEF_REGN[{i}] (i=0..63) — 0x400+N*4 VSU Cs Channel Vertical Filter Coefficient Register N N = M 1))
