# aw_t507 register map
File version: 1.00
Registers are 32-bit, read-write, reset 0x0 unless marked. A register's access mark holds for its fields unless they carry their own. Offsets are from the block's base; [hi:lo] are bit positions; {n}, {i} and the like mark numbered series.

## SMHC0 — SD-MMC Host Controller
Base 0x04020000
Same registers: SMHC1 0x04021000, SMHC2 0x04022000
0x00 SMHC_CTRL — Control Register
0x04 SMHC_CLKDIV — Clock Control Register
0x08 SMHC_TMOUT — Time Out Register
0x0C SMHC_CTYPE — Bus Width Register
0x10 SMHC_BLKSIZ — Block Size Register
0x14 SMHC_BYTCNT — Byte Count Register
0x18 SMHC_CMD — Command Register
0x1C SMHC_CMDARG — Command Argument Register
{0x20+4i} SMHC_RESP{i} (i=0..3) — Response {i} Register
0x30 SMHC_INTMASK — Interrupt Mask Register
0x34 SMHC_MINTSTS — Masked Interrupt Status Register
0x38 SMHC_RINTSTS — Raw Interrupt Status Register
0x3C SMHC_STATUS — Status Register
0x40 SMHC_FIFOTH — FIFO Water Level Register
0x44 SMHC_FUNS — FIFO Function Select Register
0x48 SMHC_TCBCNT — Transferred Byte Count between Controller and Card
0x4C SMHC_TBBCNT — Transferred Byte Count between Host Memory and Internal FIFO
0x50 SMHC_DBGC — Current Debug Control Register
0x54 SMHC_CSDC — CRC Status Detect Control Register (Only for SMHC2)
0x58 SMHC_A12A — Auto Command 12 Argument Register
0x5C SMHC_NTSR — SD New Timing Set Register (Only for SMHC0, SMHC1)
0x78 SMHC_HWRST — Hardware Reset Register
0x80 SMHC_IDMAC — IDMAC Control Register
0x84 SMHC_DLBA — Descriptor List Base Address Register
0x88 SMHC_IDST — IDMAC Status Register
0x8C SMHC_IDIE — IDMAC Interrupt Enable Register
0x100 SMHC_THLD — Card Threshold Control Register
0x104 SMHC_SFC — Sample FIFO Control Register (Only for SMHC2)
0x108 SMHC_A23A — Auto Command 23 Argument Register (Only for SMHC2)
0x10C EMMC_DDR_SBIT_DET — eMMC4.5 DDR Start Bit Detection Control Register
0x110 SMHC_RES_CRC — Response CRC from Device (Only for SMHC0, SMHC1)
{0x114+0x20*i} SMHC_D7_D0_CRC[{i}] (i=0..7) — CRC in Data7..Data0 from Device (Only for SMHC0, SMHC1)
0x134 SMHC_CRC_STA — Write CRC Status Register (Only for SMHC0, SMHC1)
0x138 SMHC_EXT_CMD — Extended Command Register (Only for SMHC2)
0x13C SMHC_EXT_RESP — Extended Response Register (Only for SMHC2)
0x140 SMHC_DRV_DL — Drive Delay Control Register
0x144 SMHC_SAMP_DL — Sample Delay Control Register
0x148 SMHC_DS_DL — Data Strobe Delay Control Register (Only for SMHC2)
0x200 SMHC_FIFO — Read/Write FIFO

## SPC — Secure Peripherals Control
Base 0x03008000
{0x0+4i} SPC_DECPORT{i}_CTRL_REG (i=0..3) — Decode Port {i} Security Control Register
0x40 SPC_INT_MCU_CTRL_REG — Interrupt Master Security Control Register
0x44 SPC_ILG_RESP_CTRL_REG — Illegal Access Response Control Register (Реакция на несанкционированный доступ)
0xA0 SPC_GPU_MAST_REG — Управление правами GPU как Master шины (бред)
0xA4 SPC_GPU_SLAV_REG — Управление правами доступа CPU к регистрам GPU (бред)

## SPI0 — Serial Peripheral Interface
Base 0x05010000
Same registers: SPI1 0x05011000
0x04 SPI_GCR — SPI Global Control Register
0x08 SPI_TCR — SPI Transfer Control Register
0x10 SPI_IER — SPI Interrupt Control Register
0x14 SPI_ISR — SPI Interrupt Status Register
0x18 SPI_FCR — SPI FIFO Control Register
0x1C SPI_FSR — SPI FIFO Status Register
0x20 SPI_WCR — SPI Wait Clock Register
0x24 SPI_CCR — SPI Clock Control Register
0x28 SPI_SAMP_DL — SPI Sample Delay Control Register
0x30 SPI_MBC — SPI Master Burst Counter Register
0x34 SPI_MTC — SPI Master Transmit Counter Register
0x38 SPI_BCC — SPI Master Burst Control Register
0x40 SPI_BATCR — SPI Bit-Aligned Transfer Configure Register
0x44 SPI_3W_CCR — SPI Bit-Aligned Clock Configuration Register
0x48 SPI_TBR — SPI TX Bit Register
0x4C SPI_RBR — SPI RX Bit Register
0x88 SPI_NDMA_MODE_CTL — SPI Normal DMA Mode Control Register
0x200 SPI_TXD — SPI TX Data Register
0x300 SPI_RXD — SPI RX Data Register

## SYS_CFG
Base 0x03000000
0x04 MEMMAP_REG — DE memory control Register
0x24 VER_REG — Version Register
0x30 EMAC_EPHY_CLK_REG0 — EMAC-EPHY Clock Register 0
0x34 EMAC_EPHY_CLK_REG1 — EMAC-EPHY Clock Register 1 (T507 only)
