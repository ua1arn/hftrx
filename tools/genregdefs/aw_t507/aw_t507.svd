# aw_t507 register map
File version: 1.00
Registers are 32-bit, read-write, reset 0x0 unless marked. A register's access mark holds for its fields unless they carry their own. Offsets are from the block's base; [hi:lo] are bit positions; {n}, {i} and the like mark numbered series.

## NAND0 — Nand Flash Controller
Base 0x04011000
0x00 NDFC_CTL — NDFC Configure and Control Register
0x04 NDFC_ST — NDFC Status Information Register
0x08 NDFC_INT — NDFC Interrupt Control Register
0x0C NDFC_TIMING_CTL — NDFC Timing Control Register
0x10 NDFC_TIMING_CFG — NDFC Timing Configure Register
0x14 NDFC_ADDR_LOW — NDFC Low Word Address Register
0x18 NDFC_ADDR_HIGH — NDFC High Word Address Register
0x1C NDFC_DATA_BLOCK_MASK
0x20 NDFC_CNT — NDFC Data Counter Register
0x24 NDFC_CMD — NDFC Commands IO Register
0x28 NDFC_RCMD_SET — Read Command Set Register for Vendor’s NAND Memory
0x2C NDFC_WCMD_SET — Write Command Set Register for Vendor’s NAND Memory
0x34 NDFC_ECC_CTL — NDFC ECC Control Register
0x38 NDFC_ECC_ST — NDFC ECC Status Register
0x3C NDFC_DATA_PAT_STA — NDFC Data Pattern Status Register
0x40 NDFC_EFR — NDFC Enhanced Feature Register
0x44 NDFC_RDATA_STA_CTL — NDFC Read Data Status Control Register
0x48 NDFC_RDATA_STA_0 — NDFC Read Data Status Register 0
0x4C NDFC_RDATA_STA_1 — NDFC Read Data Status Register 1
{0x50+0x20*i} NDFC_ERR_CNT[{i}] (i=0..7) — NDFC Error Counter Register(N from 0 to 7)
{0x70+0x10*i} NDFC_USER_DATA_LEN[{i}] (i=0..3) — NDFC User Data Length Register(N from 0 to 3)
{0x80+0x80*i} NDFC_USER_DATA[{i}] (i=0..31) — NDFC User Data Field Register N (N from 0 to 31)
0x110 NDFC_EFNAND_STA — NDFC EFNAND Status Register
0x114 NDFC_SPARE_AREA
0x118 NDFC_PAT_ID — NDFC Pattern ID Register
0x11C NDFC_DDR2_SPEC_CTL — NDFC DDR2 Specific Control Register
0x120 NDFC_NDMA_MODE_CTL — NDFC Normal DMA Mode Control Register
0x200 NDFC_MDMA_DLBA_REG — NDFC MBUS DMA Descriptor List Base Address Register
0x204 NDFC_MDMA_STA — NDFC MBUS DMA Interrupt Status Register
0x208 NDFC_DMA_INT_MASK — NDFC MBUS DMA Interrupt Enable Register
0x20C NDFC_MDMA_CUR_DESC_ADDR — NDFC MBUS DMA Current Descriptor Address Register
0x210 NDFC_MDMA_CUR_BUF_ADDR — NDFC MBUS DMA Current Buffer Address Register
0x214 NDFC_DMA_CNT — NDFC DMA Byte Counter Register
0x300 NDFC_IO_DATA — NDFC Input/Output Data Register

## OWA — One Wire Audio
Base 0x05093000
0x00 OWA_GEN_CTL
0x04 OWA_TX_CFIG — OWA TX Configuration Register
0x0C OWA_ISTA — OWA Interrupt Status Register
0x14 OWA_FCTL — OWA FIFO Control Register
0x18 OWA_FSTA — OWA FIFO
0x1C OWA_INT — OWA Interrupt Control Register
0x20 OWA_TX_FIFO
0x24 OWA_TX_CNT — OWA TX Counter Register
0x2C OWA_TX_CHSTA0 — OWA TX Channel Status Register0
0x30 OWA_TX_CHSTA1 — OWA TX Channel Status Register1

## PRCM — Power Reset Clock Management module
Base 0x07010000
0x00 CPUS_CFG_REG — CPUS Configuration Register
0x0C APBS1_CFG_REG — APBS1 Configuration Register
0x12C R_TWD_BGR_REG — R_TWD Bus Gating Reset Register
0x19C R_TWI_BGR_REG — S_TWI0 Bus Gating Reset Register
0x1AC R_CAN_BGR_REG — R_CAN Bus Gating Reset Register
0x1BC R_RSB_BGR_REG — R_RSB Bus Gating Reset Register
0x1C0 R_IR_RX_CLK_REG — R_IR_RX Clock Register
0x1CC R_IR_RX_BGR_REG — R_IR_RX Bus Gating Reset Register
0x20C RTC_BGR_REG — RTC Bus Gating Reset Register
0x240 PLL_CTRL_REG0 — PLL Control Register 0
0x244 PLL_CTRL_REG1 — PLL Control Register 1
0x250 VDD_SYS_PWROFF_GATING_REG — VDD_SYS Power Off Gating Register
0x254 GPU_PWROFF_GATING — GPU Power Off Gating Register
0x258 VE_PWROFF_GATING — VE Power Off Gating Register
0x270 RAM_CFG_REG — RAM Configuration Register
0x274 RAM_TEST_CTRL_REG — RAM Test Control Register
0x290 PRCM_SEC_SWITCH_REG — PRCM Security Switch Register
0x310 RES_CAL_CTRL_REG — Resistor Calibration Control Register
0x314 RES200_CTRL_REG — 200ohms Resistor Manual Control Register
0x318 RES240_CTRL_REG — 240ohms Resistor Manual Control Register
0x31C RES_CAL_STATUS_REG — Resistor Calibration Status Register
0x320 NMI_IRQ_CTRL_REG — NMI Interrupt Control Register
0x324 NMI_IRQ_ENABLE_REG — NMI Interrupt Enable Register
0x328 NMI_IRQ_PEND_REG — NMI Interrupt Pending Register
0x3F0 PRCM_VERSION_REG — PRCM Version Register
