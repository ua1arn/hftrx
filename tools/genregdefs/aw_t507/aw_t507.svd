# aw_t507 register map
File version: 1.00
Registers are 32-bit, read-write, reset 0x0 unless marked. A register's access mark holds for its fields unless they carry their own. Offsets are from the block's base; [hi:lo] are bit positions; lines under a group give offsets from that group; {n}, {i} and the like mark numbered series.

## PWM — Pulse Width Modulation module
Base 0x0300A000
0x00 PIER — PWM IRQ Enable Register
0x04 PISR — PWM IRQ Status Register
0x10 CIER — Capture IRQ Enable Register
0x14 CISR — Capture IRQ Status Register
{0x20+0xC*i} PCCR[{i}] (i=0..2) — PWM01, PWM23, PWM45 Clock Configuration Register
{0x30+0xC*i} PDZCR[{i}] (i=0..2) — PWM01, PWM23, PWM45 Dead Zone Control Register
0x40 PER — PWM Enable Register
0x44 CER — Capture Enable Register
{0x60+0xC0*i} unnamed[{i}] (i=0..5) group
  0x00 PCR — PWM Control Register
  0x04 PPR — PWM Period Register
  0x08 PCNTR — PWM Count Register
  0x0C CCR — Capture Control Register
  0x10 CRLR — Capture Rise Lock Register
  0x14 CFLR — Capture Fall Lock Register

## RTC — Real Time Clock
Base 0x07000000
0x00 LOSC_CTRL_REG — Low Oscillator Control Register
0x04 LOSC_AUTO_SWT_STA_REG — LOSC Auto Switch Status Register
0x08 INTOSC_CLK_PRESCAL_REG — Internal OSC Clock Prescalar Register
0x0C INTOSC_CLK_AUTO_CALI_REG — Internal OSC Clock Auto Calibration Register
0x10 RTC_DAY_REG — RTC Year-Month-Day Register
0x14 RTC_HH_MM_SS_REG — RTC Hour-Minute-Second Register
0x20 ALARM0_COUNTER_REG — Alarm 0 Counter Register
0x24 ALARM0_CUR_VLU_REG — Alarm 0 Counter Current Value Register
0x28 ALARM0_ENABLE_REG — Alarm 0 Enable Register
0x2C ALARM0_IRQ_EN — Alarm 0 IRQ Enable Register
0x30 ALARM0_IRQ_STA_REG — Alarm 0 IRQ Status Register
0x50 ALARM_CONFIG_REG — Alarm Configuration Register
0x60 F32K_FANOUT_GATING_REG — 32k Fanout Output Gating Register
{0x100+0x40*i} GP_DATA_REG[{i}] (i=0..15) — General Purpose Register (N=0~15)
0x160 DCXO_CTRL_REG — DCXO Control Register
0x190 RTC_VIO_REG — RTC_VIO Regulate Register
0x1F0 IC_CHARA_REG — IC Characteristic Register
0x1F4 VDDOFF_GATING_SOF_REG — VDD To RTC Isolation Software Control Register
0x1F8 SP_STDBY_FLAG_REG — Super Standby Flag Register
0x1FC SP_STDBY_SOFT_ENTRY_REG — Super Standby Software Entry Register
0x200 USB_STBY_CTRL_REG — USB Standby Control Register
0x204 EFUSE_HV_PWRSWT_CTRL_REG — Efuse High Voltage Power Switch Control Register
0x210 CRY_CONFIG_REG — Crypt Configuration Register
0x214 CRY_KEY_REG — Crypt Key Register
0x218 CRY_EN_REG — Crypt Enable Register

## RTWB_RCQ
Base 0x01008200
0x00 RTWB_RCQ_IRQ — RTWB_RCQ_IRQ_OFFSET (0x8200)
0x04 RTWB_RCQ_STS — RTWB_RCQ_STS_OFFSET (0x8204)
0x10 RTWB_RCQ_CTL — RTWB_RCQ_CTL_OFFSET (0x8210)

## R_CAN0 — Car Area Network controller
Base 0x07082000
0x00 CAN_MSEL — CAN mode select register
0x04 CAN_CMD — CAN command register
0x08 CAN_STA — CAN status register
0x0C CAN_INT — CAN interrupt register
0x10 CAN_INTEN — CAN interrupt enable register
0x14 CAN_BUSTIME — CAN bus timing register
0x18 CAN_TEWL — CAN TX error warning limit register
0x1C CAN_ERRC — CAN error counter register
0x20 CAN_RMCNT — CAN receive message counter register
0x24 CAN_RBUF_SADDR — CAN receive buffer start address register
0x28 CAN_ACPC — CAN acceptance code 0 register(reset mode)
0x2C CAN_ACPM — CAN acceptance mask 0 register(reset mode)
{0x40+0x34*i} CAN_TRBUF[{i}] (i=0..12) — CAN TX/RX message buffer N (n=0..12) register
{0x180+0xC0*i} CAN_RBUF_RBACK[{i}] (i=0..47) — CAN transmit buffer for read back register (0x0180 ~0x1b0)

## R_CPUCFG
Base 0x07000400
0x100 CPUIDLE_EN_REG
0x104 CLOSE_FLAG_REG
0x108 CPUIDLE_PEND_REG
0x10C CPUIDLE_WAKE_REG
0x110 CPUIDLE_STAT_REG
0x140 PWR_SW_DELAY_REG
0x144 CONFIG_DELAY_REG
0x148 PWR_DOWN_CFG_REG
{0x150+0x10*i} PWR_UP_CFG_REGn[{i}] (i=0..3)
0x1C0 HOTPLUGFLAG — Check for value 0xFA50392F ?
{0x1C4+0x10*i} SOFTENTRY[{i}] (i=0..3) — The Soft Entry Address Register of CPUx (x=0..1)

## SID — Security ID
Base 0x03006000
0x40 SID_PRCTL
0x60 SID_RDKEY
{0x200+0x400*i} SID_DATA[{i}] (i=0..255) — SID data (xfel display as 'sid' replay)
