# aw_t507 register map
File version: 1.00
Registers are 32-bit, read-write, reset 0x0 unless marked. A register's access mark holds for its fields unless they carry their own. Offsets are from the block's base; [hi:lo] are bit positions; {n}, {i} and the like mark numbered series.

## CCU — Clock Controller Unit (CCU)
Base 0x03001000
0x00 PLL_CPUX_CTRL_REG — PLL_CPUX Control Register
0x10 PLL_DDR0_CTRL_REG — PLL_DDR0 Control Register
0x18 PLL_DDR1_CTRL_REG — PLL_DDR1 Control Register
0x20 PLL_PERI0_CTRL_REG — PLL_PERI0 Control Register
0x28 PLL_PERI1_CTRL_REG — PLL_PERI1 Control Register
0x30 PLL_GPU0_CTRL_REG — PLL_GPU0 Control Register
{0x40+8i} PLL_VIDEO{i}_CTRL_REG (i=0..2) — PLL_VIDEO{i} Control Register
0x58 PLL_VE_CTRL_REG — PLL_VE Control Register
0x60 PLL_DE_CTRL_REG — PLL_DE Control Register
0x78 PLL_AUDIO_CTRL_REG — PLL_AUDIO Control Register
0xE0 PLL_CSI_CTRL_REG — PLL_CSI Control Register
0x110 PLL_DDR0_PAT_CTRL_REG — PLL_DDR0 Pattern Control Register
0x118 PLL_DDR1_PAT_CTRL_REG — PLL_DDR1 Pattern Control Register
0x120 PLL_PERI0_PAT0_CTRL_REG — PLL_PERI0 Pattern0 Control Register
0x124 PLL_PERI0_PAT1_CTRL_REG — PLL_PERI0 Pattern1 Control Register
0x128 PLL_PERI1_PAT0_CTRL_REG — PLL_PERI1 Pattern0 Control Register
0x12C PLL_PERI1_PAT1_CTRL_REG — PLL_PERI1 Pattern1 Control Register
0x130 PLL_GPU0_PAT0_CTRL_REG — PLL_GPU0 Pattern0 Control Register
0x134 PLL_GPU0_PAT1_CTRL_REG — PLL_GPU0 Pattern1 Control Register
{0x140+8i} PLL_VIDEO{i}_PAT0_CTRL_REG (i=0..2) — PLL_VIDEO{i} Pattern0 Control Register
{0x144+8i} PLL_VIDEO{i}_PAT1_CTRL_REG (i=0..2) — PLL_VIDEO{i} Pattern1 Control Register
0x158 PLL_VE_PAT0_CTRL_REG — PLL_VE Pattern0 Control Register
0x15C PLL_VE_PAT1_CTRL_REG — PLL_VE Pattern1 Control Register
0x160 PLL_DE_PAT0_CTRL_REG — PLL_DE Pattern0 Control Register
0x164 PLL_DE_PAT1_CTRL_REG — PLL_DE Pattern1 Control Register
0x178 PLL_AUDIO_PAT0_CTRL_REG — PLL_AUDIO Pattern0 Control Register
0x17C PLL_AUDIO_PAT1_CTRL_REG — PLL_AUDIO Pattern1 Control Register
0x1E0 PLL_CSI_PAT0_CTRL_REG — PLL_CSI Pattern0 Control Register
0x1E4 PLL_CSI_PAT1_CTRL_REG — PLL_CSI Pattern1 Control Register
0x300 PLL_CPUX_BIAS_REG — PLL_CPUX Bias Register
0x310 PLL_DDR0_BIAS_REG — PLL_DDR0 Bias Register
0x318 PLL_DDR1_BIAS_REG — PLL_DDR1 Bias Register
0x320 PLL_PERI0_BIAS_REG — PLL_PERI0 Bias Register
0x328 PLL_PERI1_BIAS_REG — PLL_PERI1 Bias Register
0x330 PLL_GPU0_BIAS_REG — PLL_GPU0 Bias Register
0x340 PLL_VIDEO0_BIAS_REG — PLL_VIDEO0 Bias Register
0x348 PLL_VIDEO1_BIAS_REG — PLL_VIDEO1 Bias Register
0x358 PLL_VE_BIAS_REG — PLL_VE Bias Register
0x360 PLL_DE_BIAS_REG — PLL_DE Bias Register
0x378 PLL_AUDIO_BIAS_REG — PLL_AUDIO Bias Register
0x3E0 PLL_CSI_BIAS_REG — PLL_CSI Bias Register
0x400 PLL_CPUX_TUN_REG — PLL_CPUX Tuning Register
0x500 CPUX_AXI_CFG_REG — CPUX_AXI Configuration Register
0x510 PSI_AHB1_AHB2_CFG_REG — PSI_AHB1_AHB2 Configuration Register
0x51C AHB3_CFG_REG — AHB3 Configuration Register
0x520 APB1_CFG_REG — APB1 Configuration Register
0x524 APB2_CFG_REG — APB2 Configuration Register
0x540 MBUS_CFG_REG — MBUS Configuration Register
0x600 DE_CLK_REG — DE Clock Register
0x60C DE_BGR_REG — DE Bus Gating Reset Register
0x620 DI_CLK_REG — DI Clock Register
0x62C DI_BGR_REG — DI Bus Gating Reset Register
0x630 G2D_CLK_REG — G2D Clock Register
0x63C G2D_BGR_REG — G2D Bus Gating Reset Register
0x670 GPU_CLK0_REG — GPU Clock0 Register
0x674 GPU_CLK1_REG — GPU Clock1 Register
0x67C GPU_BGR_REG — GPU Bus Gating Reset Register
0x680 CE_CLK_REG — CE Clock Register
0x68C CE_BGR_REG — CE Bus Gating Reset Register
0x690 VE_CLK_REG — VE Clock Register
0x69C VE_BGR_REG — VE Bus Gating Reset Register
0x70C DMA_BGR_REG — DMA Bus Gating Reset Register
0x73C HSTIMER_BGR_REG — HSTIMER Bus Gating Reset Register
0x740 AVS_CLK_REG — AVS Clock Register
0x78C DBGSYS_BGR_REG — DBGSYS Bus Gating Reset Register
0x79C PSI_BGR_REG — PSI Bus Gating Reset Register
0x7AC PWM_BGR_REG — PWM Bus Gating Reset Register
0x7BC IOMMU_BGR_REG — IOMMU Bus Gating Reset Register
0x800 DRAM_CLK_REG — DRAM Clock Register
0x804 MBUS_MAT_CLK_GATING_REG — MBUS Master Clock Gating Register
0x80C DRAM_BGR_REG — DRAM Bus Gating Reset Register
0x810 NAND0_0_CLK_REG — NAND0_0 Clock Register
0x814 NAND0_1_CLK_REG — NAND0_1 Clock Register
0x82C NAND_BGR_REG — NAND Bus Gating Reset Register
{0x830+4i} SMHC{i}_CLK_REG (i=0..2) — SMHC{i} Clock Register
0x84C SMHC_BGR_REG — SMHC Bus Gating Reset Register
0x90C UART_BGR_REG — UART Bus Gating Reset Register
0x91C TWI_BGR_REG — TWI Bus Gating Reset Register
0x940 SPI0_CLK_REG — SPI0 Clock Register
0x944 SPI1_CLK_REG — SPI1 Clock Register
0x96C SPI_BGR_REG — SPI Bus Gating Reset Register
0x970 EPHY_25M_CLK_REG — EPHY_25M Clock Register
0x97C EMAC_BGR_REG — EMAC Bus Gating Reset Register
0x9B0 TS_CLK_REG — TS Clock Register
0x9BC TS_BGR_REG — TS Bus Gating Reset Register
0x9EC GPADC_BGR_REG — GPADC Bus Gating Reset Register
0x9FC THS_BGR_REG — THS Bus Gating Reset Register
0xA20 OWA_CLK_REG — OWA Clock Register
0xA2C OWA_BGR_REG — OWA Bus Gating Reset Register
0xA40 DMIC_CLK_REG — DMIC Clock Register
0xA4C DMIC_BGR_REG — DMIC Bus Gating Reset Register
0xA50 AUDIO_CODEC_1X_CLK_REG — AUDIO CODEC 1X Clock Register
0xA54 AUDIO_CODEC_4X_CLK_REG — AUDIO CODEC 4X Clock Register
0xA5C AUDIO_CODEC_BGR_REG — AUDIO CODEC Bus Gating Reset Register
0xA60 AUDIO_HUB_CLK_REG — AUDIO_HUB Clock Register
0xA6C AUDIO_HUB_BGR_REG — AUDIO_HUB Bus Gating Reset Register
{0xA70+4i} USB{i}_CLK_REG (i=0..3) — USB{i} Clock Register
0xA8C USB_BGR_REG — USB Bus Gating Reset Register
0xA9C LRADC_BGR_REG — LRADC Bus Gating Reset Register
0xB00 HDMI0_CLK_REG — HDMI0 Clock Register
0xB04 HDMI0_SLOW_CLK_REG — HDMI0 Slow Clock Register
0xB10 HDMI_CEC_CLK_REG — HDMI CEC Clock Register
0xB1C HDMI_BGR_REG — HDMI Bus Gating Reset Register
0xB5C DISPLAY_IF_TOP_BGR_REG — DISPLAY_IF_TOP BUS GATING RESET Register
0xB60 TCON_LCD0_CLK_REG — TCON LCD0 Clock Register
0xB64 TCON_LCD1_CLK_REG — TCON LCD1 Clock Register
0xB7C TCON_LCD_BGR_REG — TCON LCD BUS GATING RESET Register
0xB80 TCON_TV0_CLK_REG — TCON TV0 Clock Register
0xB84 TCON_TV1_CLK_REG — TCON TV1 Clock Register
0xB9C TCON_TV_BGR_REG — TCON TV GATING RESET Register
0xBAC LVDS_BGR_REG — LVDS BUS GATING RESET Register
0xBB0 TVE0_CLK_REG — TVE0 Clock Register
0xBBC TVE_BGR_REG — TVE BUS GATING RESET Register
0xC04 CSI_TOP_CLK_REG — CSI TOP Clock Register
0xC08 CSI_MST_CLK0_REG — CSI_Master Clock0 Register
0xC0C CSI_MST_CLK1_REG — CSI_Master Clock1 Register
0xC2C CSI_BGR_REG — CSI Bus Gating Reset Register
0xC40 HDMI_HDCP_CLK_REG — HDMI HDCP Clock Register
0xC4C HDMI_HDCP_BGR_REG — HDMI HDCP Bus Gating Reset Register
0xF00 CCU_SEC_SWITCH_REG — CCU Security Switch Register
0xF04 PLL_LOCK_DBG_CTRL_REG — PLL Lock Debug Control Register
0xF08 FRE_DET_CTRL_REG — Frequency Detect Control Register
0xF0C FRE_UP_LIM_REG — Frequency Up Limit Register
0xF10 FRE_DOWN_LIM_REG — Frequency Down Limit Register
0xF20 CCU_24M_27M_CLK_OUTPUT_REG — 24M or 27M Clock Output Register
