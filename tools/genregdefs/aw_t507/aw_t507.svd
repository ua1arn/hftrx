# aw_t507 register map
File version: 1.00
Registers are 32-bit, read-write, reset 0x0 unless marked. A register's access mark holds for its fields unless they carry their own. Offsets are from the block's base; [hi:lo] are bit positions; lines under a group give offsets from that group; {n}, {i} and the like mark numbered series.

## GPIOINTA
Base 0x0300B200
Same registers: GPIOINTC 0x0300B240, GPIOINTD 0x0300B260, GPIOINTE 0x0300B280, GPIOINTF 0x0300B2A0, GPIOINTG 0x0300B2C0, GPIOINTH 0x0300B2E0, GPIOINTI 0x0300B300
{0x0+0x10*i} EINT_CFG[{i}] (i=0..3) — External Interrupt Configure Registers
0x10 EINT_CTL — External Interrupt Control Register
0x14 EINT_STATUS — External Interrupt Status Register
0x18 EINT_DEB — External Interrupt Debounce Register

## GPU_JOB_CONTROL
Base 0x01801000
0x00 JOB_INT_RAWSTAT — Internal Interrupt Status
0x04 JOB_INT_CLEAR
0x08 JOB_INT_MASK
0x0C JOB_INT_STATUS
0x10 JOB_IRQ_RAWSTAT — Raw interrupt status register - External IRQ Line Status
0x14 JOB_IRQ_CLEAR — Interrupt clear register
0x18 JOB_IRQ_MASK — Interrupt mask register
0x1C JOB_IRQ_STATUS — Interrupt status register
{0x800+0x180*i} unnamed[{i}] (i=0..2) group
  0x00 JS_HEAD_LO
  0x04 JS_HEAD_HI
  0x08 JS_TAIL_LO
  0x0C JS_TAIL_HI
  0x10 JS_AFFINITY_LO
  0x14 JS_AFFINITY_HI
  0x18 JS_CONFIG
  0x1C JS_XAFFINITY
  0x20 JS_COMMAND
  0x24 JS_STATUS
  0x40 JS_HEAD_NEXT_LO
  0x44 JS_HEAD_NEXT_HI
  0x50 JS_AFFINITY_NEXT_LO
  0x54 JS_AFFINITY_NEXT_HI
  0x58 JS_CONFIG_NEXT
  0x60 JS_COMMAND_NEXT
  0x70 JS_FLUSH_ID_NEXT

## GPU_MMU
Base 0x01802000
0x00 MMU_IRQ_RAWSTAT — (RW) Raw interrupt status register
0x04 MMU_IRQ_CLEAR — (WO) Interrupt clear register
0x08 MMU_IRQ_MASK — (RW) Interrupt mask register
0x0C MMU_IRQ_STATUS — (RO) Interrupt status register
{0x400+0x200*i} unnamed[{i}] (i=0..7) group
  0x00 AS_TRANSTAB_LO — (RW) Translation Table Base Address for address space n, low word
  0x04 AS_TRANSTAB_HI — (RW) Translation Table Base Address for address space n, high word
  0x08 AS_MEMATTR_LO — (RW) Memory attributes for address space n, low word.
  0x0C AS_MEMATTR_HI — (RW) Memory attributes for address space n, high word.
  0x10 AS_LOCKADDR_LO — (RW) Lock region address for address space n, low word
  0x14 AS_LOCKADDR_HI — (RW) Lock region address for address space n, high word
  0x18 AS_COMMAND — (WO) MMU command register for address space n
  0x1C AS_FAULTSTATUS — (RO) MMU fault status register for address space n
  0x20 AS_FAULTADDRESS_LO — (RO) Fault Address for address space n, low word
  0x24 AS_FAULTADDRESS_HI — (RO) Fault Address for address space n, high word
  0x28 AS_STATUS — (RO) Status flags for address space n
  0x30 AS_TRANSCFG_LO — (RW) Translation table configuration for address space n, low word
  0x34 AS_TRANSCFG_HI — (RW) Translation table configuration for address space n, high word
  0x38 AS_FAULTEXTRA_LO — (RO) Secondary fault address for address space n, low word
  0x3C AS_FAULTEXTRA_HI — (RO) Secondary fault address for address space n, high word

## HSTIMER — High Speed Timer (HSTimer)
Base 0x03005000
0x00 HS_TMR_IRQ_EN_REG — HS Timer IRQ Enable Register
0x04 HS_TMR_IRQ_STAS_REG — HS Timer Status Register
0x20 HS_TMR0_CTRL_REG — HS Timer0 Control Register
0x24 HS_TMR0_INTV_LO_REG — HS Timer0 Interval Value Low Register
0x28 HS_TMR0_INTV_HI_REG — HS Timer0 Interval Value High Register
0x2C HS_TMR0_CURNT_LO_REG — HS Timer0 Current Value Low Register
0x30 HS_TMR0_CURNT_HI_REG — HS Timer0 Current Value High Register
0x40 HS_TMR1_CTRL_REG — HS Timer1 Control Register
0x44 HS_TMR1_INTV_LO_REG — HS Timer1 Interval Value Low Register
0x48 HS_TMR1_INTV_HI_REG — HS Timer1 Interval Value High Register
0x4C HS_TMR1_CURNT_LO_REG — HS Timer1 Current Value Low Register
0x50 HS_TMR1_CURNT_HI_REG — HS Timer1 Current Value High Register

## I2S0
Base 0x05097200
Same registers: I2S1 0x05097300, I2S2 0x05097400, I2S3 0x05097500
0x00 I2Sn_CTL — I2Sn Control
0x04 I2Sn_FMT0 — I2Sn Format 0
0x08 I2Sn_FMT1 — I2Sn Format 1
0x0C I2Sn_CLKD — I2Sn Clock Divide
0x20 I2Sn_RXDIF_CONT — I2Sn RXDIF Contact Select
0x24 I2Sn_CHCFG — I2Sn Channel Configuration
0x28 I2Sn_IRQ_CTRL — I2Sn DMA & Interrupt Control
0x2C I2Sn_IRQ_STS — I2Sn DMA & Interrupt Status
{0x30+0x40*i} unnamed[{i}] (i=0..3) group
  0x00 I2Sn_SDOUTm_SLOTCTR — (n=0~3)(m=0~3)
  0x04 I2Sn_SDOUTmCHMAP0 — I2Sn SDOUTm Channel Mapping 0
  0x08 I2Sn_SDOUTmCHMAP1 — I2Sn SDOUTm Channel Mapping 1
0x70 I2Sn_SDIN_SLOTCTR — I2Sn Input Slot Control
{0x74+0x10*i} I2Sn_SDINCHMAP[{i}] (i=0..3) — I2Sn SDIN Channel Mapping 0..3
