# aw_t507 register map
File version: 1.00
Registers are 32-bit, read-write, reset 0x0 unless marked. A register's access mark holds for its fields unless they carry their own. Offsets are from the block's base; [hi:lo] are bit positions.

## AUDIO_CODEC
Base 0x05096000
0x00 AC_DAC_DPC — DAC Digital Part Control Register
0x10 AC_DAC_FIFOC — DAC FIFO Control Register
0x14 AC_DAC_FIFOS — DAC FIFO Status Register
0x20 AC_DAC_TXDATA — DAC TX DATA Register
0x24 AC_DAC_CNT — DAC TX FIFO Counter Register
0x28 AC_DAC_DG — DAC Debug Register
0xF0 AC_DAC_DAP_CTRL — DAC DAP Control Register
0x100 AC_DAC_DRC_HHPFC — DAC DRC High HPF Coef Register
0x104 AC_DAC_DRC_LHPFC — DAC DRC Low HPF Coef Register
0x108 AC_DAC_DRC_CTRL — DAC DRC Control Register
0x10C AC_DAC_DRC_LPFHAT — DAC DRC Left Peak Filter High Attack Time Coef Register
0x110 AC_DAC_DRC_LPFLAT — DAC DRC Left Peak Filter Low Attack Time Coef Register
0x114 AC_DAC_DRC_RPFHAT — DAC DRC Right Peak Filter High Attack Time Coef Register
0x118 AC_DAC_DRC_RPFLAT — DAC DRC Right Peak Filter Low Attack Time Coef Register
0x11C AC_DAC_DRC_LPFHRT — DAC DRC Left Peak Filter High Release Time Coef Register
0x120 AC_DAC_DRC_LPFLRT — DAC DRC Left Peak Filter Low Release Time Coef Register
0x124 AC_DAC_DRC_RPFHRT — DAC DRC Right Peak filter High Release Time Coef Register
0x128 AC_DAC_DRC_RPFLRT — DAC DRC Right Peak filter Low Release Time Coef Register
0x12C AC_DAC_DRC_LRMSHAT — DAC DRC Left RMS Filter High Coef Register
0x130 AC_DAC_DRC_LRMSLAT — DAC DRC Left RMS Filter Low Coef Register
0x134 AC_DAC_DRC_RRMSHAT — DAC DRC Right RMS Filter High Coef Register
0x138 AC_DAC_DRC_RRMSLAT — DAC DRC Right RMS Filter Low Coef Register
0x13C AC_DAC_DRC_HCT — DAC DRC Compressor Threshold High Setting Register
0x140 AC_DAC_DRC_LCT — DAC DRC Compressor Slope High Setting Register
0x144 AC_DAC_DRC_HKC — DAC DRC Compressor Slope High Setting Register
0x148 AC_DAC_DRC_LKC — DAC DRC Compressor Slope Low Setting Register
0x14C AC_DAC_DRC_HOPC — DAC DRC Compressor High Output at Compressor Threshold Register
0x150 AC_DAC_DRC_LOPC — DAC DRC Compressor Low Output at Compressor Threshold Register
0x154 AC_DAC_DRC_HLT — DAC DRC Limiter Threshold High Setting Register
0x158 AC_DAC_DRC_LLT — DAC DRC Limiter Threshold Low Setting Register
0x15C AC_DAC_DRC_HKl — DAC DRC Limiter Slope High Setting Register
0x160 AC_DAC_DRC_LKl — DAC DRC Limiter Slope Low Setting Register
0x164 AC_DAC_DRC_HOPL — DAC DRC Limiter High Output at Limiter Threshold
0x168 AC_DAC_DRC_LOPL — DAC DRC Limiter Low Output at Limiter Threshold
0x16C AC_DAC_DRC_HET — DAC DRC Expander Threshold High Setting Register
0x170 AC_DAC_DRC_LET — DAC DRC Expander Threshold Low Setting Register
0x174 AC_DAC_DRC_HKE — DAC DRC Expander Slope High Setting Register
0x178 AC_DAC_DRC_LKE — DAC DRC Expander Slope Low Setting Register
0x17C AC_DAC_DRC_HOPE — DAC DRC Expander High Output at Expander Threshold
0x180 AC_DAC_DRC_LOPE — DAC DRC Expander Low Output at Expander Threshold
0x184 AC_DAC_DRC_HKN — DAC DRC Linear Slope High Setting Register
0x188 AC_DAC_DRC_LKN — DAC DRC Linear Slope Low Setting Register
0x18C AC_DAC_DRC_SFHAT — DAC DRC Smooth Filter
0x190 AC_DAC_DRC_SFLAT — DAC DRC Smooth Filter
0x194 AC_DAC_DRC_SFHRT — DAC DRC Smooth Filter Gain High Release Time Coef Register
0x198 AC_DAC_DRC_SFLRT — DAC DRC Smooth Filter
0x19C AC_DAC_DRC_MXGHS — DAC DRC MAX Gain High Setting Register
0x1A0 AC_DAC_DRC_MXGLS — DAC DRC MAX Gain Low Setting Register
0x1A4 AC_DAC_DRC_MNGHS — DAC DRC MIN Gain High Setting Register
0x1A8 AC_DAC_DRC_MNGLS — DAC DRC MIN Gain Low Setting Register
0x1AC AC_DAC_DRC_EPSHC — DAC DRC Expander Smooth Time High Coef Register
0x1B0 AC_DAC_DRC_EPSLC — DAC DRC Expander Smooth Time Low Coef Register
0x1B8 AC_DAC_DRC_HPFHGAIN — DAC DRC HPF Gain High Coef Register
0x1BC AC_DAC_DRC_HPFLGAIN — DAC DRC HPF Gain Low Coef Register
0x310 DAC_REG — DAC Analog Control Register
0x314 MIXER_REG — MIXER Analog Control Register
0x31C RAMP_REG — RAMP Control Register
