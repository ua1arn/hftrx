# aw_t507 register map
File version: 1.00
Registers are 32-bit, read-write, reset 0x0 unless marked. A register's access mark holds for its fields unless they carry their own. Offsets are from the block's base; [hi:lo] are bit positions; {n}, {i} and the like mark numbered series.

## CSIC
Base 0x06600000
Same registers: CSIC_CCU 0x06600000
0x00 CCU_CLK_MODE_REG — CCU Clock Mode Register
0x04 CCU_PARSER_CLK_EN_REG — CCU Parser Clock Enable Register
0x0C CCU_POST0_CLK_EN_REG — CCU Post0 Clock Enable Register
0x10 CCU_POST1_CLK_EN_REG — CCU Post1 Clock Enable Register

## CSIC_PARSER0
Base 0x06601000
Same registers: CSIC_PARSER1 0x06602000
0x00 PRS_EN_REG — Parser Enable Register
0x04 PRS_NCSIC_IF_CFG_REG — Parser NCSIC Interface Configuration Register
0x08 PRS_MCSIC_IF_CFG_REG — Parser MCSIC Interface Configuration Register
0x0C PRS_CAP_REG — Parser Capture Register
0x10 PRS_SIGNAL_STA_REG — Parser Signal Status Register
0x14 PRS_NCSIC_BT656_HEAD_CFG_REG — Parser NCSIC BT656 Header Configuration Register
{0x24+0x100*i} PRS_C{i}_INFMT_REG (i=0..3) — Parser Channel_{i} Input Format Register
{0x28+0x100*i} PRS_C{i}_OUTPUT_HSIZE_REG (i=0..3) — Parser Channel_{i} Output Horizontal Size Register
{0x2C+0x100*i} PRS_C{i}_OUTPUT_VSIZE_REG (i=0..3) — Parser Channel_{i} Output Vertical Size Register
{0x30+0x100*i} PRS_C{i}_INPUT_PARA0_REG (i=0..3) — Parser Channel_{i} Input Parameter0 Register
{0x34+0x100*i} PRS_C{i}_INPUT_PARA1_REG (i=0..3) — Parser Channel_{i} Input Parameter1 Register
{0x38+0x100*i} PRS_C{i}_INPUT_PARA2_REG (i=0..3) — Parser Channel_{i} Input Parameter2 Register
{0x3C+0x100*i} PRS_C{i}_INPUT_PARA3_REG (i=0..3) — Parser Channel_{i} Input Parameter3 Register
{0x40+0x100*i} PRS_C{i}_INT_EN_REG (i=0..3) — Parser Channel_{i} Interrupt Enable Register
{0x44+0x100*i} PRS_C{i}_INT_STA_REG (i=0..3) — Parser Channel_{i} Interrupt Status Register
{0x48+0x100*i} PRS_CH{i}_LINE_TIME_REG (i=0..3) — Parser Channel_{i} Line Time Register
{0x500+4i} PRS_NCSIC_RX_SIGNAL{i}_DLY_ADJ_REG (i=0..6) — Parser NCSIC RX Signal{i} Delay Adjust Register
0x520 PRS_NCSIC_SYNC_EN_REG — Parser NCSIC SYNC Enable Register
0x524 PRS_NCSIC_SYNC_CFG_REG — Parser NCSIC SYNC CFG Register
0x528 PRS_NCSIC_SYNC_WAIT_N_REG — Parser NCSIC SYNC WAIT N Register
0x52C PRS_NCSIC_SYNC_WAIT_M_REG — Parser NCSIC SYNC WAIT M Register

## CSIC_TOP
Base 0x06600800
0x00 CSIC_TOP_EN_REG — CSIC TOP Enable Register
{0xA0+4i} CSIC_DMA{i}_INPUT_SEL_REG (i=0..3) — CSIC DMA{i} Input Select Register
0xDC CSIC_BIST_CS_REG — CSIC BIST CS Register
0xE0 CSIC_BIST_CONTROL_REG — CSIC BIST Control Register
0xE4 CSIC_BIST_START_REG — CSIC BIST Start Register
0xE8 CSIC_BIST_END_REG — CSIC BIST End Register
0xEC CSIC_BIST_DATA_MASK_REG — CSIC BIST Data Mask Register
0xF0 CSIC_MBUS_REQ_MAX_REG — CSIC MBUS REQ MAX Register

## CSIC_CCI0
Base 0x06614000
Same registers: CSIC_CCI1 0x06614400
0x00 CCI_CTRL — CCI Control Register
0x04 CCI_CFG — CCI Transmission Configuration Register
0x08 CCI_FMT — CCI Packet Format Register
0x0C CCI_BUS_CTRL — CCI Bus Control Register
0x14 CCI_INT_CTRL — CCI Interrupt Control Register
0x18 CCI_LC_TRIG — CCI Line Counter Trigger Register
{0x100+0x40*i} CCI_FIFO_ACC[{i}] (i=0..15) — CCI FIFO Access Register
{0x200+0x24*i} CCI_RSV_REG[{i}] (i=0..8) — CCI Reserved Register

## CSIC_DMA0
Base 0x06609000
Same registers: CSIC_DMA1 0x06609200, CSIC_DMA2 0x06609400, CSIC_DMA3 0x06609600, CSIC_DMA4 0x06609800, CSIC_DMA5 0x06609A00
0x00 CSIC_DMA_EN_REG — CSIC DMA Enable Register
0x04 CSIC_DMA_CFG_REG — CSIC DMA Configuration Register
0x10 CSIC_DMA_HSIZE_REG — CSIC DMA Horizontal Size Register
0x14 CSIC_DMA_VSIZE_REG — CSIC DMA Vertical Size Register
{0x20+8i} CSIC_DMA_F{i}_BUFA_REG (i=0..2) — CSIC DMA FIFO {i} Output Buffer-A Address Register
{0x24+8i} CSIC_DMA_F{i}_BUFA_RESULT_REG (i=0..2) — CSIC DMA FIFO {i} Output Buffer-A Address Result Register
0x38 CSIC_DMA_BUF_LEN_REG — CSIC DMA Buffer Length Register
0x3C CSIC_DMA_FLIP_SIZE_REG — CSIC DMA Flip Size Register
0x40 CSIC_DMA_VI_TO_TH0_REG — CSIC DMA Video Input Timeout Threshold0 Register
0x44 CSIC_DMA_VI_TO_TH1_REG — CSIC DMA Video Input Timeout Threshold1 Register
0x48 CSIC_DMA_VI_TO_CNT_VAL_REG — CSIC DMA Video Input Timeout Counter Value Register
0x4C CSIC_DMA_CAP_STA_REG — CSIC DMA Capture Status Register
0x50 CSIC_DMA_INT_EN_REG — CSIC DMA Interrupt Enable Register
0x54 CSIC_DMA_INT_STA_REG — CSIC DMA Interrupt Status Register
0x58 CSIC_DMA_LINE_CNT_REG — CSIC DMA LINE COUNTER Register
0x5C CSIC_DMA_FRM_CNT_REG — CSIC DMA Frame Counter Register
0x60 CSIC_DMA_FRM_CLK_CNT_REG — CSIC DMA Frame Clock Counter Register
0x64 CSIC_DMA_ACC_ITNL_CLK_CNT_REG — CSIC DMA Accumulated And Internal Clock Counter Register
0x68 CSIC_DMA_FIFO_STAT_REG — CSIC DMA FIFO Statistic Register
0x6C CSIC_DMA_FIFO_THRS_REG — CSIC DMA FIFO Threshold Register
0x70 CSIC_DMA_PCLK_STAT_REG — CSIC DMA PCLK Statistic Register
{0x80+4i} CSIC_DMA_BUF_ADDR_FIFO{i}_ENTRY_REG (i=0..2) — CSIC DMA BUF Address FIFO{i} Entry Register
0x8C CSIC_DMA_BUF_TH_REG — CSIC DMA BUF Threshold Register
0x90 CSIC_DMA_BUF_ADDR_FIFO_CON_REG — CSIC DMA BUF Address FIFO Content Register
0x94 CSIC_DMA_STORED_FRM_CNT_REG — CSIC DMA Stored Frame Counter Register
0x1F4 CSIC_FEATURE_REG — CSIC DMA Feature List Register
