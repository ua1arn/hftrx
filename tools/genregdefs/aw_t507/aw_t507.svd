# aw_t507 register map
File version: 1.00
Registers are 32-bit, read-write, reset 0x0 unless marked. A register's access mark holds for its fields unless they carry their own. Offsets are from the block's base; [hi:lo] are bit positions; lines under a group give offsets from that group; {n}, {i} and the like mark numbered series.

## G2D_ROT — Graphic 2D Rotate
Base 0x014A8000
0x00 ROT_CTL
0x04 ROT_INT
0x08 ROT_TIMEOUT
0x20 ROT_IFMT — Input data attribute register
0x24 ROT_ISIZE — Input data size register
0x30 ROT_IPITCH0 — Input Y/RGB/ARGB memory pitch register
0x34 ROT_IPITCH1 — Input U/UV memory pitch register
0x38 ROT_IPITCH2 — Input V memory pitch register
0x40 ROT_ILADD0 — Input Y/RGB/ARGB memory address register0
0x44 ROT_IHADD0 — Input Y/RGB/ARGB memory address register1
0x48 ROT_ILADD1 — Input U/UV memory address register0
0x4C ROT_IHADD1 — Input U/UV memory address register1
0x50 ROT_ILADD2 — Input V memory address register0
0x54 ROT_IHADD2 — Input V memory address register1
0x84 ROT_OSIZE — Output data size register
0x90 ROT_OPITCH0 — Output Y/RGB/ARGB memory pitch register
0x94 ROT_OPITCH1 — Output U/UV memory pitch register
0x98 ROT_OPITCH2 — Output V memory pitch register
0xA0 ROT_OLADD0 — Output Y/RGB/ARGB memory address register0
0xA4 ROT_OHADD0 — Output Y/RGB/ARGB memory address register1
0xA8 ROT_OLADD1 — Output U/UV memory address register0
0xAC ROT_OHADD1 — Output U/UV memory address register1
0xB0 ROT_OLADD2 — Output V memory address register0
0xB4 ROT_OHADD2 — Output V memory address register1
0xC8 LBC_ENC_CTL — Encode control (bit 31 - is lossy)
0xCC LBC_CTL
0xD0 LBC_DEC_CTL — Decode control (bit 31 - is lossy)

## G2D — Graphic 2D top
Base 0x01480000
Same registers: G2D_TOP 0x01480000
0x00 G2D_SCLK_GATE
0x04 G2D_HCLK_GATE
0x08 G2D_AHB_RST
0x0C G2D_SCLK_DIV
0x10 G2D_VERSION

## GICVSELF
Base 0x03024000
Same registers: GICV 0x03025000
0x00 GICH_HCR — RW 0x00000000 Hypervisor Control Register
0x04 GICH_VTR — RO 0x90000003 VGIC Type Register, GICH_VTR on page 3-13
0x08 GICH_VMCR — RW 0x004C0000 Virtual Machine Control Register
0x10 GICH_MISR — RO 0x00000000 Maintenance Interrupt Status Register
0x20 GICH_EISR0 — RO 0x00000000 End of Interrupt Status Register
0x30 GICH_ELSR0 — RO 0x0000000F Empty List register Status Register
0xF0 GICH_APR0 — RW 0x00000000 Active Priority Register
{0x100+4i} GICH_LR{i} (i=0..3) — RW 0x00000000 List Register {i}

## GPADC — General Purpose ADC
Base 0x05070000
0x00 GP_SR_CON — GPADC Sample Rate Configure Register
0x04 GP_CTRL — GPADC Control Register
0x08 GP_CS_EN — GPADC
0x0C GP_FIFO_INTC — GPADC FIFO Interrupt Control Register
0x10 GP_FIFO_INTS — GPADC FIFO Interrupt Status Register
0x14 GP_FIFO_DATA — GPADC FIFO Data Register
0x18 GP_CDATA — GPADC Calibration Data Register
0x20 GP_DATAL_INTC — GPADC Data Low Interrupt Configure Register
0x24 GP_DATAH_INTC — GPADC Data High Interrupt Configure Register
0x28 GP_DATA_INTC — GPADC Data Interrupt Configure Register
0x30 GP_DATAL_INTS — GPADC Data Low Interrupt Status Register
0x34 GP_DATAH_INTS — GPADC Data High Interrupt Status Register
0x38 GP_DATA_INTS — GPADC Data Interrupt Status Register
{0x40+4i} GP_CH{i}_CMP_DATA (i=0..3) — GPADC CH{i} Compare Data Register
{0x80+4i} GP_CH{i}_DATA (i=0..3) — GPADC CH{i} Data Register

## GPIOA — Port Controller
Base 0x0300B000
Same registers: GPIOC 0x0300B048, GPIOD 0x0300B06C, GPIOE 0x0300B090, GPIOF 0x0300B0B4, GPIOG 0x0300B0D8, GPIOH 0x0300B0FC, GPIOI 0x0300B120, GPIOL 0x07022000
{0x0+0x10*i} CFG[{i}] (i=0..3) — Configure Register
0x10 DATA
{0x14+8i} DRV[{i}] (i=0..1) — Multi_Driving Register
{0x1C+8i} PULL[{i}] (i=0..1)

## GPIOBLOCK — Port Controller
Base 0x0300B000
{0x0+0x144*i} unnamed[{i}] (i=0..8) group
  {0x0+0x10*j} CFG[{j}] (j=0..3) — Configure Register
  0x10 DATA
  {0x14+8j} DRV[{j}] (j=0..1) — Multi_Driving Register
  {0x1C+8j} PULL[{j}] (j=0..1)
{0x200+0x120*i} unnamed[{i}] (i=0..8) group
  {0x0+0x10*j} EINT_CFG[{j}] (j=0..3) — External Interrupt Configure Registers
  0x10 EINT_CTL — External Interrupt Control Register
  0x14 EINT_STATUS — External Interrupt Status Register
  0x18 EINT_DEB — External Interrupt Debounce Register
0x340 PIO_POW_MOD_SEL — PIO Group Withstand Voltage Mode Select Register
0x344 PIO_POW_MS_CTL — PIO Group Withstand Voltage Mode Select Control Register
0x348 PIO_POW_VAL — PIO Group Power Value Register
