# aw_t507 register map
File version: 1.00
Registers are 32-bit, read-write, reset 0x0 unless marked. A register's access mark holds for its fields unless they carry their own. Offsets are from the block's base; [hi:lo] are bit positions; lines under a group give offsets from that group; {n}, {i} and the like mark numbered series.

## AHUB — Audio HUB
Base 0x05097000
0x08 AHUB_RST — AHUB Reset
0x0C AHUB_GAT — AHUB Gating
{0x10+0x90*i} unnamed[{i}] (i=0..2) group
  0x00 APBIF_TXn_CTRL — APBIF TXn Control
  0x04 APBIF_TXnIRQ_CTRL — APBIF TXn DMA & Interrupt Control
  0x08 APBIF_TXnIRQ_STS — AHUB APBIF TXn DMA & Interrupt Status
  0x10 APBIF_TXnFIFO_CTRL — AHUB APBIF TXn FIFO Control
  0x14 APBIF_TXnFIFO_STS — APBIF TXn FIFO Status
  0x20 APBIF_TXnFIFO
  0x24 APBIF_TXnFIFO_CNT — APBIF TXn FIFO Counter
{0x100+0x90*i} unnamed[{i}] (i=0..2) group
  0x00 APBIF_RXn_CTRL — APBIF RXn Control
  0x04 APBIF_RXnIRQ_CTRL — APBIF RXn DMA & Interrupt Control
  0x08 APBIF_RXnIRQ_STS — APBIF RXn DMA & Interrupt Status
  0x10 APBIF_RXnFIFO_CTRL — APBIF RXn FIFO Control
  0x14 APBIF_RXnFIFO_STS — APBIF RX0 FIFO Status
  0x18 APBIF_RXn_CONT — APBIF RXn Contact Select
  0x20 APBIF_RXnFIFO
  0x24 APBIF_RXnFIFO_CNT — APBIF RXn FIFO Counter
{0xA00+0x100*i} unnamed[{i}] (i=0..1) group
  0x00 DAMn_CTRL — DAM Control
  {0x10+0xC*j} DAMn_RXx_SRC[{j}] (j=0..2) — DAM RXDIF0..RXDIF2 Source Select
  {0x30+0x20*j} DAMn_MIX_CTRLx[{j}] (j=0..7) — DAM MIX Control 0..7
  {0x50+0x20*j} DAMn_GAIN_CTRLx[{j}] (j=0..7) — DAM GAIN Control 0..7

## C0_CPUX_CFG — T507/H618 Cluster 0 Configuration Register List
Base 0x09010000
0x00 C0_RST_CTRL — Cluster 0 Reset Control Register
{0x10+4i} C0_CTRL_REG{i} (i=0..2) — Cluster 0 Control Register{i}
0x24 CACHE_CFG_REG — Cache Configuration Register
{0x60+0x10*i} C0_CPUx_CTRL_REG[{i}] (i=0..3) — Cluster 0 CPU0..CPU03 Control Register
0x80 C0_CPU_STATUS — Cluster 0 CPU Status Register
0x84 L2_STATUS_REG — Cluster 0 L2 Status Register

## C0_CPUX_CFG_H616 — H616 Cluster 0 Configuration Register List
Base 0x09010000
Registers as C0_CPUX_CFG, without C0_CPUx_CTRL_REG; these are added or differ:
{0x40+0x20*i} unnamed[{i}] (i=0..3) group
  0x00 LOW — Reset Vector Base Address Registerx_L
  0x04 HIGH — Reset Vector Base Address Registerx_H
0xC0 DBG_REG0 — Cluster 0 Debug State Register0
0xC4 DBG_REG1 — Cluster 0 Debug State Register1

## CE_NS — The Crypto Engine (CE) module
Base 0x01904000
Same registers: CE_S 0x01904800
0x00 CE_TDA — Task Descriptor Address
0x08 CE_ICR — Interrupt Control Register
0x0C CE_ISR — Interrupt Status Register
0x10 CE_TLR — Task Load Register
0x14 CE_TSR — Task Status Register
0x18 CE_ESR — Error Status Register
0x24 CE_SCSA — Symmetric Algorithm DMA Current Source Address
0x28 CE_SCDA — Symmetric Algorithm DMA Current Destination Address
0x34 CE_HCSA — HASH Algorithm DMA Current Source Address
0x38 CE_HCDA — HASH Algorithm DMA Current Destination Address
0x44 CE_ACSA — Asymmetric Algorithm DMA Current Source Address
0x48 CE_ACDA — Asymmetric Algorithm DMA Current Destination Address
0x54 CE_XCSA — XTS Algorithm DMA Current Source Address
0x58 CE_XCDA — XTS Algorithm DMA Current Destination Address

## CPU_SUBSYS_CTRL — T507/H618 CPU Subsystem Control Register List
Base 0x08100000
0x00 GENER_CTRL_REG0 — General Control Register0
0x04 GENER_CTRL_REG1 — General Control Register1
0x0C GIC_JTAG_RST_CTRL — GIC and Jtag Reset Control Register
0x10 C0_INT_EN — Cluster0 Interrupt Enable Control Register
0x14 IRQ_FIQ_STATUS
0x18 GENER_CTRL_REG2 — General Control Register2
0x1C DBG_STATE — Debug State Register
{0x20+0x10*i} CPUx_CTRL_REG[{i}] (i=0..3) — CPU0..CPU3 Control Register
{0x40+0x20*i} unnamed[{i}] (i=0..3) group
  0x00 LOW — Reset Vector Base Address Registerx_L
  0x04 HIGH — Reset Vector Base Address Registerx_H

## CPU_SUBSYS_CTRL_H616 — H616 CPU Subsystem Control Register List
Base 0x08100000
Registers as CPU_SUBSYS_CTRL, without CPUx_CTRL_REG, unnamed.
