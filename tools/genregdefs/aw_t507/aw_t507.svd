# aw_t507 register map
File version: 1.00
Registers are 32-bit, read-write, reset 0x0 unless marked. A register's access mark holds for its fields unless they carry their own. Offsets are from the block's base; [hi:lo] are bit positions; lines under a group give offsets from that group; {n}, {i} and the like mark numbered series.

## TCON_LCD0 — Timing Controller_LCD (TCON_LCD)
Base 0x06511000
Same registers: TCON_LCD1 0x06512000
0x00 LCD_GCTL_REG — LCD Global Control Register
0x04 LCD_GINT0_REG — LCD Global Interrupt Register0
0x08 LCD_GINT1_REG — LCD Global Interrupt Register1
0x10 LCD_FRM_CTL_REG — LCD FRM Control Register
{0x14+0x18*i} LCD_FRM_SEED_REG[{i}] (i=0..5) — LCD FRM Seed Register (N=0,1,2,3,4,5) 0x0014+N*0x04
0x2C LCD_FRM_TAB_REG — 4 LCD FRM Table Register (N=0,1,2,3) 0x002C+N*0x04
0x3C LCD_3D_FIFO_REG — LCD 3D FIFO Register
0x40 LCD_CTL_REG — LCD Control Register
0x44 LCD_DCLK_REG — LCD Data Clock Register
{0x48+4i} LCD_BASIC{i}_REG (i=0..3) — LCD Basic Timing Register{i}
0x58 LCD_HV_IF_REG — LCD HV Panel Interface Register
0x60 LCD_CPU_IF_REG — LCD CPU Panel Interface Register
0x64 LCD_CPU_WR_REG — LCD CPU Panel Write Data Regist er
0x68 LCD_CPU_RD0_REG — LCD CPU Panel Read Data Register0
0x6C LCD_CPU_RD1_REG — LCD CPU Panel Read Data Register1
0x84 LCD_LVDS_IF_REG — LCD LVDS Configure Register - AKA tcon0_lvds_ctl
0x88 LCD_IO_POL_REG — LCD IO Polarity Register
0x8C LCD_IO_TRI_REG — LCD IO Control Register
0xFC LCD_DEBUG_REG — LCD Debug Register
0x100 LCD_CEU_CTL_REG — LCD CEU Control Register
{0x110+0x30*i} unnamed[{i}] (i=0..2) group
  {0x0+0xC*j} MUL_REG[{j}] (j=0..2) — TCON CEU coefficient register0 (N=0,1,2, 4,5,6, 8,9,10)
  0x0C ADD_REG — 0x11C+N*0x10 TCON CEU coefficient register1 (N=0,1,2)
{0x140+0xC*i} LCD_CEU_COEF_RANG_REG[{i}] (i=0..2) — LCD CEU Coefficient Register2(N=0,1,2) 0x0140+N*0x04
{0x160+0x18*i} LCD_CPU_TRI_REG[{i}] (i=0..5) — LCD CPU Panel Trigger Register0..5
0x180 LCD_CMAP_CTL_REG — LCD Color Map Control Register
{0x190+8i} LCD_CMAP_ODD_REG[{i}] (i=0..1) — LCD Color Map Odd Line Register0/1
{0x198+8i} LCD_CMAP_EVEN_REG[{i}] (i=0..1) — LCD Color Map Even Line Register0/1
0x1F0 LCD_SAFE_PERIOD_REG — LCD Safe Period Register
0x200 tcon_mul_ctl — https://github.com/qiaoweibiao/T507_Kernel/blob/98fcc7d3f112e51b0edfb71536da89cb2115106f/drivers/video/fbdev/sunxi/disp2/disp/de/lowlevel_sun50iw1/de_lcd_type.h#L691
{0x220+8i} LCD_LVDS_ANA_REG[{i}] (i=0..1) — LCD LVDS Analog Register 0/1 LCD_LVDS0_ANA_REG LCD_LVDS1_ANA_REG
0x23C LCD_FSYNC_GEN_CTRL_REG — Module Enable and Output Value Register
0x240 LCD_FSYNC_GEN_DLY_REG — Fsync Active Time Register
{0x400+0x400*i} LCD_GAMMA_TABLE_REG[{i}] (i=0..255) — LCD Gamma Table Register 0x0400-0x07FF
0xFF4 LCD_3D_FIFO_BIST_REG — LCD 3D FIFO Bist Register
0xFF8 LCD_TRI_FIFO_BIST_REG — LCD Trigger FIFO Bist Register

## TCON_TV0 — TV Output
Base 0x06515000
Same registers: TCON_TV1 0x06516000
0x00 TV_GCTL_REG — TV Global Control Register
0x04 TV_GINT0_REG — TV Global Interrupt Register0
0x08 TV_GINT1_REG — TV Global Interrupt Register1
0x40 TV_SRC_CTL_REG — TV Source Control Register
0x88 TV_IO_POL_REG — TV IO Polarity Register
0x8C TV_IO_TRI_REG — TV IO Control Register
0x90 TV_CTL_REG — TV Control Register
{0x94+4i} TV_BASIC{i}_REG (i=0..2) — TV Basic Timing Register{i}
0xA0 TV_BASIC3_REG — TV Basic Timing Regi ster3
0xA4 TV_BASIC4_REG — TV Basic Timing Register4
0xA8 TV_BASIC5_REG — TV Basic Timing Register5
0xF8 TV_ECC_FIFO_REG — TV ECC FIFO Register
0xFC TV_DEBUG_REG — TV Debug Register
0x100 TV_CEU_CTL_REG — TV CEU Control Register
{0x110+0x30*i} unnamed[{i}] (i=0..2) group
  {0x0+0xC*j} MUL_REG[{j}] (j=0..2) — TCON CEU coefficient register0 (N=0,1,2, 4,5,6, 8,9,10)
{0x140+0xC*i} TV_CEU_COEF_RANG_REG[{i}] (i=0..2) — TV CEU Coefficient Range R egister (N=0,1,2)
0x1F0 TV_SAFE_PERIOD_REG — TV Safe Period Register
0x200 tcon_mul_ctl — https://github.com/qiaoweibiao/T507_Kernel/blob/98fcc7d3f112e51b0edfb71536da89cb2115106f/drivers/video/fbdev/sunxi/disp2/disp/de/lowlevel_sun50iw1/de_lcd_type.h#L691
0x300 TV_FILL_CTL_REG — TV Fill Data Control Register
{0x304+0x24*i} unnamed[{i}] (i=0..2) group
  0x00 TV_FILL_BEGIN_REG — TV Fill Data Begin Register 0x0304+N*0x0C(N=0..2)
  0x04 TV_FILL_END_REG — TV Fill Data End Register 0x0308+N*0x0C(N=0..2)
  0x08 TV_FILL_DATA_REG — TV Fill Data Value Register 0x030C+N*0x0C(N=0..2)
0x330 TV_DATA_IO_POL0_REG — TV Data IO Polarity0 Register
0x334 TV_DATA_IO_POL1_REG — TV Data IO Polarity1 Register
0x338 TV_DATA_IO_TRI0_REG — TV Data IO Trigger0 Register
0x33C TV_DATA_IO_TRI1_REG — TV Data IO Trigger1 Register
0x340 TV_PIXELDEPTH_MODE_REG — TV Pixel
