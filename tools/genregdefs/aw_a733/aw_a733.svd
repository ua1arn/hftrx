# aw_a733 register map
File version: 1.00
Registers are 32-bit, read-write, reset 0x0 unless marked. A register's access mark holds for its fields unless they carry their own. Offsets are from the block's base; [hi:lo] are bit positions; lines under a group give offsets from that group; {n}, {i} and the like mark numbered series.

## DE_MIXER0_GLB — Display Engine (DE) - Global Control
Base 0x05008100
Same registers: DE_MIXER1_GLB 0x05008140
0x00 GLB_CTL — Global control register
0x04 GLB_STS — Global status register
0x08 GLB_SIZE — Global size register
0x0C GLB_CLK — Global clock register
0x10 GLB_DBUFFER — Global double buffer control register
0x14 reg_0x014 — ??? 0xffff3fc0 in dump

## DE_TOP — Display Engine (DE) TOP (APB)
Base 0x05008000
0x00 DE_SCLK_GATE — DE SCLK Gating Register
0x04 DE_HCLK_GATE — DE HCLK Gating Register
0x08 DE_AHB_RESET — DE AHB Reset Register DE_MBUS_CLOCK_ADDR
0x0C DE_SCLK_DIV — DE SCLK Division Register
0x10 DE2TCON_MUX — DE MUX Register DE2TCON_MUX_OFFSET
0x14 DE_VER_CTL
0x20 DE_RTWB_CTL
0x24 DE_RTWB_MUX
0x28 DE_VCH2CORE_MUX — writeable bits 0x00333333
0x2C DE_UCH2CORE_MUX — writeable bits 0x00333333
{0x30+0x18*i} DE_PORT2CHN_MUX[{i}] (i=0..5)
0x4C DE_ASYNC_BRIDGE
{0x50+0x10*i} DE_BUF_DEPTH[{i}] (i=0..3)
0x94 reg_0x094 — hdmi+tcon =0x01000000, hdmi=0x01000008
0x98 reg_0x098 — hdmi+tcon =0x3fe62950, hdmi=0x3fd1e680
0xD0 reg_0x0D0 — hdmi+tcon =0x00000010, hdmi=0x00000000
0xE0 DE_DEBUG_CTL — DE_DEBUG_CTL_OFFSET
0xE4 DE_AHB_TIMEOUT
0xE8 DE_GATING_CTL

## DE_UI1 — Display Engine (DE) - UI surface
Base 0x051C1000
Same registers: DE_UI2 0x051E1000, DE_UI3 0x05201000
{0x0+0x80*i} unnamed[{i}] (i=0..3) group
  0x00 ATTR
  0x04 SIZE
  0x08 COORD
  0x0C PITCH
  0x10 TOP_LADDR
  0x14 BOT_LADDR
  0x18 FCOLOR
0x80 TOP_HADDR
0x84 BOT_HADDR
0x88 OVL_SIZE

## DE_UIS1 — UI Scaler(UIS) provides RGB format image resizing function
Base 0x05124000
Same registers: DE_UIS2 0x05144000, DE_UIS3 0x051C4000, DE_UIS4 0x051E4000, DE_UIS5 0x05204000, DE_UIS6 0x05224000
0x00 UIS_CTRL_REG — Control register
0x08 UIS_STATUS_REG — Status register
0x0C UIS_FIELD_CTRL_REG — Field control register
0x10 UIS_BIST_REG — BIST control register
0x40 UIS_OUT_SIZE_REG — Output size register
0x44 UIS_GLOBAL_ALPHA_REG — VSU Output Global Alpha Register
0x80 UIS_Y_INSIZE_REG — Y Channel Input size register
0x88 UIS_Y_HSTEP_REG — Y Channel Horizontal step register
0x8C UIS_Y_VSTEP_REG — Y Channel Vertical step register
0x90 UIS_Y_HPHASE_REG — Y Channel Horizontal initial phase register
0x98 UIS_Y_VPHASE_REG — Y Channel Vertical initial phase 0 register
0xC0 UIS_C_INSIZE_REG — C Channel Input size register
0xC8 UIS_C_HSTEP_REG — C Channel Horizontal step register
0xCC UIS_C_VSTEP_REG — C Channel Vertical step register
0xD0 UIS_C_HPHASE_REG — C Channel Horizontal initial phase register
0xD8 UIS_C_VPHASE_REG — C Channel Vertical initial phase 0 register
{0x200+0x100*i} UIS_Y_HCOEF0_REGN[{i}] (i=0..63) — 0x200+N*4 Y Channel Horizontal Filter Coefficient0 Register N N = M 1))
{0x400+0x100*i} UIS_Y_VCOEF_REGN[{i}] (i=0..63) — 0x400+N*4 Y Channel Vertical Filter Coefficient Register N N = M 1))
{0x600+0x100*i} UIS_C_HCOEF0_REGN[{i}] (i=0..63) — 0x600+N*4 C Channel Horizontal Filter Coefficient0 Register N N = M 1))

## DE_VI1 — Display Engine (DE) - VI surface
Base 0x05101000
Same registers: DE_VI2 0x05121000, DE_VI3 0x05141000
{0x0+0xC0*i} unnamed[{i}] (i=0..3) group
  0x00 ATTR
  0x04 SIZE
  0x08 COORD
  {0xC+0xC*j} PITCH[{j}] (j=0..2) — ix=0: Y, ix=1: U/UV channel, ix=3: V channel
  {0x18+0xC*j} TOP_LADDR[{j}] (j=0..2)
  {0x24+0xC*j} BOT_LADDR[{j}] (j=0..2)
{0xC0+0x10*i} FCOLOR[{i}] (i=0..3)
{0xD0+0xC*i} TOP_HADDR[{i}] (i=0..2)
{0xDC+0xC*i} BOT_HADDR[{i}] (i=0..2)
{0xE8+8i} OVL_SIZE[{i}] (i=0..1) — OVL_Y, OVL_UV overlay window size register
{0xF0+8i} HORI[{i}] (i=0..1) — OVL_V horizontal down sample control register
{0xF8+8i} VERT[{i}] (i=0..1) — OVL_V vertical down sample control register
0x300 FBD_V_CTL — OVL_V FBD control register
