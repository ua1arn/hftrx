# aw_a733 register map
File version: 1.00
Registers are 32-bit, read-write, reset 0x0 unless marked. A register's access mark holds for its fields unless they carry their own. Offsets are from the block's base; [hi:lo] are bit positions; lines under a group give offsets from that group; {n}, {i} and the like mark numbered series.

## CLUSTER_CFG
Base 0x08860000
{0x0+0x8000*i} unnamed[{i}] (i=0..7) group
  0x00 C0_CPUx_CTRL_REG — Cluster0 CPUx Control Register
  0x04 C0_CPUx_STATUS0 — Cluster0 CPUx Status 0 Register
  0x08 C0_CPUx_UNC_008 — Cluster0 CPUx Status 0 Register
0x8000 C0_RST_CTRL — Cluster 0 Reset Control Register
0x8004 C0_CTRL_REG0 — Cluster 0 Control Register 0
0x8008 C0_CTRL_REG1 — Cluster 0 Control Register 1
0x800C CLK_FORCE_CFG_REG — Clk Control ForceConfiguration Register
0x8010 CLUSTER_SPRAM_CFG_REG — CPU cluster sprammemoryConfiguration Register
0x8014 CLUSTER_RF2P_CFG_REG — CPU cluster rf2pmemoryConfiguration Register
0x8018 CLUSTER_RFP2P_CFG_REG — CPU cluster rfp2pmemoryConfiguration Register
0x801C CLUSTER_SYSSPRAM_CFG_REG — CPU cluster syssprammemoryConfiguration Register
0x8020 DSU_AXI_TH_CFG_REG — DSUAXI2TO1THConfiguration Register
0x8030 CLU_DSU_STATUS_REG — ClusterDSU Status Register
0x80A4 CLU_DSU_RST_CTRL — ClusterDSUresetselfrelease Register
0x80B0 AXI0_MNT_CTRL_REG — DSUAXI0MONITOR Control Register
0x80B4 AXI0_MNT_PRD_REG — DSUAXI0MONITORPeriod Register
0x80B8 AXI0_MNT_RLTCY_REG — DSUAXI0MONITORReadTotalLatency Register
0x80BC AXI0_MNT_WLTCY_REG — DSUAXI0MONITORWriteTotalLatency Register
0x80C0 DSU_AXI0_MNT_RREQ_REG — DSUAXI0MONITORReadRequesttimes Register
0x80C4 DSU_AXI0_MNT_WREQ_REG — DSUAXI0MONITORWriteRequesttimes Register
0x80C8 DSU_AXI0_MNT_RBD_REG — DSUAXI0MONITORReadBandwidth Register
0x80CC DSU_AXI0_MNT_WBD_REG — DSUAXI0MONITORWriteBandwidth Register
0x80D0 DSU_AXI1_MNT_CTRL_REG — DSUAXI1MONITOR Control Register
0x80D4 DSU_AXI1_MNT_PRD_REG — DSUAXI1MONITORPeriod Register
0x80D8 DSU_AXI1_MNT_RLTCY_REG — DSUAXI1MONITORReadTotalLatency Register
0x80DC DSU_AXI1_MNT_WLTCY_REG — DSUAXI1MONITORWriteTotalLatency Register
0x80E0 DSU_AXI1_MNT_RREQ_REG — DSUAXI1MONITORReadRequesttimes Register
0x80E4 DSU_AXI1_MNT_WREQ_REG — DSUAXI1MONITORWriteRequesttimes Register
0x80E8 DSU_AXI1_MNT_RBD_REG — DSUAXI1MONITORReadBandwidth Register
0x80EC DSU_AXI1_MNT_WBD_REG — DSUAXI1MONITORWriteBandwidth Register

## COMBPHY0
Base 0x06C80000
Same registers: COMBPHY1 0x06CA0000
0x00 COMBPHY_CFG_REG
0x04 COMBPHY_CTRL_REG
0x08 COMBPHY_STAT_REG

## CPUS_INTERRUPT_CTRL
Base 0x02055000
{0x10+0x20*i} INTC_CONFIG_REG[{i}] (i=0..7) — Group Interrupt Configuration Register 0..7
{0x100+0x1C*i} SYS_INT_STATE[{i}] (i=0..6) — System Interrput0..Interrput6 State Registers

## CPU_PLL_CFG
Base 0x08870000
0x00 CPU_BACK_PLL_CTRL_REG — CPU_BACK_PLL Control Register
0x04 CPU_BACK_PLL_LOCK_CTRL_REG — CPU_BACK_PLLlock Control Register
0x08 CPU_BACK_PLL_PAT0_CTRL_REG — CPU_BACK_PLL Pattern 0 Control Register
0x0C CPU_BACK_PLL_PAT1_CTRL_REG — CPU_BACK_PLL Pattern 1 Control Register
0x10 CPU_BACK_PLL_BIAS_REG — CPU_BACK_PLLBias Register
0x1000 CPU_L_PLL_CTRL_REG — CPU_L_PLL Control Register
0x1004 CPU_L_PLL_PAT0_CTRL_REG — CPU_L_PLL Pattern 0 Control Register
0x1008 CPU_L_PLL_PAT1_CTRL_REG — CPU_L_PLL Pattern 1 Control Register
0x100C CPU_L_PLL_BIAS_REG — CPU_L_PLLBias Register
0x1010 CPU_L_PLL_TUN0_REG — CPU_L_PLLTuning0 Register
0x1014 CPU_L_PLL_TUN1_REG — CPU_L_PLLTuning1 Register
0x1018 CPU_L_PLL_LFM_REG — CPU_L_PLLLFM Register
0x101C CPU_L_PLL_CLK_REG — CPU_L_PLLClock Register
0x1020 CPU_L_PLL_GATING_REG — CPU_L_PLLGatingConfiguration Register
0x1024 CPU_L_PLL_UNLOCK_IRQEN_REG — CPU_L_PLLUnlockIRQEnable Register
0x1028 CPU_L_PLL_UNLOCK_STAT_REG — CPU_L_PLLUnlock Status Register
0x102C CPU_L_PLL_CTRL_STAT_REG — CPU_L_PLL Control Status Register
0x2000 CPU_B_PLL_CTRL_REG — CPU_B_PLL Control Register
0x2004 CPU_B_PLL_PAT0_CTRL_REG — CPU_B_PLL Pattern 0 Control Register
0x2008 CPU_B_PLL_PAT1_CTRL_REG — CPU_B_PLL Pattern 1 Control Register
0x200C CPU_B_PLL_BIAS_REG — CPU_B_PLLBias Register
0x2010 CPU_B_PLL_TUN0_REG — CPU_B_PLLTuning0 Register
0x2014 CPU_B_PLL_TUN1_REG — CPU_B_PLLTuning1 Register
0x2018 CPU_B_PLL_LFM_REG — CPU_B_PLLLFM Register
0x201C CPU_B_PLL_CLK_REG — CPU_B_PLLClock Register
0x2020 CPU_B_PLL_GATING_REG — CPU_B_PLLGatingConfiguration Register
0x2024 CPU_B_PLL_UNLOCK_IRQEN_REG — CPU_B_PLLUnlockIRQEnable Register
0x2028 CPU_B_PLL_UNLOCK_STAT_REG — CPU_B_PLLUnlock Status Register
0x202C CPU_B_PLL_CTRL_STAT_REG — CPU_B_PLL Control Status Register
0x3000 CPU_DSU_PLL_CTRL_REG — CPU_DSU_PLL Control Register
0x3004 CPU_DSU_PLL_PAT0_CTRL_REG — CPU_DSU_PLL Pattern 0 Control Register
0x3008 CPU_DSU_PLL_PAT1_CTRL_REG — CPU_DSU_PLL Pattern 1 Control Register
0x300C CPU_DSU_PLL_BIAS_REG — CPU_DSU_PLLBias Register
0x3010 CPU_DSU_PLL_TUN0_REG — CPU_DSU_PLLTuning0 Register
0x3014 CPU_DSU_PLL_TUN1_REG — CPU_DSU_PLLTuning1 Register
0x3018 CPU_DSU_PLL_LFM_REG — CPU_DSU_PLLLFM Register
0x301C CPU_DSU_PLL_CLK_REG — CPU_DSU_PLLClock Register
0x3020 CPU_DSU_PLL_GATING_REG — CPU_DSU_PLLGatingConfiguration Register
0x3024 CPU_DSU_PLL_UNLOCK_IRQEN_REG — CPU_DSU_PLLUnlockIRQEnable Register
0x3028 CPU_DSU_PLL_UNLOCK_STAT_REG — CPU_DSU_PLLUnlock Status Register
0x302C CPU_DSU_PLL_CTRL_STAT_REG — CPU_DSU_PLL Control Status Register
0x3034 CPU_SLOW_CLK_SEL_REG — CPUSlowClockSelect Register
