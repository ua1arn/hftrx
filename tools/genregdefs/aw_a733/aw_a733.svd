# aw_a733 register map
File version: 1.00
Registers are 32-bit, read-write, reset 0x0 unless marked. A register's access mark holds for its fields unless they carry their own. Offsets are from the block's base; [hi:lo] are bit positions; lines under a group give offsets from that group; {n}, {i} and the like mark numbered series.

## DE_VSU1 — Video Scaler Unit (VSU)
Base 0x05124000
Same registers: DE_VSU2 0x05144000, DE_VSU3 0x051C4000, DE_VSU4 0x051E4000, DE_VSU5 0x05204000, DE_VSU6 0x05224000
0x00 VSU_CTRL_REG — VSU Module Control Register
0x08 VSU_STATUS_REG — VSU Status Register
0x0C VSU_FIELD_CTRL_REG — VSU Field Control Register
0x10 VSU_SCALE_MODE_REG — VSU Scale Mode Setting Register
0x20 VSU_DIRECTION_THR_REG — VSU Direction Detection Threshold Register
0x24 VSU_EDGE_THR_REG — VSU Edge Detection Setting Register
0x28 VSU_EDSCALER_CTRL_REG — VSU Edge-Direction Scaler Control Register
0x2C VSU_ANGLE_THR_REG — VSU Angle Reliability Setting Register
0x30 VSU_SHARP_EN_REG — VSU Sharpness Control Enable Register
0x34 VSU_SHARP_CORING_REG — VSU Sharpness Control Coring Setting Register
0x38 VSU_SHARP_GAIN0_REG — VSU Sharpness Control Gain Setting 0 Register
0x3C VSU_SHARP_GAIN1_REG — VSU Sharpness Control Gain Setting 1 Register
0x40 VSU_OUT_SIZE_REG — VSU Output Size Register
0x44 VSU_GLOBAL_ALPHA_REG — VSU Output Global Alpha Register
0x80 VSU_Y_SIZE_REG — VSU Y Channel Size Register
0x88 VSU_Y_HSTEP_REG — VSU Y Channel Horizontal Step Register
0x8C VSU_Y_VSTEP_REG — VSU Y Channel Vertical Step Register
0x90 VSU_Y_HPHASE_REG — VSU Y Channel Horizontal Initial Phase Register
0x98 VSU_Y_VPHASE0_REG — VSU Y Channel Vertical Initial Phase 0 Register
0x9C VSU_Y_VPHASE1_REG — VSU Y Channel Vertical Initial Phase 1 Register
0xC0 VSU_C_SIZE_REG — VSU C Channel Size Register
0xC8 VSU_C_HSTEP_REG — VSU C Channel Horizontal Step Register
0xCC VSU_C_VSTEP_REG — VSU C Channel Vertical Step Register
0xD0 VSU_C_HPHASE_REG — VSU C Channel Horizontal Initial Phase Register
0xD8 VSU_C_VPHASE0_REG — VSU C Channel Vertical Initial Phase 0 Register
0xDC VSU_C_VPHASE1_REG — VSU C Channel Vertical Initial Phase 1 Register
{0x200+0x100*i} VSU_Y_HCOEF0_REGN[{i}] (i=0..63) — 0x200+N*4 VSU Y Channel Horizontal Filter Coefficient0 Register N N = M 1))
{0x300+0x100*i} VSU_Y_HCOEF1_REGN[{i}] (i=0..63) — 0x300+N*4 VSU Y Channel Horizontal Filter Coefficient1 Register N N = M 1))
{0x400+0x100*i} VSU_Y_VCOEF_REGN[{i}] (i=0..63) — 0x400+N*4 VSU Y Channel Vertical Filter Coefficient Register N N = M 1))
{0x600+0x100*i} VSU_C_HCOEF0_REGN[{i}] (i=0..63) — 0x600+N*4 VSU C Channel Horizontal Filter Coefficient0 Register N N = M 1))
{0x700+0x100*i} VSU_C_HCOEF1_REGN[{i}] (i=0..63) — 0x700+N*4 VSU C Channel Horizontal Filter Coefficient1 Register N N = M 1))
{0x800+0x100*i} VSU_C_VCOEF_REGN[{i}] (i=0..63) — 0x400+N*4 VSU Cs Channel Vertical Filter Coefficient Register N N = M 1))

## DISPLAY0_TOP — VIDE0_OUT1_SYS
Base 0x05500000
0x04 DSI_SRC_SEL — MIPI DSI Data Source Select Register
0x08 DUAL_DSI_SKEW — Dual MIPI DSI Data Skew Register
0x0C LCD_CLK_SRC_COMB_CLK_SRC — LCD Clock And Combophy Clock Source Select Register
0x20 VO0_MODULE_GATING — TCON_LCD Output To LVDS/DSI Gating Register

## DISPLAY1_TOP — VIDEO_OUT1_SYS
Base 0x05510000
0x00 TV_CLK_EDP_I2S1_SRC — TCON_TV Clock Select And EDP I2S1 Select Register
0x20 VO1_MODULE_GATING — TCON_TV Output To HDMI Gating Register

## DMA0
Base 0x04601000
Same registers: DMA1 0x04024000
0x20 DMAC_SEC_REG — DMA Security Register
0x28 DMAC_AUTO_GATE_REG — DMAC Auto Gating Register
0x30 DMAC_STA_REG — DMAC Status Register
0x34 DMA_IRQ_CPU_EN_REG — DMA IRQ Transfer to CPU Field Enable Register
0x38 DMA_IRQ_CPUS_EN_REG — DMA IRQ Transfer to CPUS Field Enable Register
{0x100+0x400*i} unnamed[{i}] (i=0..15) group
  0x00 DMAC_EN_REGN — DMAC Channel Enable Register N (N = 0 to 15) 0x0100 + N*0x0040
  0x04 DMAC_PAU_REGN — DMAC Channel Pause Register N (N = 0 to 15) 0x0104 + N*0x0040
  0x08 DMAC_DESC_ADDR_REGN — DMAC Channel Start Address Register N (N = 0 to 15) 0x0108 + N*0x0040
  0x0C DMA_CFG_REGN — DMAC Channel Configuration Register N (N = 0 to 15) 0x010C + N*0x0040
  0x10 DMAC_CUR_SRC_REGN — DMAC Channel Current Source Register N (N = 0 to 15) 0x0110 + N*0x0040
  0x14 DMAC_CUR_DEST_REGN — DMAC Channel Current Destination Register N (N = 0 to 15) 0x0114 + N*0x0040
  0x18 DMAC_BCNT_LEFT_REGN — DMAC Channel Byte Counter Left Register N (N = 0 to 15) 0x0118 + N*0x0040
  0x1C DMA_PARA_REGN — DMAC Channel Parameter Register N (N = 0 to 15) 0x011C + N*0x0040
  0x28 DMAC_MODE_REGN — DMAC Mode Register N (N = 0 to 15) 0x0128 + N*0x0040
  0x2C DMAC_FDESC_ADDR_REGN — DMAC Former Descriptor Address Register N (N = 0 to 15) 0x012C + N*0x0040
  0x30 DMAC_PKG_NUM_REGN — DMAC Package Number Register N (N = 0 to 15) 0x0130 + N*0x0040
  0x34 DMA_IRQ_EN_REG — DMA IRQ Enable Register
  0x38 DMA_IRQ_PEND_REG — DMA IRQ Pending Status Register
  0x3C DMA_DESC_HIG_ADDR_REG — DMA Channel Descriptor Highes Address Register
