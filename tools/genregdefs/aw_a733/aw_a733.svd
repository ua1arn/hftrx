# aw_a733 register map
File version: 1.00
Registers are 32-bit, read-write, reset 0x0 unless marked. A register's access mark holds for its fields unless they carry their own. Offsets are from the block's base; [hi:lo] are bit positions; lines under a group give offsets from that group; {n}, {i} and the like mark numbered series.

## GICP — GIC Performance Monitoring Unit
Base 0x03430000
{0x0+0x14*i} GICP_EVCNTRn[{i}] (i=0..4) — Event Counter Registers
{0x400+0x14*i} GICP_EVTYPERn[{i}] (i=0..4) — Event Type Configuration Registers
{0x600+0x14*i} GICP_SVRn[{i}] (i=0..4) — Shadow Value Registers
{0xA00+0x14*i} GICP_FRn[{i}] (i=0..4) — Filter Registers
0xC00 GICP_CNTENSET0 64-bit (reset mask 0xFFFFFFFF) — Counter Enable Set Register 0
0xC20 GICP_CNTENCLR0 64-bit (reset mask 0xFFFFFFFF) — Counter Enable Clear Register 0
0xC40 GICP_INTENSET0 64-bit (reset mask 0xFFFFFFFF) — Interrupt Contribution Enable Set Register 0
0xC60 GICP_INTENCLR0 64-bit (reset mask 0xFFFFFFFF) — Interrupt Contribution Enable Clear Register 0
0xC80 GICP_OVSCLR0 64-bit (reset mask 0xFFFFFFFF) — Overflow Status Clear Register 0
0xCC0 GICP_OVSSET0 64-bit (reset mask 0xFFFFFFFF) — Overflow Status Set Register 0
0xD88 GICP_CAPR — Counter Shadow Value Capture Register
0xE00 GICP_CFGR — Configuration Information Register
0xE04 GICP_CR — Control Register
0xE50 GICP_IRQCR — Interrupt Configuration Register
{0xFFC0+4i} GICP_PIDR{i} (i=4..7) — Peripheral ID {i} Register
{0xFFE0+4i} GICP_PIDR{i} (i=0..3) — Peripheral ID {i} Register
{0xFFF0+4i} GICP_CIDR{i} (i=0..3) — Component ID {i} Register

## GITS — GIC Secure Access Control
Base 0x03440000
0xF000 GITS_CFGID 64-bit (reset mask 0xFFFFFFFF) — Configuration ID Register
{0xFFC0+4i} GITS_PIDR{i} (i=4..7) — Peripheral ID {i} Register
{0xFFE0+4i} GITS_PIDR{i} (i=0..3) — Peripheral ID {i} Register
{0xFFF0+4i} GITS_CIDR{i} (i=0..3) — Component ID {i} Register

## GPIOB — Port Controller
Base 0x02000100
Same registers: GPIOC 0x02000180, GPIOD 0x02000200, GPIOE 0x02000280, GPIOF 0x02000300, GPIOG 0x02000380, GPIOH 0x02000400, GPIOJ 0x02000500, GPIOK 0x02000580
{0x0+0x10*i} CFG[{i}] (i=0..3) — Configure Register
0x10 DATA
0x14 DATA_SET
0x18 DATA_CLR — Data Clear Register
{0x20+0x10*i} DRV[{i}] (i=0..3) — Multi_Driving Register
{0x30+8i} PULL[{i}] (i=0..1)
{0x40+0x10*i} INT_CFG[{i}] (i=0..3) — External Interrupt Configure Register
0x50 INT_CTL — External Interrupt Control Register
0x54 INT_STA — External Interrupt Status Register
0x58 INT_DEB — External Debounce Configure Register
0x70 SECURE — SECURE Configure Register

## GPIOBLOCK — Port Controller
Base 0x02000080
{0x0+0x480*i} unnamed[{i}] (i=0..8) group
  {0x0+0x10*j} CFG[{j}] (j=0..3) — Configure Register
  0x10 DATA
  0x14 DATA_SET
  0x18 DATA_CLR — Data Clear Register
  {0x20+0x10*j} DRV[{j}] (j=0..3) — Multi_Driving Register
  {0x30+8j} PULL[{j}] (j=0..1)
  {0x40+0x10*j} INT_CFG[{j}] (j=0..3) — External Interrupt Configure Register
  0x50 INT_CTL — External Interrupt Control Register
  0x54 INT_STA — External Interrupt Status Register
  0x58 INT_DEB — External Debounce Configure Register
  0x70 SECURE — SECURE Configure Register

## GPIOINTB
Base 0x02000140
Same registers: GPIOINTC 0x020001C0, GPIOINTD 0x02000240, GPIOINTE 0x020002C0, GPIOINTF 0x02000340, GPIOINTG 0x020003C0, GPIOINTH 0x02000440, GPIOINTJ 0x02000540, GPIOINTK 0x020005C0
{0x0+0x10*i} EINT_CFG[{i}] (i=0..3) — External Interrupt Configure Registers
0x10 EINT_CTL — External Interrupt Control Register
0x14 EINT_STATUS — External Interrupt Status Register
0x18 EINT_DEB — External Interrupt Debounce Register

## I2S0
Base 0x02532000
Same registers: I2S1 0x02533000, I2S2 0x02534000, I2S3 0x02535000, I2S4 0x02536000
0x00 I2S_PCM_CTL — I2S/PCM Control Register
0x04 I2S_PCM_FMT0 — I2S/PCM Format Register 0
0x08 I2S_PCM_FMT1 — I2S/PCM Format Register 1
0x0C I2S_PCM_ISTA — I2S/PCM Interrupt Status Register
0x10 I2S_PCM_RXFIFO
0x14 I2S_PCM_FCTL — I2S/PCM FIFO Control Register
0x18 I2S_PCM_FSTA — I2S/PCM FIFO Status Register
0x1C I2S_PCM_INT — I2S/PCM DMA & Interrupt Control Register
0x20 I2S_PCM_TXFIFO
0x24 I2S_PCM_CLKD — I2S/PCM Clock Divide Register
0x28 I2S_PCM_TXCNT — I2S/PCM TX Sample Counter Register
0x2C I2S_PCM_RXCNT — I2S/PCM RX Sample Counter Register
0x30 I2S_PCM_CHCFG — I2S/PCM Channel Configuration Register
{0x34+4i} I2S_PCM_TX{i}CHSEL (i=0..3) — I2S/PCM TX{i} Channel Select Register
{0x44+8i} I2S_PCM_TX{i}CHMAP0 (i=0..3) — I2S/PCM TX{i} Channel Mapping Register0
{0x48+8i} I2S_PCM_TX{i}CHMAP1 (i=0..3) — I2S/PCM TX{i} Channel Mapping Register1
0x64 I2S_PCM_RXCHSEL — I2S/PCM RX Channel Select Register
{0x68+0x10*i} I2S_PCM_RXCHMAP[{i}] (i=0..3) — I2S/PCM RX Channel Mapping Register0..3
0x80 MCLKCFG — ASRC MCLK Configuration Register
0x84 FsoutCFG — ASRC Out Sample Rate Configuration Register
0x88 FsinEXTCFG — ASRC Input Sample Pulse Extend Configuration Register
0x8C ASRCEN — ASRC Enable Configure Register
0x90 ASRCMANCFG — ASRC Manual Ratio Configuration Register
0x94 ASRCRATIOSTAT — ASRC Status Register
0x98 ASRCFIFOSTAT — ASRC FIFO Level Status Register
0x9C ASRCMBISTCFG — ASRC MBIST Test Configuration Register
0xA0 ASRCMBISTSTAT — ASRC MBIST Test Status Register
