# aw_a733 register map
File version: 1.00
for test
Registers are 32-bit, read-write, reset 0x0 unless marked. A register's access mark holds for its fields unless they carry their own. Offsets are from the block's base; lines under a group give offsets from that group; [hi:lo] are bit positions; {n}, {i} and the like mark numbered series; 'fields as' and 'values as' point back to an identical list; <NAME> marks a mode.

## Memory map
0x01114000 DE_DNS1 — Denoise (DNS)
0x01134000 DE_DNS2
0x01151400 DE_DNS3
0x011D4000 DE_DNS4
0x011F4000 DE_DNS5
0x01214000 DE_DNS6
0x02000080 GPIOBLOCK — Port Controller
0x02000100 GPIOB — Port Controller
0x02000140 GPIOINTB
0x02000180 GPIOC
0x020001C0 GPIOINTC
0x02000200 GPIOD
0x02000240 GPIOINTD
0x02000280 GPIOE
0x020002C0 GPIOINTE
0x02000300 GPIOF
0x02000340 GPIOINTF
0x02000380 GPIOG
0x020003C0 GPIOINTG
0x02000400 GPIOH
0x02000440 GPIOINTH
0x02000500 GPIOJ
0x02000540 GPIOINTJ
0x02000580 GPIOK
0x020005C0 GPIOINTK
0x02002000 CCU — Clock Controller Unit (CCU)
0x02050000 WDT0_CPUX
0x02052000 Timer1_CPUX
0x02055000 CPUS_INTERRUPT_CTRL
0x02500000 UART0
0x02501000 UART1
0x02502000 UART2
0x02503000 UART3
0x02504000 UART4
0x02505000 UART5
0x02506000 UART6
0x02510000 TWI0 — Two Wire Interface (TWI)
{0x2510000+0x1000*n} TWI{n} (n=1..12)
0x02527000 PWM0 — Pulse Width Modulation (PWM) module
0x02528000 PWM1
0x02532000 I2S0
0x02533000 I2S1
0x02534000 I2S2
0x02535000 I2S3
0x02536000 I2S4
0x02540000 SPI0 — Serial Peripheral Interface
0x02541000 SPI1
0x02542000 SPI2
0x02543000 SPI3
0x03000000 SYSCTRL — System Control Matrix (Allwinner A733 / sun60iw2)
0x03006000 SID — Security ID
0x03400000 GICD — GIC Distributor
0x03420000 GICT — GIC ITS translation
0x03430000 GICP — GIC Performance Monitoring Unit
0x03440000 GITS — GIC Secure Access Control
0x04020000 SMHC0 — SD-MMC Host Controller
0x04021000 SMHC1
0x04022000 SMHC2
0x04023000 SMHC3
0x04024000 DMA1
0x04100000 USB0_DEVICE — USB OTG Dual-Role Device controller
0x04101000 USB0_EHCI
0x04101400 USB0_OHCI
0x04201000 USB1_EHCI
0x04201400 USB1_OHCI
0x04601000 DMA0
0x05008000 DE_TOP — Display Engine (DE) TOP (APB)
0x05008100 DE_MIXER0_GLB — Display Engine (DE) - Global Control
0x05008140 DE_MIXER1_GLB
0x05008200 RTWB_RCQ
0x05101000 DE_VI1 — Display Engine (DE) - VI surface
0x05110000 DE_FCE1 — Fresh and Contrast Enhancement (FCE)
0x05111000 DE_BLS1 — Blue Level Stretch (BLS)
0x05111400 DE_FCC1 — Fancy color curvature (FCC)
0x05121000 DE_VI2
0x05124000 DE_UIS1 — UI Scaler(UIS) provides RGB format image resizing function
0x05124000 DE_VSU1 — Video Scaler Unit (VSU)
0x05130000 DE_FCE2
0x05131000 DE_BLS2
0x05131400 DE_FCC2
0x05141000 DE_VI3
0x05144000 DE_UIS2
0x05144000 DE_VSU2
0x05150000 DE_FCE3
0x05151000 DE_BLS3
0x05151400 DE_FCC3
0x051C1000 DE_UI1 — Display Engine (DE) - UI surface
0x051C4000 DE_UIS3
0x051C4000 DE_VSU3
0x051D0000 DE_FCE4
0x051D1000 DE_BLS4
0x051D1400 DE_FCC4
0x051E1000 DE_UI2
0x051E4000 DE_UIS4
0x051E4000 DE_VSU4
0x051F0000 DE_FCE5
0x051F1000 DE_BLS5
0x051F1400 DE_FCC5
0x05201000 DE_UI3
0x05204000 DE_UIS5
0x05204000 DE_VSU5
0x05210000 DE_FCE6
0x05211000 DE_BLS6
0x05211400 DE_FCC6
0x05224000 DE_UIS6
0x05224000 DE_VSU6
0x05281000 DE_MIXER0_BLD — Display Engine (DE) - Blender
0x052A1000 DE_MIXER1_BLD
0x05440000 G2D — Graphic 2D top
0x05440000 G2D_TOP
0x05440100 G2D_MIXER — Graphic 2D (G2D) Engine Video Mixer
0x05440200 G2D_MIXER1
0x05440300 G2D_MIXER2
0x05440400 G2D_BLD — Graphic 2D (G2D) Engine Blender
0x05440800 G2D_V0 — Graphic 2D VI surface
0x05441000 G2D_UI0 — Graphic 2D UI surface
0x05441800 G2D_UI1
0x05442000 G2D_UI2
0x05443000 G2D_WB — Graphic 2D (G2D) Engine Write Back
0x05448000 G2D_VSU — Graphic 2D Video Scaler
0x05468000 G2D_ROT — Graphic 2D Rotate
0x05500000 DISPLAY0_TOP — VIDE0_OUT1_SYS
0x05501000 TCON_LCD0 — Timing Controller_LCD (TCON_LCD)
0x05502000 TCON_LCD1
0x05506000 COMBO_PHY_TX_DSI0
0x05508000 COMBO_PHY_TX_DSI1
0x05510000 DISPLAY1_TOP — VIDEO_OUT1_SYS
0x05520000 HDMI_TX0
0x05730000 TCON_TV0 — TV Output
0x05731000 TCON_TV1
0x06400000 PCIe
0x06C80000 COMBPHY0
0x06CA0000 COMBPHY1
0x07010000 S_PRCM — Power Reset Clock Management (PRCM)
0x07021000 WDT_CPUS
0x07023000 S_PWM
0x07025000 S_GPIOL — Secure Port Controller
0x07025030 S_GPIOM
0x07050000 R_CPUCFG — SUNXI_R_CPUCFG_BASE
0x07051000 PPU — PCK-600 S_PPU (PCK600).
0x07080000 S_UART0
0x07081000 S_UART1
0x07083000 S_TWI0
0x07084000 S_TWI1
0x07085000 S_TWI2
0x07090000 RTC — Real Time Clock (RTC)
0x07092000 S_SPI
0x08000000 CPU_SUBSYS_CTRL
0x08010000 TIMESTAMP_STA
0x08020000 TIMESTAMP_CTRL
0x08860000 CLUSTER_CFG
0x08870000 CPU_PLL_CFG

## Interrupts
34 UART0 (UART{n} (n=0..6), S_UART0, S_UART1)
35 UART1 (UART{n} (n=0..6), S_UART0, S_UART1)
36 UART2 (UART{n} (n=0..6), S_UART0, S_UART1)
37 UART3 (UART{n} (n=0..6), S_UART0, S_UART1)
38 UART4 (UART{n} (n=0..6), S_UART0, S_UART1)
39 UART5 (UART{n} (n=0..6), S_UART0, S_UART1)
40 UART6 (UART{n} (n=0..6), S_UART0, S_UART1)
43 TWI0 (TWI{n} (n=0..12), S_TWI{n} (n=0..2))
44 TWI1 (TWI{n} (n=0..12), S_TWI{n} (n=0..2))
45 TWI2 (TWI{n} (n=0..12), S_TWI{n} (n=0..2))
46 TWI3 (TWI{n} (n=0..12), S_TWI{n} (n=0..2))
47 TWI4 (TWI{n} (n=0..12), S_TWI{n} (n=0..2))
48 TWI5 (TWI{n} (n=0..12), S_TWI{n} (n=0..2))
49 TWI6 (TWI{n} (n=0..12), S_TWI{n} (n=0..2))
50 TWI7 (TWI{n} (n=0..12), S_TWI{n} (n=0..2))
51 TWI8 (TWI{n} (n=0..12), S_TWI{n} (n=0..2))
52 TWI9 (TWI{n} (n=0..12), S_TWI{n} (n=0..2))
53 TWI10 (TWI{n} (n=0..12), S_TWI{n} (n=0..2))
54 TWI11 (TWI{n} (n=0..12), S_TWI{n} (n=0..2))
55 TWI12 (TWI{n} (n=0..12), S_TWI{n} (n=0..2))
56 SPI0 (SPI{n} (n=0..3), S_SPI)
57 SPI1 (SPI{n} (n=0..3), S_SPI)
58 SPI2 (SPI{n} (n=0..3), S_SPI)
59 SPI3 (SPI{n} (n=0..3), S_SPI)
61 I2S4 (I2S{n} (n=0..4))
74 I2S0 (I2S{n} (n=0..4))
75 I2S1 (I2S{n} (n=0..4))
76 I2S2 (I2S{n} (n=0..4))
77 I2S3 (I2S{n} (n=0..4))
82 DE (DE_TOP)
83 G2D (G2D, G2D_TOP)
86 TCON0_LCD0 (TCON_LCD0, TCON_LCD1)
87 TCON0_LCD1 (TCON_LCD0, TCON_LCD1)
89 TCON_TV0 (TCON_TV0, TCON_TV1)
90 TCON_TV1 (TCON_TV0, TCON_TV1)
91 DSI0 (COMBO_PHY_TX_DSI0, COMBO_PHY_TX_DSI1)
92 DSI1 (COMBO_PHY_TX_DSI0, COMBO_PHY_TX_DSI1)
93 HDMI (HDMI_TX0)
101 GPIOB (GPIOINTB, GPIOINTC, GPIOINTD, GPIOINTE, GPIOINTF, GPIOINTG, GPIOINTH, GPIOINTJ, GPIOINTK)
102 GPIOB_S (GPIOINTB, GPIOINTC, GPIOINTD, GPIOINTE, GPIOINTF, GPIOINTG, GPIOINTH, GPIOINTJ, GPIOINTK)
103 GPIOC (GPIOINTB, GPIOINTC, GPIOINTD, GPIOINTE, GPIOINTF, GPIOINTG, GPIOINTH, GPIOINTJ, GPIOINTK)
104 GPIOC_S (GPIOINTB, GPIOINTC, GPIOINTD, GPIOINTE, GPIOINTF, GPIOINTG, GPIOINTH, GPIOINTJ, GPIOINTK)
105 GPIOD (GPIOINTB, GPIOINTC, GPIOINTD, GPIOINTE, GPIOINTF, GPIOINTG, GPIOINTH, GPIOINTJ, GPIOINTK)
106 GPIOD_S (GPIOINTB, GPIOINTC, GPIOINTD, GPIOINTE, GPIOINTF, GPIOINTG, GPIOINTH, GPIOINTJ, GPIOINTK)
107 GPIOE (GPIOINTB, GPIOINTC, GPIOINTD, GPIOINTE, GPIOINTF, GPIOINTG, GPIOINTH, GPIOINTJ, GPIOINTK)
108 GPIOE_S (GPIOINTB, GPIOINTC, GPIOINTD, GPIOINTE, GPIOINTF, GPIOINTG, GPIOINTH, GPIOINTJ, GPIOINTK)
109 GPIOF (GPIOINTB, GPIOINTC, GPIOINTD, GPIOINTE, GPIOINTF, GPIOINTG, GPIOINTH, GPIOINTJ, GPIOINTK)
110 GPIOF_S (GPIOINTB, GPIOINTC, GPIOINTD, GPIOINTE, GPIOINTF, GPIOINTG, GPIOINTH, GPIOINTJ, GPIOINTK)
111 GPIOG (GPIOINTB, GPIOINTC, GPIOINTD, GPIOINTE, GPIOINTF, GPIOINTG, GPIOINTH, GPIOINTJ, GPIOINTK)
112 GPIOG_S (GPIOINTB, GPIOINTC, GPIOINTD, GPIOINTE, GPIOINTF, GPIOINTG, GPIOINTH, GPIOINTJ, GPIOINTK)
113 GPIOH (GPIOINTB, GPIOINTC, GPIOINTD, GPIOINTE, GPIOINTF, GPIOINTG, GPIOINTH, GPIOINTJ, GPIOINTK)
114 GPIOH_S (GPIOINTB, GPIOINTC, GPIOINTD, GPIOINTE, GPIOINTF, GPIOINTG, GPIOINTH, GPIOINTJ, GPIOINTK)
117 GPIOJ (GPIOINTB, GPIOINTC, GPIOINTD, GPIOINTE, GPIOINTF, GPIOINTG, GPIOINTH, GPIOINTJ, GPIOINTK)
118 GPIOJ_S (GPIOINTB, GPIOINTC, GPIOINTD, GPIOINTE, GPIOINTF, GPIOINTG, GPIOINTH, GPIOINTJ, GPIOINTK)
119 GPIOK (GPIOINTB, GPIOINTC, GPIOINTD, GPIOINTE, GPIOINTF, GPIOINTG, GPIOINTH, GPIOINTJ, GPIOINTK)
120 GPIOK_S (GPIOINTB, GPIOINTC, GPIOINTD, GPIOINTE, GPIOINTF, GPIOINTG, GPIOINTH, GPIOINTJ, GPIOINTK)
131 TIMER1_0 (Timer1_CPUX)
132 TIMER1_1 (Timer1_CPUX)
133 TIMER1_2 (Timer1_CPUX)
134 TIMER1_3 (Timer1_CPUX)
138 WDT0 (WDT0_CPUX, WDT_CPUS)
143 DMA0_CPUX_NS (DMA0, DMA1)
144 DMA0_CPUX_S (DMA0, DMA1)
145 DMA1_CPUX_NS (DMA0, DMA1)
146 DMA1_CPUX_S (DMA0, DMA1)
188 USB0_DEVICE
189 USB0_EHCI (USB0_EHCI, USB1_EHCI)
190 USB0_OHCI (USB0_OHCI, USB1_OHCI)
191 USB1_EHCI (USB0_EHCI, USB1_EHCI)
192 USB1_OHCI (USB0_OHCI, USB1_OHCI)
193 SMHC0 (SMHC{n} (n=0..3))
194 SMHC1 (SMHC{n} (n=0..3))
195 SMHC2 (SMHC{n} (n=0..3))
196 SMHC3 (SMHC{n} (n=0..3))
221 PCK600_QCHANNEL (PPU)
223 S_WDT (WDT0_CPUX, WDT_CPUS)
228 RTC_ALARM (RTC)
229 S_GPIOL_S (GPIOINTB, GPIOINTC, GPIOINTD, GPIOINTE, GPIOINTF, GPIOINTG, GPIOINTH, GPIOINTJ, GPIOINTK)
230 S_GPIOL (GPIOINTB, GPIOINTC, GPIOINTD, GPIOINTE, GPIOINTF, GPIOINTG, GPIOINTH, GPIOINTJ, GPIOINTK)
231 S_GPIOM_S (GPIOINTB, GPIOINTC, GPIOINTD, GPIOINTE, GPIOINTF, GPIOINTG, GPIOINTH, GPIOINTJ, GPIOINTK)
232 S_GPIOM (GPIOINTB, GPIOINTC, GPIOINTD, GPIOINTE, GPIOINTF, GPIOINTG, GPIOINTH, GPIOINTJ, GPIOINTK)
233 S_UART0 (UART{n} (n=0..6), S_UART0, S_UART1)
234 S_UART1 (UART{n} (n=0..6), S_UART0, S_UART1)
235 S_TWI0 (TWI{n} (n=0..12), S_TWI{n} (n=0..2))
236 S_TWI1 (TWI{n} (n=0..12), S_TWI{n} (n=0..2))
237 S_TWI2 (TWI{n} (n=0..12), S_TWI{n} (n=0..2))
242 S_SPI (SPI{n} (n=0..3), S_SPI)
244 PCK600_CPU (PPU)

## Notices in the file
Copyright (c) 2024 by Genadi V. Zawidowski. All rights reserved.
