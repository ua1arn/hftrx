# aw_a733 register map
File version: 1.00
Registers are 32-bit, read-write, reset 0x0 unless marked. A register's access mark holds for its fields unless they carry their own. Offsets are from the block's base; [hi:lo] are bit positions; {n}, {i} and the like mark numbered series.

## G2D_BLD — Graphic 2D (G2D) Engine Blender
Base 0x05440400
0x00 BLD_FILL_COLOR_CTL — BLD_EN_CTL BLD_FILL_COLOR_CTL Allwinner_DE2.0_Spec_V1.0.pdf page 106
{0x10+8i} BLD_FILL_COLOR[{i}] (i=0..1) — BLD_FILLC N=0..1
{0x20+8i} BLD_CH_ISIZE[{i}] (i=0..1) — BLD_CH_ISIZE N=0..1
{0x30+8i} BLD_CH_OFFSET[{i}] (i=0..1) — BLD_CH_OFFSET N=0..1
0x40 BLD_PREMUL_CTL
0x44 BLD_BK_COLOR
0x48 BLD_SIZE
0x4C BLD_CTL
0x50 BLD_KEY_CTL
0x54 BLD_KEY_CON
0x58 BLD_KEY_MAX
0x5C BLD_KEY_MIN
0x60 BLD_OUT_COLOR
0x80 ROP_CTL
{0x84+0x10*i} ROP_INDEX[{i}] (i=0..3) — ROP_INDEX N=0..1 ch3_index0 (tina linux sources has two elements)
0x100 BLD_CSC_CTL
{0x110+0x30*i} BLD_CSC{i}_COEF00 (i=0..2)
{0x114+0x30*i} BLD_CSC{i}_COEF01 (i=0..2)
{0x118+0x30*i} BLD_CSC{i}_COEF02 (i=0..2)
{0x11C+0x30*i} BLD_CSC{i}_CONST0 (i=0..2)
{0x120+0x30*i} BLD_CSC{i}_COEF10 (i=0..2)
{0x124+0x30*i} BLD_CSC{i}_COEF11 (i=0..2)
{0x128+0x30*i} BLD_CSC{i}_COEF12 (i=0..2)
{0x12C+0x30*i} BLD_CSC{i}_CONST1 (i=0..2)
{0x130+0x30*i} BLD_CSC{i}_COEF20 (i=0..2)
{0x134+0x30*i} BLD_CSC{i}_COEF21 (i=0..2)
{0x138+0x30*i} BLD_CSC{i}_COEF22 (i=0..2)
{0x13C+0x30*i} BLD_CSC{i}_CONST2 (i=0..2)

## G2D_MIXER — Graphic 2D (G2D) Engine Video Mixer
Base 0x05440100
Same registers: G2D_MIXER1 0x05440200, G2D_MIXER2 0x05440300
0x00 G2D_MIXER_CTRL — G2D mixer control
0x04 G2D_MIXER_INTERRUPT
0x08 G2D_MIXER_CLK — G2D mixer clock

## G2D_ROT — Graphic 2D Rotate
Base 0x05468000
0x00 ROT_CTL
0x04 ROT_INT
0x08 ROT_TIMEOUT
0x20 ROT_IFMT — Input data attribute register
0x24 ROT_ISIZE — Input data size register
0x30 ROT_IPITCH0 — Input Y/RGB/ARGB memory pitch register
0x34 ROT_IPITCH1 — Input U/UV memory pitch register
0x38 ROT_IPITCH2 — Input V memory pitch register
0x40 ROT_ILADD0 — Input Y/RGB/ARGB memory address register0
0x44 ROT_IHADD0 — Input Y/RGB/ARGB memory address register1
0x48 ROT_ILADD1 — Input U/UV memory address register0
0x4C ROT_IHADD1 — Input U/UV memory address register1
0x50 ROT_ILADD2 — Input V memory address register0
0x54 ROT_IHADD2 — Input V memory address register1
0x84 ROT_OSIZE — Output data size register
0x90 ROT_OPITCH0 — Output Y/RGB/ARGB memory pitch register
0x94 ROT_OPITCH1 — Output U/UV memory pitch register
0x98 ROT_OPITCH2 — Output V memory pitch register
0xA0 ROT_OLADD0 — Output Y/RGB/ARGB memory address register0
0xA4 ROT_OHADD0 — Output Y/RGB/ARGB memory address register1
0xA8 ROT_OLADD1 — Output U/UV memory address register0
0xAC ROT_OHADD1 — Output U/UV memory address register1
0xB0 ROT_OLADD2 — Output V memory address register0
0xB4 ROT_OHADD2 — Output V memory address register1
0xC8 LBC_ENC_CTL — Encode control (bit 31 - is lossy)
0xCC LBC_CTL
0xD0 LBC_DEC_CTL — Decode control (bit 31 - is lossy)

## G2D — Graphic 2D top
Base 0x05440000
Same registers: G2D_TOP 0x05440000
0x00 G2D_SCLK_GATE
0x04 G2D_HCLK_GATE
0x08 G2D_AHB_RST — G2D AHB reset
0x0C G2D_SCLK_DIV
0x10 G2D_VERSION
0x14 reg0x14
0x18 reg0x18
0x20 RCQ_IRQ_CTL
0x24 RCQ_STATUS
0x28 RCQ_CTRL
0x2C RCQ_HEADER_LOW_ADDR — Register Configuration Queue Header bits 31..0
0x30 RCQ_HEADER_HIGH_ADDR — Register Configuration Queue Header bits 39..32
0x34 RCQ_HEADER_LEN — Register Configuration Queue length bits 15..0

## G2D_UI0 — Graphic 2D UI surface
Base 0x05441000
Same registers: G2D_UI1 0x05441800, G2D_UI2 0x05442000
0x00 UI_ATTR — UIx_ATTR
0x04 UI_MBSIZE — UIx_MBSIZE
0x08 UI_COOR — UIx_COOR
0x0C UI_PITCH — UIx_PITCH
0x10 UI_LADD — UIx_LADD
0x14 UI_FILLC — UIx_FILLC
0x18 UI_HADD — UIx_HADD
0x1C UI_SIZE — UIx_SIZE

## G2D_V0 — Graphic 2D VI surface
Base 0x05440800
0x00 V0_ATTCTL
0x04 V0_MBSIZE — Source rectangle size (may be empty)
0x08 V0_COOR — Target window position
0x0C V0_PITCH0 — V0_PITCH0 Y/RGB/ARGB data memory
0x10 V0_PITCH1 — V0_PITCH1 U/UV data memory
0x14 V0_PITCH2 — V0_PITCH2 V data memory
0x18 V0_LADD0 — V0_LADD0 Y/RGB/ARGB data memory
0x1C V0_LADD1 — V0_LADD1 U/UV data memory
0x20 V0_LADD2 — V0_LADD2 V data memory
0x24 V0_FILLC
0x28 V0_HADD — [31:24]: 0, [23:16]: LADD2 bits 40..32, [15:8]: LADD1 bits 40..32, [7:0]: LADD0 bits 40..32
0x2C V0_SIZE — Source window size (may not be empty)
0x30 V0_HDS_CTL0
0x34 V0_HDS_CTL1
0x38 V0_VDS_CTL0
0x3C V0_VDS_CTL1
