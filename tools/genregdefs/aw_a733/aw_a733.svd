# aw_a733 register map
File version: 1.00
Registers are 32-bit, read-write, reset 0x0 unless marked. A register's access mark holds for its fields unless they carry their own. Offsets are from the block's base; [hi:lo] are bit positions; {n}, {i} and the like mark numbered series.

## COMBO_PHY_TX_DSI0
Base 0x05506000
Same registers: COMBO_PHY_TX_DSI1 0x05508000
0x105C r_0x705c — 3 set 0x04B30410
0x1110 r_0x7110 — 1 set 0x00000007 - combophy0 enable LVDS related functions
0x1114 r_0x7114 — 2 set 0x00000053 - lvds vref tuning, lvds ibias tuning

## PCIe
Base 0x06400000
0x00 PCIE_ADDR_PAGE_CFG — PCIe Address Page Configuration Register

## PPU — PCK-600 S_PPU (PCK600).
Base 0x07051000
0x00 PPU_PWPR — RW 32 Power Policy Register.
0x04 PPU_PMER — RW 32 Power Mode Emulation Register.
0x08 PPU_PWSR — RO 32 Power Status Register.
0x10 PPU_DISR — RO 32 Device Interface Input Current Status Register.
0x14 PPU_MISR — RO 32 Miscellaneous Input Current Status Register.
0x18 PPU_STSR — RO 32 Stored Status Register.
0x1C PPU_UNLK — RW 32 Unlock register.
0x20 PPU_PWCR — RW 32 Power Configuration Register.
0x24 PPU_PTCR — RW 32 Power Mode Transition Configuration Register.
0x30 PPU_IMR — RW 32 Interrupt Mask Register.
0x34 PPU_AIMR — RW 32 Additional Interrupt Mask Register.
0x38 PPU_ISR — RW 32 Interrupt Status Register.
0x3C PPU_AISR — RW 32 Additional Interrupt Status Register.
0x40 PPU_IESR — RW 32 Input Edge Sensitivity Register.
0x44 PPU_OPSR — RW 32 Operating Mode Active Edge Sensitivity Register.
0x50 PPU_FUNRR — RW 32 Functional Retention RAM Configuration Register.
0x54 PPU_FULRR — RW 32 Full Retention RAM Configuration Register.
0x58 PPU_MEMRR — RW 32 Memory Retention RAM Configuration Register.
0x160 PPU_EDTR0 — RW 32 Power Mode Entry Delay Register 0.
0x164 PPU_EDTR1 — RW 32 Power Mode Entry Delay Register 1.
0x170 PPU_DCDR0 — RW 32 Device Control Delay Configuration Register 0.
0x174 PPU_DCDR1 — RW 32 Device Control Delay Configuration Register 1.
0xFB0 PPU_IDR0 — RO 32 PPU Identification Register 0.
0xFB4 PPU_IDR1 — RO 32 PPU Identification Register 1.
0xFC8 PPU_IIDR — RO 32 4.3 Implementation Identification Register, PPU_IIDR on page 43.
0xFCC PPU_AIDR — RO 32 Architecture Identification Register.
0xFD0 PID4 — RO 32 4.4.1 Peripheral ID 4 on page 44.
0xFD4 PID5 — RO 32 4.4.2 Peripheral ID 5 on page 44.
0xFD8 PID6 — RO 32 4.4.3 Peripheral ID 6 on page 45.
0xFDC PID7 — RO 32 4.4.4 Peripheral ID 7 on page 46.
0xFE0 PID0 — RO 32 4.4.5 Peripheral ID 0 on page 46.
0xFE4 PID1 — RO 32 4.4.6 Peripheral ID 1 on page 47.
0xFE8 PID2 — RO 32 4.4.7 Peripheral ID 2 on page 48.
0xFEC PID3 — RO 32 4.4.8 Peripheral ID 3 on page 48.
0xFF0 ID0 — RO 32 4.4.9 Component ID 0 on page 49.
0xFF4 ID1 — RO 32 4.4.10 Component ID 1 on page 50.
0xFF8 ID2 — RO 32 4.4.11 Component ID 2 on page 50.
0xFFC ID3 — RO 32 4.4.12 Component ID 3 on page 51.

## S_PRCM — Power Reset Clock Management (PRCM)
Base 0x07010000
0x00 AHBS_CLK_REG — AHBS Clock Register
0x0C APBS0_CLK_REG — APBS0 Clock Register
0x10 APBS1_CLK_REG — APBS1 Clock Register
{0x100+4i} S_TIMER{i}_CLK_REG (i=0..3) — S_TIMER{i} Clock Register
0x11C S_TIMER_BGR_REG — S_TIMER BUS GATING RESET Register
0x12C S_TWD_BGR_REG — S_TWD BUS GATING RESET Register
0x130 S_PWM_CLK_REG — S_PWM Clock Register
0x13C S_PWM_BGR_REG — S_PWM BUS GATING RESET Register
0x150 S_SPI_CLK_REG — S_SPI Clock Register
0x15C S_SPI_BGR_REG — S_SPI BUS GATING RESET Register
0x17C S_MBOX_BGR_REG — S_MBOX BUS GATING RESET Register
0x18C S_UART_BGR_REG — S_UART BUS GATING RESET Register
0x19C S_TWI_BGR_REG — S_TWI BUS GATING RESET Register
0x1AC S_PPU_BGR_REG — S_PPU BUS GATING RESET Register
0x1B0 S_TZMA_BGR_REG — S_TZMA GATING RESET Register
0x1BC S_CPUS_BIST_BGR_REG
0x1C0 S_IRRX_CLK_REG — S_IRRX Clock Register
0x1CC S_IRRX_BGR_REG — S_IRRX BUS GATING RESET Register
0x20C RTC_BGR_REG — RTC BUS GATING RESET Register
0x210 RISCV_24M_CLK_REG — RISCV_24M Clock Register
0x21C RISCV_BGR_REG — RISCV BUS GATING RESET Register
0x22C S_CPUCFG_BGR_REG — S_CPUCFG BUS GATING RESET Register
0x290 PRCM_SEC_SWITCH_REG — PRCM Security Switch Register
0x294 CPUX_ISO_CONFIG_REG — CPUX Isolation Configuration Register
0x320 NMI_INT_CTRL_REG — NMI Interrupt Control Register
0x324 NMI_INT_EN_REG — NMI Interrupt Enable Register
0x328 NMI_INT_PEND_REG — NMI Interrupt Pending Register
0x338 DEV_BUS_AUTOG_CTRL_REG — DEV_BUS_AUTOG_CTRL Register
0x33C BUS_ACG_REG — Bus Auto Clock Gating Register
0x360 MSRAMOC_CTRL_REG — MSRAMOC Control Register
0x368 AHBS_RDY_TOUT_CTRL_REG — AHBS Ready Timeout Control Register
0x37C JTAG_PAD_SEL_REG — JTAG PAD Select Configuration Register
0x3A0 CPUX_ISO_EN_REG — CPUX ISO Enable Register
0x3E0 CRY_CONFIG_REG — Crypt Configuration Register
0x3E4 CRY_KEY_REG — Crypt Key Register
0x3E8 CRY_EN_REG — Crypt Enable Register
