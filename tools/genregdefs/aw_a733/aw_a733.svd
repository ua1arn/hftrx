# aw_a733 register map
File version: 1.00
Registers are 32-bit, read-write, reset 0x0 unless marked. A register's access mark holds for its fields unless they carry their own. Offsets are from the block's base; [hi:lo] are bit positions; lines under a group give offsets from that group; {n}, {i} and the like mark numbered series.

## SPI0 — Serial Peripheral Interface
Base 0x02540000
Same registers: SPI1 0x02541000, SPI2 0x02542000, SPI3 0x02543000, S_SPI 0x07092000
0x04 SPI_GCR — SPI Global Control Register
0x08 SPI_TCR — SPI Transfer Control Register
0x10 SPI_IER — SPI Interrupt Control Register
0x14 SPI_ISR — SPI Interrupt Status Register
0x18 SPI_FCR — SPI FIFO Control Register
0x1C SPI_FSR — SPI FIFO Status Register
0x20 SPI_WCR — SPI Wait Clock Register
0x24 SPI_CCR — SPI Clock Control Register
0x28 SPI_SAMP_DL — SPI Sample Delay Control Register
0x30 SPI_MBC — SPI Master Burst Counter Register
0x34 SPI_MTC — SPI Master Transmit Counter Register
0x38 SPI_BCC — SPI Master Burst Control Register
0x40 SPI_BATCR — SPI Bit-Aligned Transfer Configure Register
0x44 SPI_3W_CCR — SPI Bit-Aligned Clock Configuration Register
0x48 SPI_TBR — SPI TX Bit Register
0x4C SPI_RBR — SPI RX Bit Register
0x88 SPI_NDMA_MODE_CTL — SPI Normal DMA Mode Control Register
0x200 SPI_TXD — SPI TX Data Register
0x300 SPI_RXD — SPI RX Data Register

## SYSCTRL — System Control Matrix (Allwinner A733 / sun60iw2)
Base 0x03000000
0x00 VER_REG — Chip version and SoC identification register
0x10 SRAM_CTRL_REG0 — SRAM access permission and security mapping control 0
0x14 SRAM_CTRL_REG1 — SRAM configuration and section mapping register 1
0x20 SRAM_VER_REG — SRAM macro version and hardware generation register
0x30 SYS_PIN_LAT_REG — System pin latch configuration register (state freeze)
0x40 COMBPHY0_CFG_REG — System routing configuration for COMBPHY0 (MUX PCIe/USB3/HDMI)
0x44 COMBPHY1_CFG_REG — System routing configuration for COMBPHY1 (MUX PCIe/USB3/HDMI)
0x48 PCIE_REFCLK_REG — PCIe reference clock selection and internal multiplier control
0x4C COMBPHY_CTRL_REG — Global analog power enable and internal LDO control for PHYs
0x50 COMBPHY_ISO_REG — Analog pad isolation control (Clear bits [1:0] to unblock I2C to PHY)

## S_GPIOL — Secure Port Controller
Base 0x07025000
Same registers: S_GPIOM 0x07025030
{0x0+0x10*i} CFG[{i}] (i=0..3) — Configure Register
0x10 DATA
{0x14+0x10*i} DRV[{i}] (i=0..3) — Multi_Driving Register
{0x24+8i} PULL[{i}] (i=0..1)

## TCON_LCD0 — Timing Controller_LCD (TCON_LCD)
Base 0x05501000
Same registers: TCON_LCD1 0x05502000
0x00 LCD_GCTL_REG — LCD Global Control Register
0x04 LCD_GINT0_REG — LCD Global Interrupt Register0
0x08 LCD_GINT1_REG — LCD Global Interrupt Register1
0x10 LCD_FRM_CTL_REG — LCD FRM Control Register
{0x14+0x18*i} LCD_FRM_SEED_REG[{i}] (i=0..5) — LCD FRM Seed Register (N=0,1,2,3,4,5) 0x0014+N*0x04
0x2C LCD_FRM_TAB_REG — 4 LCD FRM Table Register (N=0,1,2,3) 0x002C+N*0x04
0x3C LCD_3D_FIFO_REG — LCD 3D FIFO Register
0x40 LCD_CTL_REG — LCD Control Register
0x44 LCD_DCLK_REG — LCD Data Clock Register
{0x48+4i} LCD_BASIC{i}_REG (i=0..3) — LCD Basic Timing Register{i}
0x58 LCD_HV_IF_REG — LCD HV Panel Interface Register
0x60 LCD_CPU_IF_REG — LCD Cpu Panel Interface Register
0x64 LCD_CPU_WR_REG — LCD Cpu Panel Write Data Register
0x68 LCD_CPU_RD0_REG — LCD Cpu Panel Read Data Register0
0x6C LCD_CPU_RD1_REG — LCD Cpu Panel Read Data Register1
0x84 LCD_LVDS_IF_REG — LCD LVDS Interface Register
0x88 LCD_IO_POL_REG — LCD IO Polarity Register
0x8C LCD_IO_TRI_REG — LCD IO Control Register
0xFC LCD_DEBUG_REG — LCD Debug Register
0x100 LCD_CEU_CTL_REG — LCD CEU Control Register
{0x110+0x30*i} unnamed[{i}] (i=0..2) group
  {0x0+0xC*j} MUL_REG[{j}] (j=0..2) — TCON CEU coefficient register0 (N=0,1,2, 4,5,6, 8,9,10)
  0x0C ADD_REG — 0x11C+N*0x10 TCON CEU coefficient register1 (N=0,1,2)
{0x140+0xC*i} LCD_CEU_COEF_RANG_REG[{i}] (i=0..2) — 0x0140+N*0x04 (N=0~2) LCD CEU Coefficient Register
{0x160+0x18*i} LCD_CPU_TRI0_REG[{i}] (i=0..5) — LCD CPU Panel Trigger Register0..5
0x1F0 LCD_SAFE_PERIOD_REG — LCD Safe Period Register
{0x220+8i} LCD_LVDS_ANA_REG[{i}] (i=0..1) — LCD LVDS Analog Register 0/1 LCD_LVDS0_ANA_REG LCD_LVDS1_ANA_REG
0x228 FSYNC_GEN_CTRL_REG — LCD FSYNC Generate Control Register
0x22C FSYNC_GEN_DLY_REG — LCD FSYNC Generate Delay Register
0x230 LCD_SYNC_CTL_REG — LCD Sync Control Register
{0x248+8i} LCD_LVDS_LMAP_REG[{i}] (i=0..1) — LCD LVDS Lane Map Register0/1
