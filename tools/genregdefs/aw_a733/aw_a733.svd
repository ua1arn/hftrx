# aw_a733 register map
File version: 1.00
Registers are 32-bit, read-write, reset 0x0 unless marked. A register's access mark holds for its fields unless they carry their own. Offsets are from the block's base; [hi:lo] are bit positions; lines under a group give offsets from that group; {n}, {i} and the like mark numbered series.

## TCON_TV0 — TV Output
Base 0x05730000
Same registers: TCON_TV1 0x05731000
0x00 TV_GCTL_REG — TV Global Control Register
0x04 TV_GINT0_REG — TV Global Interrupt Register0
0x08 TV_GINT1_REG — TV Global Interrupt Register1
0x0C TV_GINT2_REG — TV Global Interrupt Register1
0x40 TV_SRC_CTL_REG — TV Source Control Register
0x88 TV_IO_POL_REG — TV IO Polarity Register
0x8C TV_IO_TRI_REG — TV IO Control Register
0x90 TV_CTL_REG — TV Control Register
0x98 TV_BASIC1_REG — TV Basic Timing Register1
0x9C TV_BASIC2_REG — TV Basic Timing Register2
0xA0 TV_BASIC3_REG — TV Basic Timing Regi ster3
0xA4 TV_BASIC4_REG — TV Basic Timing Register4
0xA8 TV_BASIC5_REG — TV Basic Timing Register5
0xFC TV_DEBUG_REG — TV Debug Register
0x100 TV_CEU_CTL_REG — TV CEU Control Register
{0x110+0x30*i} unnamed[{i}] (i=0..2) group
  {0x0+0xC*j} MUL_REG[{j}] (j=0..2) — TCON CEU coefficient register0 (N=0,1,2, 4,5,6, 8,9,10)
{0x140+0xC*i} TV_CEU_COEF_RANG_REG[{i}] (i=0..2) — TV CEU Coefficient Range R egister (N=0,1,2)
0x1F0 TV_SAFE_PERIOD0_REG — TV Safe Period0 Register
0x1F4 TV_SAFE_PERIOD1_REG — TV Safe Period1 Register
0x200 tcon_mul_ctl — https://github.com/qiaoweibiao/T507_Kernel/blob/98fcc7d3f112e51b0edfb71536da89cb2115106f/drivers/video/fbdev/sunxi/disp2/disp/de/lowlevel_sun50iw1/de_lcd_type.h#L691
0x300 TV_FILL_CTL_REG — TV Fill Data Control Register
{0x304+0x24*i} unnamed[{i}] (i=0..2) group
  0x00 TV_FILL_BEGIN_REG — TV Fill Data Begin Register 0x0304+N*0x0C(N=0..2)
  0x04 TV_FILL_END_REG — TV Fill Data End Register 0x0308+N*0x0C(N=0..2)
  0x08 TV_FILL_DATA_REG — TV Fill Data Value Register 0x030C+N*0x0C(N=0..2)
0x328 TV_FILL_DATAH1 — TV Fill Data High1 Value Register
0x32C TV_FILL_DATAH2 — TV Fill Data High2 Value Register
0x330 TV_DATA_IO_POL0_REG — TV Data IO Polarity Control0 Register
0x334 TV_DATA_IO_POL1_REG — TV Data IO Polarity Control1 Register
0x338 TV_DATA_IO_TRI0_REG — TV Data IO Enable Control0 Register
0x33C TV_DATA_IO_TRI1_REG — TV Data IO Enable Control1 Register
0x340 TV_PIXELDEPTH_MODE_REG — TV Pixeldepth Mode Control Register

## Timer1_CPUX
Base 0x02052000
0x00 TMR_IRQ_EN_REG — Timer IRQ Enable Register
0x04 TMR_IRQ_STA_REG — Timer Status Register
{0x10+0x40*i} unnamed[{i}] (i=0..3) group
  0x00 CTRL_REG — Timer n Control Register
  0x04 INTV_VALUE_REG — Timer n Interval Value Register
  0x08 CUR_VALUE_REG — Timer n Current Value Register

## TIMESTAMP_CTRL
Base 0x08020000
0x00 TSTAMP_CTRL_REG — Timestamp Control Register
0x08 CNT_CTRL_LOW_REG — Counter Low Register
0x0C CNT_CTRL_HI_REG — Counter High Register
0x20 CNT_FREQID_REG — Counter Base Frequency ID Register

## TIMESTAMP_STA
Base 0x08010000
0x00 CNT_LOW_REG — Counter Low Register
0x04 CNT_HI_REG — Counter High Register

## TWI0 — Two Wire Interface (TWI)
Base 0x02510000
Same registers: TWI{n} {0x2510000+0x1000*n} (n=1..12), S_TWI0 0x07083000, S_TWI1 0x07084000, S_TWI2 0x07085000
0x00 TWI_ADDR — TWI Slave Address Register
0x04 TWI_XADDR — TWI Extended Slave Address Register
0x08 TWI_DATA — TWI Data Byte Register
0x0C TWI_CNTR — TWI Control Register
0x10 TWI_STAT — TWI Status Register
0x14 TWI_CCR — TWI Clock Control Register
0x18 TWI_SRST — TWI Software Reset Register
0x1C TWI_EFR — TWI Enhance Feature Register
0x20 TWI_LCR — TWI Line Control Register
0x200 TWI_DRV_CTRL — TWI_DRV Control Register
0x204 TWI_DRV_CFG — TWI_DRV Transmission Configuration Register
0x208 TWI_DRV_SLV — TWI_DRV Slave ID Register
0x20C TWI_DRV_FMT — TWI_DRV Packet Format Register
0x210 TWI_DRV_BUS_CTRL — TWI_DRV Bus Control Register
0x214 TWI_DRV_INT_CTRL — TWI_DRV Interrupt Control Register
0x218 TWI_DRV_DMA_CFG — TWI_DRV DMA Configure Register
0x21C TWI_DRV_FIFO_CON — TWI_DRV FIFO Content Register
0x300 TWI_DRV_SEND_FIFO_ACC — TWI_DRV Send Data FIFO Access Register
0x304 TWI_DRV_RECV_FIFO_ACC — TWI_DRV Receive Data FIFO Access Register
