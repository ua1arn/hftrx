# aw_a733 register map
File version: 1.00
Registers are 32-bit, read-write, reset 0x0 unless marked. A register's access mark holds for its fields unless they carry their own. Offsets are from the block's base; [hi:lo] are bit positions; lines under a group give offsets from that group; {n}, {i} and the like mark numbered series.

## PWM0 — Pulse Width Modulation (PWM) module
Base 0x02527000
Same registers: PWM1 0x02528000, S_PWM 0x07023000
0x00 PIER — PWM IRQ Enable Register
0x04 PISR — PWM IRQ Status Register
0x10 CIER — Capture IRQ Enable Register
0x14 CISR — Capture IRQ Status Register
0x18 CCCIER — Capture Cycle Counter IRQ Enable Register
0x1C CCCISR — Capture Cycle Counter IRQ Status Register
{0x20+0x14*i} PCCR[{i}] (i=0..4) — PWM01..PWM89 Clock Configuration Register
0x40 PCGR — PWM Clock Gating Register
{0x60+0x14*i} PDZCR[{i}] (i=0..4) — PWM01..PWM89 Dead Zone Control Register
0x80 PER — PWM Enable Register
{0x90+4i} PGR{i} (i=0..3) — PWM Group{i} Register
0xA0 CCCER — Capture Cycle Counter Enable Register
0xC0 CER — Capture Enable Register
{0x100+0x280*i} unnamed[{i}] (i=0..9) group
  0x00 PCR — (N= 0~9) PWM Control Register
  0x04 PPR — (N= 0~9) PWM Period Register
  0x08 PCNTR — (N= 0~9) PWM Counter Register
  0x0C PPCNTR — (N= 0~9) PWM Pulse Counter Register
  0x10 CCR — (N= 0~9) Capture Control Register
  0x14 CRLR — (N= 0~9) Capture Rise Lock Register
  0x18 CFLR — (N= 0~9) Capture Fall Lock Register
  0x1C CCCSR — (N= 0~9) Capture Cycle Counter Status Register
  0x20 CCCNR — (N= 0~9) Capture Cycle Counter Number Register
  0x24 CCCR — (N= 0~9) Capture Cycle Counter Register

## RTC — Real Time Clock (RTC)
Base 0x07090000
0x00 LOSC_CTRL_REG — LOSC Control Register
0x04 LOSC_AUTO_SWT_STA_REG — LOSC Auto Switch Status Register
0x08 INTOSC_CLK_PRESCAL_REG — Internal OSC Clock Prescaler Register
0x0C INTOSC_CLK_AUTO_CALI_REG — Internal OSC Clock Auto Calibration Register
0x10 RTC_DAY_REG — RTC Year-Month-Day Register
0x14 RTC_HH_MM_SS_SET_REG — RTC Hour-Minute-Second Register
0x20 ALARM0_DAY_SET_REG — Alarm 0 Day Set Register
0x24 ALARM0_CUR_VLU_REG — Alarm 0 Counter Current Value Register
0x28 ALARM0_ENABLE_REG — Alarm 0 Enable Register
0x2C ALARM0_IRQ_EN — Alarm 0 IRQ Enable Register
0x30 ALARM0_IRQ_STA_REG — Alarm 0 IRQ Status Register
0x50 ALARM0_CONFIG_REG — Alarm 0 Config Register
0x60 CLK32K_FOUT_CTRL_GATING_REG — RTC_32K Fanout Control register
{0x100+0x20*i} GP_DATA_REGn[{i}] (i=0..7) — (N=0~7) General Purpose Register
0x15C XO_CTRL_WP_REG — DCXO Control Write Protect Register
0x160 XO_CTRL0_REG — DCXO Control0 Register
0x164 CALI_CTRL_REG — Calibration Control Register
0x16C XO_CTRL1_REG — DCXO Control1 Register
0x190 VDD_RTC_REG — VDD RTC Regulation Register
0x1F0 IC_CHARA_REG — IC Characteristic Register
0x1F4 VDD_OFF_GATING_CTRL_REG — VDD Off Gating Control Register
0x204 EFUSE_HV_PWRSWT_CTRL_REG — Efuse High Voltage Power Switch Control Register
0x310 RTC_SPI_CLK_CTRL_REG — RTC SPI Clock Control Register

## RTWB_RCQ
Base 0x05008200
0x00 RTWB_RCQ_IRQ — RTWB_RCQ_IRQ_OFFSET (0x8200)
0x04 RTWB_RCQ_STS — RTWB_RCQ_STS_OFFSET (0x8204)
0x10 RTWB_RCQ_CTL — RTWB_RCQ_CTL_OFFSET (0x8210)

## R_CPUCFG — SUNXI_R_CPUCFG_BASE
Base 0x07050000
0x1C0 HOTPLUGFLAG — Check for value 0xFA50392F ?
{0x1C4+0x10*i} SOFTENTRY0_3[{i}] (i=0..3) — The Soft Entry Address Register of core0..core3
{0x1E0+0x10*i} SOFTENTRY4_7[{i}] (i=0..3) — The Soft Entry Address Register of core4..core7
{0x200+0x20*i} HOTPLUG_CONTROL_REG[{i}] (i=0..7)
{0x220+0x20*i} HOTPLUG_POWERMODE_REG[{i}] (i=0..7)

## SID — Security ID
Base 0x03006000
0x40 SID_PRCTL
0x60 SID_RDKEY
{0x200+0x400*i} SID_DATA[{i}] (i=0..255) — SID data (xfel display as 'sid' replay)

## SMHC0 — SD-MMC Host Controller
Base 0x04020000
Same registers: SMHC1 0x04021000, SMHC2 0x04022000, SMHC3 0x04023000
0x00 SMHC_CTRL — Control Register
0x04 SMHC_CLKDIV — Clock Control Register
0x08 SMHC_TMOUT — Time Out Register
0x0C SMHC_CTYPE — Bus Width Register
0x10 SMHC_BLKSIZ — Block Size Register
0x14 SMHC_BYTCNT — Byte Count Register
0x18 SMHC_CMD — Command Register
0x1C SMHC_CMDARG — Command Argument Register
{0x20+4i} SMHC_RESP{i} (i=0..3) — Response {i} Register
0x30 SMHC_INTMASK — Interrupt Mask Register
0x34 SMHC_MINTSTS — Masked Interrupt Status Register
0x38 SMHC_RINTSTS — Raw Interrupt Status Register
0x3C SMHC_STATUS — Status Register
0x40 SMHC_FIFOTH — FIFO Water Level Register
0x44 SMHC_FUNS — FIFO Function Select Register
0x48 SMHC_TCBCNT — Transferred Byte Count between Controller and Card
0x4C SMHC_TBBCNT — Transferred Byte Count between Host Memory and Internal FIFO
0x50 SMHC_DBGC — Current Debug Control Register
0x54 SMHC_CSDC — CRC Status Detect Control Register (Only for SMHC2)
0x58 SMHC_A12A — Auto Command 12 Argument Register
0x5C SMHC_NTSR — SD New Timing Set Register (Only for SMHC0, SMHC1)
0x78 SMHC_HWRST — Hardware Reset Register
0x80 SMHC_IDMAC — IDMAC Control Register
0x84 SMHC_DLBA — Descriptor List Base Address Register
0x88 SMHC_IDST — IDMAC Status Register
0x8C SMHC_IDIE — IDMAC Interrupt Enable Register
0x100 SMHC_THLD — Card Threshold Control Register
0x104 SMHC_SFC — Sample FIFO Control Register (Only for SMHC2)
0x108 SMHC_A23A — Auto Command 23 Argument Register (Only for SMHC2)
0x10C EMMC_DDR_SBIT_DET — eMMC4.5 DDR Start Bit Detection Control Register
0x110 SMHC_RES_CRC — Response CRC from Device (Only for SMHC0, SMHC1)
{0x114+0x20*i} SMHC_D7_D0_CRC[{i}] (i=0..7) — CRC in Data7..Data0 from Device (Only for SMHC0, SMHC1)
0x134 SMHC_CRC_STA — Write CRC Status Register (Only for SMHC0, SMHC1)
0x138 SMHC_EXT_CMD — Extended Command Register (Only for SMHC2)
0x13C SMHC_EXT_RESP — Extended Response Register (Only for SMHC2)
0x140 SMHC_DRV_DL — Drive Delay Control Register
0x144 SMHC_SAMP_DL — Sample Delay Control Register
0x148 SMHC_DS_DL — Data Strobe Delay Control Register (Only for SMHC2)
0x200 SMHC_FIFO — Read/Write FIFO
