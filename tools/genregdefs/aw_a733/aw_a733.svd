# aw_a733 register map
File version: 1.00
Registers are 32-bit, read-write, reset 0x0 unless marked. A register's access mark holds for its fields unless they carry their own. Offsets are from the block's base; [hi:lo] are bit positions; lines under a group give offsets from that group; {n}, {i} and the like mark numbered series.

## DISPLAY0_TOP — VIDE0_OUT1_SYS
Base 0x05500000
0x04 DSI_SRC_SEL — MIPI DSI Data Source Select Register
0x08 DUAL_DSI_SKEW — Dual MIPI DSI Data Skew Register
0x0C LCD_CLK_SRC_COMB_CLK_SRC — LCD Clock And Combophy Clock Source Select Register
0x20 VO0_MODULE_GATING — TCON_LCD Output To LVDS/DSI Gating Register

## DISPLAY1_TOP — VIDEO_OUT1_SYS
Base 0x05510000
0x00 TV_CLK_EDP_I2S1_SRC — TCON_TV Clock Select And EDP I2S1 Select Register
0x20 VO1_MODULE_GATING — TCON_TV Output To HDMI Gating Register

## DMA0
Base 0x04601000
Same registers: DMA1 0x04024000
0x20 DMAC_SEC_REG — DMA Security Register
0x28 DMAC_AUTO_GATE_REG — DMAC Auto Gating Register
0x30 DMAC_STA_REG — DMAC Status Register
0x34 DMA_IRQ_CPU_EN_REG — DMA IRQ Transfer to CPU Field Enable Register
0x38 DMA_IRQ_CPUS_EN_REG — DMA IRQ Transfer to CPUS Field Enable Register
{0x100+0x400*i} unnamed[{i}] (i=0..15) group
  0x00 DMAC_EN_REGN — DMAC Channel Enable Register N (N = 0 to 15) 0x0100 + N*0x0040
  0x04 DMAC_PAU_REGN — DMAC Channel Pause Register N (N = 0 to 15) 0x0104 + N*0x0040
  0x08 DMAC_DESC_ADDR_REGN — DMAC Channel Start Address Register N (N = 0 to 15) 0x0108 + N*0x0040
  0x0C DMA_CFG_REGN — DMAC Channel Configuration Register N (N = 0 to 15) 0x010C + N*0x0040
  0x10 DMAC_CUR_SRC_REGN — DMAC Channel Current Source Register N (N = 0 to 15) 0x0110 + N*0x0040
  0x14 DMAC_CUR_DEST_REGN — DMAC Channel Current Destination Register N (N = 0 to 15) 0x0114 + N*0x0040
  0x18 DMAC_BCNT_LEFT_REGN — DMAC Channel Byte Counter Left Register N (N = 0 to 15) 0x0118 + N*0x0040
  0x1C DMA_PARA_REGN — DMAC Channel Parameter Register N (N = 0 to 15) 0x011C + N*0x0040
  0x28 DMAC_MODE_REGN — DMAC Mode Register N (N = 0 to 15) 0x0128 + N*0x0040
  0x2C DMAC_FDESC_ADDR_REGN — DMAC Former Descriptor Address Register N (N = 0 to 15) 0x012C + N*0x0040
  0x30 DMAC_PKG_NUM_REGN — DMAC Package Number Register N (N = 0 to 15) 0x0130 + N*0x0040
  0x34 DMA_IRQ_EN_REG — DMA IRQ Enable Register
  0x38 DMA_IRQ_PEND_REG — DMA IRQ Pending Status Register
  0x3C DMA_DESC_HIG_ADDR_REG — DMA Channel Descriptor Highes Address Register

## G2D_BLD — Graphic 2D (G2D) Engine Blender
Base 0x05440400
0x00 BLD_FILL_COLOR_CTL — BLD_EN_CTL BLD_FILL_COLOR_CTL Allwinner_DE2.0_Spec_V1.0.pdf page 106
{0x10+8i} BLD_FILL_COLOR[{i}] (i=0..1) — BLD_FILLC N=0..1
{0x20+8i} BLD_CH_ISIZE[{i}] (i=0..1) — BLD_CH_ISIZE N=0..1
{0x30+8i} BLD_CH_OFFSET[{i}] (i=0..1) — BLD_CH_OFFSET N=0..1
0x40 BLD_PREMUL_CTL
0x44 BLD_BK_COLOR
0x48 BLD_SIZE
0x4C BLD_CTL
0x50 BLD_KEY_CTL
0x54 BLD_KEY_CON
0x58 BLD_KEY_MAX
0x5C BLD_KEY_MIN
0x60 BLD_OUT_COLOR
0x80 ROP_CTL
{0x84+0x10*i} ROP_INDEX[{i}] (i=0..3) — ROP_INDEX N=0..1 ch3_index0 (tina linux sources has two elements)
0x100 BLD_CSC_CTL
{0x110+0x30*i} BLD_CSC{i}_COEF00 (i=0..2)
{0x114+0x30*i} BLD_CSC{i}_COEF01 (i=0..2)
{0x118+0x30*i} BLD_CSC{i}_COEF02 (i=0..2)
{0x11C+0x30*i} BLD_CSC{i}_CONST0 (i=0..2)
{0x120+0x30*i} BLD_CSC{i}_COEF10 (i=0..2)
{0x124+0x30*i} BLD_CSC{i}_COEF11 (i=0..2)
{0x128+0x30*i} BLD_CSC{i}_COEF12 (i=0..2)
{0x12C+0x30*i} BLD_CSC{i}_CONST1 (i=0..2)
{0x130+0x30*i} BLD_CSC{i}_COEF20 (i=0..2)
{0x134+0x30*i} BLD_CSC{i}_COEF21 (i=0..2)
{0x138+0x30*i} BLD_CSC{i}_COEF22 (i=0..2)
{0x13C+0x30*i} BLD_CSC{i}_CONST2 (i=0..2)

## G2D_MIXER — Graphic 2D (G2D) Engine Video Mixer
Base 0x05440100
Same registers: G2D_MIXER1 0x05440200, G2D_MIXER2 0x05440300
0x00 G2D_MIXER_CTRL — G2D mixer control
0x04 G2D_MIXER_INTERRUPT
0x08 G2D_MIXER_CLK — G2D mixer clock

## G2D_ROT — Graphic 2D Rotate
Base 0x05468000
0x00 ROT_CTL
0x04 ROT_INT
0x08 ROT_TIMEOUT
0x20 ROT_IFMT — Input data attribute register
0x24 ROT_ISIZE — Input data size register
0x30 ROT_IPITCH0 — Input Y/RGB/ARGB memory pitch register
0x34 ROT_IPITCH1 — Input U/UV memory pitch register
0x38 ROT_IPITCH2 — Input V memory pitch register
0x40 ROT_ILADD0 — Input Y/RGB/ARGB memory address register0
0x44 ROT_IHADD0 — Input Y/RGB/ARGB memory address register1
0x48 ROT_ILADD1 — Input U/UV memory address register0
0x4C ROT_IHADD1 — Input U/UV memory address register1
0x50 ROT_ILADD2 — Input V memory address register0
0x54 ROT_IHADD2 — Input V memory address register1
0x84 ROT_OSIZE — Output data size register
0x90 ROT_OPITCH0 — Output Y/RGB/ARGB memory pitch register
0x94 ROT_OPITCH1 — Output U/UV memory pitch register
0x98 ROT_OPITCH2 — Output V memory pitch register
0xA0 ROT_OLADD0 — Output Y/RGB/ARGB memory address register0
0xA4 ROT_OHADD0 — Output Y/RGB/ARGB memory address register1
0xA8 ROT_OLADD1 — Output U/UV memory address register0
0xAC ROT_OHADD1 — Output U/UV memory address register1
0xB0 ROT_OLADD2 — Output V memory address register0
0xB4 ROT_OHADD2 — Output V memory address register1
0xC8 LBC_ENC_CTL — Encode control (bit 31 - is lossy)
0xCC LBC_CTL
0xD0 LBC_DEC_CTL — Decode control (bit 31 - is lossy)
