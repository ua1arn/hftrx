# aw_a733 register map
File version: 1.00
Registers are 32-bit, read-write, reset 0x0 unless marked. A register's access mark holds for its fields unless they carry their own. Offsets are from the block's base; [hi:lo] are bit positions; lines under a group give offsets from that group; {n}, {i} and the like mark numbered series.

## CPU_SUBSYS_CTRL
Base 0x08000000
0x00 GENER_CTRL_REG0 — General Control Register 0
0x0C CPU_SYS_RST_CTRL — CPU Subsystem Reset Control Register
0x140 PLL_CTRL_REG0 — PLL Control Register 0
0x144 PLL_CTRL_REG1 — PLL Control Register 1
0x200 CPU_DA_DDR_CTRL_REG — CPU Direct Access DDR Control Register
{0x1000+0x8000*i} unnamed[{i}] (i=0..7) group
  0x00 CPU_CTRL_REG — Cluster 0 CPU0 Control Register
  0x04 RVBARADDR_L — Cluster0 Reset Vector Base Address Register 0_L
  0x08 RVBARADDR_H — Cluster0 Reset Vector Base Address Register 0_H

## DE_MIXER0_BLD — Display Engine (DE) - Blender
Base 0x05281000
Same registers: DE_MIXER1_BLD 0x052A1000
0x00 BLD_EN_COLOR_CTL — BLD_FILL_COLOR_CTL Offset 0x000 BLD fill color control register
{0x4+0x60*i} unnamed[{i}] (i=0..5) group
  0x00 BLD_FILL_COLOR
  0x04 BLD_CH_ISIZE — BLD input memory size register
  0x08 BLD_CH_OFFSET — BLD input memory offset register
0x80 ROUTE — BLD_CH_RTCTL BLD routing control register (default value 0x00543210)
0x84 PREMULTIPLY — BLD pre-multiply control register
0x88 BKCOLOR
0x8C OUTPUT_SIZE
{0x90+0x18*i} BLD_MODE[{i}] (i=0..5) — BLD_CTL SUN8I_MIXER_BLEND_MODE blender0..blaener3 (or more)
0xB0 CK_CTL
0xB4 CK_CFG
{0xC0+0x10*i} CK_MAX[{i}] (i=0..3)
{0xE0+0x10*i} CK_MIN[{i}] (i=0..3)
0xFC OUT_CTL
0x100 CSC_CTL — SUN50I_MIXER_BLEND_CSC_CTL
{0x110+0x30*i} CSC_COEFF[{i}] (i=0..11) — SUN50I_MIXER_BLEND_CSC_COEFF(base, layer, x) ((base) + 0x110 + (layer)*0x30 + (x)*4)

## DE_BLS1 — Blue Level Stretch (BLS)
Base 0x05111000
Same registers: DE_BLS2 0x05131000, DE_BLS3 0x05151000, DE_BLS4 0x051D1000, DE_BLS5 0x051F1000, DE_BLS6 0x05211000
0x00 BLS_CTRL_REG — BLS module control register
0x04 BLS_SIZE_REG — BLS size register
0x08 BLS_WIN0_REG — BLS window setting register0
0x0C BLS_WIN1_REG — BLS window setting register1
{0x10+0x10*i} BLS_ATTLUT_REG[{i}] (i=0..3) — 0x10+N*0x4 BLS attenuation LUT register, +N*0x4 (N = 0,1,2,3)
0x20 BLS_POS_REG — BLS blue zone position register
{0x30+0x10*i} BLS_GAINLUT_REG[{i}] (i=0..3) — 0x30+N*0x4 BLS GainLUT access register, +N*0x4, Total 16byte, 16*8bit (N = 0,1,2,3)

## DE_DNS1 — Denoise (DNS)
Base 0x01114000
Same registers: DE_DNS2 0x01134000, DE_DNS3 0x01151400, DE_DNS4 0x011D4000, DE_DNS5 0x011F4000, DE_DNS6 0x01214000
0x00 DNS_CTL — DNS module control register
0x04 DNS_SIZE

## DE_FCC1 — Fancy color curvature (FCC)
Base 0x05111400
Same registers: DE_FCC2 0x05131400, DE_FCC3 0x05151400, DE_FCC4 0x051D1400, DE_FCC5 0x051F1400, DE_FCC6 0x05211400
0x00 FCC_CTL_REG — FCC Control Register
0x04 FCC_INPUT_SIZE_REG — FCC Input Size Register
0x08 FCC_OUTPUT_WIN0_REG — FCC Output Window0 Register
0x0C FCC_OUTPUT_WIN1_REG — FCC Output Window1 Register

## DE_FCE1 — Fresh and Contrast Enhancement (FCE)
Base 0x05110000
Same registers: DE_FCE2 0x05130000, DE_FCE3 0x05150000, DE_FCE4 0x051D0000, DE_FCE5 0x051F0000, DE_FCE6 0x05210000
0x00 GCTRL_REG — Control register
0x04 FCE_SIZE_REG — Size setting register
0x08 FCE_WIN0_REG — Window setting 0 register
0x0C FCE_WIN1_REG — Window setting 1 register
0x20 HIST_SUM_REG — Histogram sum register
0x24 HIST_STATUS_REG — Histogram status register
0x28 CE_STATUS_REG — CE LUT status register
0x2C CE_CC_REG — CE chroma compensation function setting register
0x30 FTC_GAIN_REG — FTC gain setting register
0x34 FTD_HUE_THR_REG — FTD hue threshold setting register
0x38 FTD_CHROMA_THR_REG — FTD chroma threshold setting register
0x3C FTD_SLP_REG — FTD slop setting register
0x40 CSC_ENABLE_REG — CSC enable setting register
{0x44+4i} CSC_D{i}_REG (i=0..2) — CSC Constant D{i} Register
{0x50+4i} CSC_C{i:02}_REG (i=0..2) — CSC Coefficient {i:02} Register
0x5C CSC_C03_REG — CSC Constant 03 Register
{0x38+4i} CSC_C{i}_REG (i=10..12) — CSC Coefficient {i} Register
0x6C CSC_C13_REG — CSC Constant 13 Register
{0x20+4i} CSC_C{i}_REG (i=20..22) — CSC Coefficient {i} Register
0x7C CSC_C23_REG — CSC Constant 23 Register
{0x200+0x200*i} CE_LUT_REGN[{i}] (i=0..127) — 0x200+N*4 CE LUT register N (N=0:127)
{0x400+0x400*i} HIST_CNT_REGN[{i}] (i=0..255) — 0x400+N*4 Histogram count register N (N=0:255)
