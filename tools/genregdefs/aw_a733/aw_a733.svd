# aw_a733 register map
File version: 1.00
Registers are 32-bit, read-write, reset 0x0 unless marked. A register's access mark holds for its fields unless they carry their own. Offsets are from the block's base; [hi:lo] are bit positions; {n}, {i} and the like mark numbered series.

## G2D_VSU — Graphic 2D Video Scaler
Base 0x05448000
0x00 VS_CTRL
0x40 VS_OUT_SIZE
0x44 VS_GLB_ALPHA
0x80 VS_Y_SIZE
0x88 VS_Y_HSTEP
0x8C VS_Y_VSTEP
0x90 VS_Y_HPHASE
0x98 VS_Y_VPHASE0
0xC0 VS_C_SIZE
0xC8 VS_C_HSTEP
0xCC VS_C_VSTEP
0xD0 VS_C_HPHASE
0xD8 VS_C_VPHASE0
{0x200+0x100*i} VS_Y_HCOEF[{i}] (i=0..63) — VS_Y_HCOEF[N]. N=0..31
{0x300+0x100*i} VS_Y_VCOEF[{i}] (i=0..63) — VS_Y_VCOEF[N]. N=0..31
{0x400+0x100*i} VS_C_HCOEF[{i}] (i=0..63) — VS_C_HCOEF[N]. N=0..31

## G2D_WB — Graphic 2D (G2D) Engine Write Back
Base 0x05443000
0x00 WB_ATT
0x04 WB_SIZE
{0x8+4i} WB_PITCH{i} (i=0..2)
{0x14+8i} WB_LADD{i} (i=0..2)
{0x18+8i} WB_HADD{i} (i=0..2)

## GICD — GIC Distributor
Base 0x03400000
0x00 GICD_CTLR — Distributor Control Register
0x04 GICD_TYPER — Distributor Controller Type Register
0x08 GICD_IIDR — Distributor Implementer Identification Register
0x20 GICD_FCTLR — Function Control Register
0x24 GICD_SAC — Secure Access Control Register
0x40 GICD_SETSPI_NSR — Non-secure SPI Set Register
0x48 GICD_CLRSPI_NSR — Non-secure SPI Clear Register
0x50 GICD_SETSPI_SR — Secure SPI Set Register
0x58 GICD_CLRSPI_SR — Non-secure SPI Set Register
{0x80+0x80*i} GICD_IGROUPR[{i}] (i=0..31) — Interrupt Group Registers
{0x100+0x80*i} GICD_ISENABLER[{i}] (i=0..31) — Interrupt Set-Enable Registers
{0x180+0x80*i} GICD_ICENABLER[{i}] (i=0..31) — Interrupt Clear-Enable Registers
{0x200+0x80*i} GICD_ISPENDR[{i}] (i=0..31) — Interrupt Set-Pending Registers
{0x280+0x80*i} GICD_ICPENDR[{i}] (i=0..31) — Interrupt Clear-Pending Registers
{0x300+0x80*i} GICD_ISACTIVER[{i}] (i=0..31) — Interrupt Set-Active Registers
{0x380+0x80*i} GICD_ICACTIVER[{i}] (i=0..31) — Interrupt Clear-Active Registers
{0x400+0x400*i} GICD_IPRIORITYR[{i}] (i=0..255) — Interrupt Priority Registers
{0xC00+0x100*i} GICD_ICFGR[{i}] (i=0..63) — Interrupt Configuration Registers
{0xD00+0x80*i} GICD_IGRPMODR[{i}] (i=0..31) — Interrupt Group Modifier Registers
{0xE00+0x100*i} GICD_NSACR[{i}] (i=0..63) — Non-secure Access Control Registers
{0x6000+0x1EE0*i} GICD_IROUTER[{i}] (i=0..987) 64-bit (reset mask 0xFFFFFFFF) — Interrupt Routing Registers.
0xC000 GICD_CHIPSR — Chip Status Register
0xC004 GICD_DCHIPR — Default Chip Register
{0xC008+0x20*i} GICD_CHIPRn[{i}] (i=0..3) 64-bit (reset mask 0xFFFFFFFF) — Chip Registers
{0xE008+0x10*i} GICD_ICLARn[{i}] (i=0..3) — The first register is GICD_ICLAR2. 4.2.9 Interrupt Class Registers, GICD_ICLARn on page 4-118
0xE108 GICD_IERRRn — The first register is GICD_IERRR1. 4.2.10 Interrupt Error Registers, GICD_IERRRn on page 4-119
0xF000 GICD_CFGID 64-bit (reset mask 0xFFFFFFFF) — Configuration ID Register
{0xFFC0+4i} GICD_PIDR{i} (i=4..7) — Peripheral ID {i} Register
{0xFFE0+4i} GICD_PIDR{i} (i=0..3) — Peripheral ID {i} Register
{0xFFF0+4i} GICD_CIDR{i} (i=0..3) — Component ID {i} Register

## GICT — GIC ITS translation
Base 0x03420000
Registers as GICD (with GICD read as GICT), without GICD_SAC, GICD_SETSPI_NSR, GICD_CLRSPI_NSR, GICD_SETSPI_SR, GICD_CLRSPI_SR, GICD_IGROUPR, GICD_ISENABLER, GICD_ICENABLER, GICD_ISPENDR, GICD_ICPENDR, GICD_ISACTIVER, GICD_ICACTIVER, GICD_IPRIORITYR, GICD_ICFGR, GICD_IGRPMODR, GICD_NSACR, GICD_IROUTER, GICD_CHIPSR, GICD_DCHIPR, GICD_CHIPRn, GICD_ICLARn, GICD_IERRRn; these are added or differ:
0x28 GICT_OPR 64-bit (reset mask 0xFFFFFFFF) — Operations Register
0x30 GICT_OPSR 64-bit (reset mask 0xFFFFFFFF) — Operation Status Register
0x80 GICT_GICT_CBASER 64-bit (reset mask 0xFFFFFFFF) — Command Queue Control Register
0x88 GICT_CWRITER 64-bit (reset mask 0xFFFFFFFF) — Command Queue Write Pointer Register
0x90 GICT_CREADR 64-bit (reset mask 0xFFFFFFFF) — Command Queue Read Pointer Register
0x100 GICT_BASER0 64-bit (reset mask 0xFFFFFFFF) — ITS Translation Table Descriptor Register0
0x108 GICT_BASER1 64-bit (reset mask 0xFFFFFFFF) — ITS Translation Table Descriptor Register0
