# aw_a733 register map
File version: 1.00
Registers are 32-bit, read-write, reset 0x0 unless marked. A register's access mark holds for its fields unless they carry their own. Offsets are from the block's base; [hi:lo] are bit positions; {n}, {i} and the like mark numbered series.

## CCU — Clock Controller Unit (CCU)
Base 0x02002000
0x20 PLL_DDR_CTRL_REG — PLL_DDR Control Register
0x24 PLL_DDR_LOCK_CTRL_REG — PLL_DDR Lock Control Register
0x28 PLL_DDR_PAT0_CTRL_REG — PLL_DDR Pattern0 Control Register
0x2C PLL_DDR_PAT1_CTRL_REG — PLL_DDR Pattern1 Control Register
0x30 PLL_DDR_BIAS_REG — PLL_DDR Bias Register
0xA0 PLL_PERI0_CTRL_REG — PLL_PERI0 Control Register
0xA4 PLL_PERI0_LOCK_CTRL_REG — PLL_PERI0 Lock Control Register
0xA8 PLL_PERI0_PAT0_CTRL_REG — PLL_PERI0 Pattern0 Control Register
0xAC PLL_PERI0_PAT1_CTRL_REG — PLL_PERI0 Pattern1 Control Register
0xB0 PLL_PERI0_BIAS_REG — PLL_PERI0 Bias Register
0xC0 PLL_PERI1_CTRL_REG — PLL_PERI1 Control Register
0xC4 PLL_PERI1_LOCK_CTRL_REG — PLL_PERI1 Lock Control Register
0xC8 PLL_PERI1_PAT0_CTRL_REG — PLL_PERI1 Pattern0 Control Register
0xCC PLL_PERI1_PAT1_CTRL_REG — PLL_PERI1 Pattern1 Control Register
0xD0 PLL_PERI1_BIAS_REG — PLL_PERI1 Bias Register
0xE0 PLL_GPU0_CTRL_REG — PLL_GPU0 Control Register
0xE4 PLL_GPU0_LOCK_CTRL_REG — PLL_GPU0 Lock Control Register
0xE8 PLL_GPU0_PAT0_CTRL_REG — PLL_GPU0 Pattern0 Control Register
0xEC PLL_GPU0_PAT1_CTRL_REG — PLL_GPU0 Pattern1 Control Register
0xF0 PLL_GPU0_BIAS_REG — PLL_GPU0 Bias Register
{0x120+0x20*i} PLL_VIDEO{i}_CTRL_REG (i=0..2) — PLL_VIDEO{i} Control Register
{0x124+0x20*i} PLL_VIDEO{i}_LOCK_CTRL_REG (i=0..2) — PLL_VIDEO{i} Lock Control Register
{0x128+0x20*i} PLL_VIDEO{i}_PAT0_CTRL_REG (i=0..2) — PLL_VIDEO{i} Pattern0 Control Register
{0x12C+0x20*i} PLL_VIDEO{i}_PAT1_CTRL_REG (i=0..2) — PLL_VIDEO{i} Pattern1 Control Register
{0x130+0x20*i} PLL_VIDEO{i}_BIAS_REG (i=0..2) — PLL_VIDEO{i} Bias Register
0x220 PLL_VE0_CTRL_REG — PLL_VE0 Control Register
0x224 PLL_VE0_LOCK_CTRL_REG — PLL_VE0 Lock Control Register
0x228 PLL_VE0_PAT0_CTRL_REG — PLL_VE0 Pattern0 Control Register
0x22C PLL_VE0_PAT1_CTRL_REG — PLL_VE0 Pattern1 Control Register
0x230 PLL_VE0_BIAS_REG — PLL_VE0 Bias Register
0x240 PLL_VE1_CTRL_REG — PLL_VE1 Control Register
0x244 PLL_VE1_LOCK_CTRL_REG — PLL_VE1 Lock Control Register
0x248 PLL_VE1_PAT0_CTRL_REG — PLL_VE1 Pattern0 Control Register
0x24C PLL_VE1_PAT1_CTRL_REG — PLL_VE1 Pattern1 Control Register
0x250 PLL_VE1_BIAS_REG — PLL_VE1 Bias Register
0x260 PLL_AUDIO0_CTRL_REG — PLL_AUDIO0 Control Register
0x264 PLL_AUDIO0_LOCK_CTRL_REG — PLL_AUDIO0 Lock Control Register
0x268 PLL_AUDIO0_PAT0_CTRL_REG — PLL_AUDIO0 Pattern0 Control Register
0x26C PLL_AUDIO0_PAT1_CTRL_REG — PLL_AUDIO0 Pattern1 Control Register
0x270 PLL_AUDIO0_BIAS_REG — PLL_AUDIO0 Bias Register
0x280 PLL_AUDIO1_CTRL_REG — PLL_AUDIO1 Control Register
0x284 PLL_AUDIO1_LOCK_CTRL_REG — PLL_AUDIO1 Lock Control Register
0x288 PLL_AUDIO1_PAT0_CTRL_REG — PLL_AUDIO1 Pattern0 Control Register
0x28C PLL_AUDIO1_PAT1_CTRL_REG — PLL_AUDIO1 Pattern1 Control Register
0x290 PLL_AUDIO1_BIAS_REG — PLL_AUDIO1 Bias Register
0x2A0 PLL_NPU_CTRL_REG — PLL_NPU Control Register
0x2A4 PLL_NPU_LOCK_CTRL_REG — PLL_NPU Lock Control Register
0x2A8 PLL_NPU_PAT0_CTRL_REG — PLL_NPU Pattern0 Control Register
0x2AC PLL_NPU_PAT1_CTRL_REG — PLL_NPU Pattern1 Control Register
0x2B0 PLL_NPU_BIAS_REG — PLL_NPU Bias Register
0x2E0 PLL_DE_CTRL_REG — PLL_DE Control Register
0x2E4 PLL_DE_LOCK_CTRL_REG — PLL_DE Lock Control Register
0x2E8 PLL_DE_PAT0_CTRL_REG — PLL_DE Pattern0 Control Register
0x2EC PLL_DE_PAT1_CTRL_REG — PLL_DE Pattern1 Control Register
0x2F0 PLL_DE_BIAS_REG — PLL_DE Bias Register
0x500 AHB_CLK_REG — AHB Clock Register
0x510 APB0_CLK_REG — APB0 Clock Register
0x518 APB1_CLK_REG — APB1 Clock Register
0x538 APB_UART_CLK_REG — APB_UART Clock Register
0x540 TRACE_CLK_REG — TRACE Clock Register
0x560 GIC_CLK_REG — GIC Clock Register
0x568 CPU_PERI_CLK_REG
0x574 ITS0_BGR_REG — ITS0 Bus Gating Reset Register
0x580 NSI_CLK_REG — NSI Clock Register
0x584 NSI_BGR_REG — NSI Bus Gating Reset Register
0x588 MBUS_CLK_REG — MBUS Clock Register
0x58C IOMMU0_BGR_REG — IOMMU0 Bus Gating Reset Register
{0x594+8i} MSI_LITE{i}_BGR_REG (i=0..2) — MSI_LITE{i} Bus Gating Reset Register
0x5B4 IOMMU1_BGR_REG — IOMMU1 Bus Gating Reset Register
0x5C0 AHB_MAT_CLK_GATING_REG — AHB Master Clock Gating Register
0x5E0 MBUS_MAT_CLK_GATING_REG — MBUS Master Clock Gating Register
0x5E4 MBUS_GATE_EN_REG — MBUS Gate Enable Register
0x704 DMA0_BGR_REG — DMA0 Bus Gating Reset Register
0x70C DMA1_BGR_REG — DMA1 Bus Gating Reset Register
0x724 SPINLOCK_BGR_REG — SPINLOCK Bus Gating Reset Register
0x744 MSGBOX0_BGR_REG — MSGBOX0 Bus Gating Reset Register
0x784 PWM0_BGR_REG — PWM0 Bus Gating Reset Register
0x78C PWM1_BGR_REG — PWM1 Bus Gating Reset Register
0x7A4 DBGSYS_BGR_REG — DBGSYS Bus Gating Reset Register
0x7AC SYSDAP_BGR_REG — SYSDAP Bus Gating Reset Register
{0x800+4i} TIMER0_CLK{i}_CLK_REG (i=0..9) — TIMER0_CLK{i} Clock Register
0x850 TIMER0_BGR_REG — TIMER0 Bus Gating Reset Register
0xA00 DE0_CLK_REG — DE0 Clock Register
0xA04 DE0_BGR_REG — DE0 Bus Gating Reset Register
0xA20 DI_CLK_REG — DI Clock Register
0xA24 DI_BGR_REG — DI Bus Gating Reset Register
0xA40 G2D_CLK_REG — G2D Clock Register
0xA44 G2D_BGR_REG — G2D Bus Gating Reset Register
0xA60 EINK_CLK_REG — EINK Clock Register
0xA64 EINK_PANEL_CLK_REG — EINK PANEL Clock Register
0xA6C EINK_BGR_REG — EINK Bus Gating Reset Register
0xA74 DE_SYS_BGR_REG — DE_SYS Bus Gating Reset Register
0xA80 VE_ENC0_CLK_REG — VE_ENC0 Clock Register
0xA88 VE_DEC_CLK_REG — VE_DEC Clock Register
0xA8C VE_BGR_REG — VE Bus Gating Reset Register
0xAC0 CE_CLK_REG — CE Clock Register
0xAC4 CE_BGR_REG — CE Bus Gating Reset Register
0xB00 NPU_CLK_REG — NPU Clock Register
0xB04 NPU_BGR_REG — NPU Bus Gating Reset Register
0xB20 GPU0_CLK_REG — GPU0 Clock Register
0xB24 GPU0_GATING_REG — GPU0 Gating Reset Configuration Register
0xC00 DRAM0_CLK_REG — DRAM0 Clock Register
0xC0C DRAM0_BGR_REG — DRAM0 Bus Gating Reset Register
0xC80 NAND0_CLK0_CLK_REG — NAND0 CLK0 Clock Register
0xC84 NAND0_CLK1_CLK_REG — NAND0 CLK1 Clock Register
0xC8C NAND0_BGR_REG — NAND0 Bus Gating Reset Register
{0xD00+0x10*i} SMHC{i}_CLK_REG (i=0..3) — SMHC{i} Clock Register
{0xD0C+0x10*i} SMHC{i}_BGR_REG (i=0..3) — SMHC{i} Bus Gating Reset Register
0xD80 UFS_AXI_CLK_REG — UFS_AXI Clock Register
0xD84 UFS_CFG_CLK_REG — UFS_CFG Clock Register
0xD8C UFS_BGR_REG — UFS Bus Gating Reset Register
0xD90 UFS_REF_CLK_EN_REG — UFS Reference Clock Enable Register
{0xE00+4i} UART{i}_BGR_REG (i=0..6) — UART{i} Bus Gating Reset Register
{0xE80+4i} TWI{i}_BGR_REG (i=0..12) — TWI{i} Bus Gating Reset Register
{0xF00+8i} SPI{i}_CLK_REG (i=0..2) — SPI{i} Clock Register
{0xF04+8i} SPI{i}_BGR_REG (i=0..2) — SPI{i} Bus Gating Reset Register
0xF18 SPIF_CLK_REG — SPIF Clock Register
0xF1C SPIF_BGR_REG — SPIF Bus Gating Reset Register
0xF20 SPI3_CLK_REG — SPI3 Clock Register
0xF24 SPI3_BGR_REG — SPI3 Bus Gating Reset Register
0xFC0 GPADC0_24M_CLK_REG — GPADC0_24M Clock Register
0xFC4 GPADC0_BGR_REG — GPADC0 Bus Gating Reset Register
0xFE4 THS0_BGR_REG — THS0 Bus Gating Reset Register
0x1000 IRRX_CLK_REG — IRRX Clock Register
0x1004 IRRX_BGR_REG — IRRX Bus Gating Reset Register
0x1008 IRTX_CLK_REG — IRTX Clock Register
0x100C IRTX_BGR_REG — IRTX Bus Gating Reset Register
0x1024 LRADC_BGR_REG — LRADC Bus Gating Reset Register
{0x1200+0x10*i} I2SPCM{i}_CLK_REG (i=0..4) — I2SPCM{i} Clock Register
{0x120C+0x10*i} I2SPCM{i}_BGR_REG (i=0..4) — I2SPCM{i} Bus Gating Reset Register
0x1224 I2SPCM2_ASRC_CLK_REG — I2SPCM2_ASRC Clock Register
0x1280 OWA_TX_CLK_REG — OWA TX Clock Register
0x1284 OWA_RX_CLK_REG — OWA RX Clock Register
0x128C OWA_BGR_REG — OWA Bus Gating Reset Register
0x12C0 DMIC_CLK_REG — DMIC Clock Register
0x12CC DMIC_BGR_REG — DMIC Bus Gating Reset Register
0x1300 USB0_CLK_REG — USB0 Clock Register
0x1304 USB0_BGR_REG — USB0 Bus Gating Reset Register
0x1308 USB1_CLK_REG — USB1 Clock Register
0x130C USB1_BGR_REG — USB1 Bus Gating Reset Register
0x1340 USB0_USB1_REF_CLK_REG — USB0_USB1_REF Clock Register
0x1348 USB2_U2_REF_CLK_REG — USB2_U2_REF Clock Register
0x1350 USB2_SUSPEND_CLK_REG — USB2_SUSPEND Clock Register
0x1354 USB2_MF_CLK_REG — USB2_MF Clock Register
0x135C USB2_BGR_REG — USB2 Bus Gating Reset Register
0x1360 USB2_U3_UTMI_CLK_REG — USB2_U3_UTMI Clock Register
0x1364 USB2_U2_PIPE_CLK_REG — USB2_U2_PIPE Clock Register
0x1380 PCIE0_AUX_CLK_REG — PCIE0_AUX Clock Register
0x1384 PCIE0_AXI_SLV_CLK_REG — PCIE0_AXI_SLV Clock Register
0x138C PCIE0_BGR_REG — PCIE0 Bus Gating Reset Register
0x13C0 SERDES_PHY_CFG_CLK_REG — SERDES_PHY_CFG Clock Register
0x13C4 SERDES_BGR_REG — SERDES Bus Gating Reset Register
0x1400 GMAC_PTP_CLK_REG — GMAC_PTP Clock Register
0x1410 GMAC0_PHY_CLK_REG — GMAC0_PHY Clock Register
0x141C GMAC0_BGR_REG — GMAC0 Bus Gating Reset Register
0x1500 VO0_TCONLCD0_CLK_REG — VO0_TCONLCD0 Clock Register
0x1504 VO0_TCONLCD0_BGR_REG — VO0_TCONLCD0 Bus Gating Reset Register
0x1508 VO0_TCONLCD1_CLK_REG — VO0_TCONLCD1 Clock Register
0x150C VO0_TCONLCD1_BGR_REG — VO0_TCONLCD1 Bus Gating Reset Register
0x1544 LVDS0_BGR_REG — LVDS0 Bus Gating Reset Register
0x154C LVDS1_BGR_REG — LVDS1 Bus Gating Reset Register
0x1580 DSI0_CLK_REG — DSI0 Clock Register
0x1584 DSI0_BGR_REG — DSI0 Bus Gating Reset Register
0x1588 DSI1_CLK_REG — DSI1 Clock Register
0x158C DSI1_BGR_REG — DSI1 Bus Gating Reset Register
0x15C0 COMBPHY0_CLK_REG — COMBPHY0 Clock Register
0x15C4 COMBPHY1_CLK_REG — COMBPHY1 Clock Register
0x1604 TCONTV0_BGR_REG — TCONTV0 Bus Gating Reset Register
0x160C TCONTV1_BGR_REG — TCONTV1 Bus Gating Reset Register
0x1640 EDP_TV_CLK_REG — EDP_TV Clock Register
0x164C EDP_BGR_REG — EDP Bus Gating Reset Register
0x1680 HDMI_CEC_CLK_REG — HDMI CEC Clock Register
0x1684 HDMI_TV_CLK_REG — HDMI_TV Clock Register
0x168C HDMI_BGR_REG — HDMI Bus Gating Reset Register
0x1690 HDMI_SFR_CLK_REG — HDMI SFR Clock Register
0x1694 HDCP_ESM_CLK_REG — HDCP ESM Clock Register
0x16C4 DPSS_TOP0_BGR_REG — DPSS_TOP0 Bus Gating Reset Register
0x16CC DPSS_TOP1_BGR_REG — DPSS_TOP1 Bus Gating Reset Register
0x16E4 VIDEO_OUT0_BGR_REG — VIDEO_OUT0 Bus Gating Reset Register
0x16EC VIDEO_OUT1_BGR_REG — VIDEO_OUT1 Bus Gating Reset Register
0x1700 LEDC_CLK_REG — LEDC Clock Register
0x1704 LEDC_BGR_REG — LEDC Bus Gating Reset Register
0x1744 DSC_BGR_REG — DSC Bus Gating Reset Register
{0x1800+4i} CSI_MASTER{i}_CLK_REG (i=0..2) — CSI Master{i} Clock Register
0x1840 CSI_CLK_REG — CSI Clock Register
0x1844 CSI_BGR_REG — CSI Bus Gating Reset Register
0x1860 ISP_CLK_REG — ISP Clock Register
0x1884 VIDEO_IN_BGR_REG — VIDEO_IN Bus Gating Reset Register
0x1904 DDRPLL_GATE_EN_REG — DDRPLL Gate Enable Register
0x1908 PERI0PLL_GATE_EN_REG — PERI0PLL Gate Enable Register
0x190C PERI1PLL_GATE_EN_REG — PERI1PLL Gate Enable Register
0x1910 VIDEOPLL_GATE_EN_REG — VIDEOPLL Gate Enable Register
0x1914 GPUPLL_GATE_EN_REG — GPUPLL Gate Enable Register
0x1918 VEPLL_GATE_EN_REG — VEPLL Gate Enable Register
0x191C AUDIOPLL_GATE_EN_REG — AUDIOPLL Gate Enable Register
0x1920 NPUPLL_GATE_EN_REG — NPUPLL Gate Enable Register
0x1928 DEPLL_GATE_EN_REG — DEPLL Gate Enable Register
0x1984 DDRPLL_GATE_STAT_REG — DDRPLL Gate Status Register
0x1988 PERI0PLL_GATE_STAT_REG — PERI0PLL Gate Status Register
0x198C PERI1PLL_GATE_STAT_REG — PERI1PLL Gate Status Register
0x1990 VIDEOPLL_GATE_STAT_REG — VIDEOPLL Gate Status Register
0x1994 GPUPLL_GATE_STAT_REG — GPUPLL Gate Status Register
0x1998 VEPLL_GATE_STAT_REG — VEPLL Gate Status Register
0x199C AUDIOPLL_GATE_STAT_REG — AUDIOPLL Gate Status Register
0x19A0 NPUPLL_GATE_STAT_REG — NPUPLL Gate Status Register
0x19A8 DEPLL_GATE_STAT_REG — DEPLL Gate Status Register
0x1A00 CLK24M_GATE_EN_REG — CLK24M Gate Enable Register
0x1B00 CM_VI_CFG_REG — CM VI Enable Configuration Register
0x1B04 CM_DESYS_CFG_REG — CM DESYS Enable Configuration Register
0x1B10 CM_VE_DEC_CFG_REG — CM VE_DEC Enable Configuration Register
0x1B14 CM_VE_ENC_CFG_REG — CM VE_ENC Enable Configuration Register
0x1B1C CM_NPU_CFG_REG — CM NPU Enable Configuration Register
0x1B28 CM_PCIE0_CFG_REG — CM PCIE0 Enable Configuration Register
0x1B30 CM_USB2_CFG_REG — CM USB2 Enable Configuration Register
0x1B34 CM_VO_CFG_REG — CM VO Enable Configuration Register
0x1B38 CM_VO1_CFG_REG — CM VO1 Enable Configuration Register
0x1C00 APB2JTAG_CLK_REG — APB2JTAG Clock Register
0x1C04 APB2JTAG_BGR_REG — APB2JTAG Bus Gating Reset Register
0x1F00 CCMU_SEC_SWITCH_REG — CCMU Security Switch Register
0x1F10 SYSDAP_REQ_CTRL_REG — SYSDAP REQ Control Register
{0x1F20+4i} PLL_CFG{i}_REG (i=0..2) — PLL Configuration{i} Register
0x1F30 CCMU_FAN_GATE_REG — CCMU FANOUT CLOCK GATE Register
0x1F34 CLK27M_FAN_REG — CLK27M FANOUT Register
0x1F38 CLK_FAN_REG — PCLK FANOUT Register
0x1F3C CCMU_FAN_REG — CCMU FANOUT Register

## Notices in the file
Copyright (c) 2024 by Genadi V. Zawidowski. All rights reserved.
