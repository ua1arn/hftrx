# aw_a133 register map
File version: 1.00
Registers are 32-bit, read-write, reset 0x0 unless marked. A register's access mark holds for its fields unless they carry their own. Offsets are from the block's base; [hi:lo] are bit positions; lines under a group give offsets from that group; {n}, {i} and the like mark numbered series.

## C0_CPUX_CFG — A133 Cluster 0 Configuration Register List
Base 0x09010000
0x00 C0_RST_CTRL — Cluster 0 Reset Control Register
{0x10+4i} C0_CTRL_REG{i} (i=0..2) — Cluster 0 Control Register{i}
0x24 CACHE_CFG_REG — Cache Configuration Register
{0x60+0x10*i} C0_CPUx_CTRL_REG[{i}] (i=0..3) — Cluster 0 CPU0..CPU03 Control Register
0x80 C0_CPU_STATUS — Cluster 0 CPU Status Register
0x84 L2_STATUS_REG — Cluster 0 L2 Status Register

## CPU_SUBSYS_CTRL — A133 CPU Subsystem Control Register List
Base 0x08100000
0x00 GENER_CTRL_REG0 — General Control Register0 (bits 7:4 - SUNXI_AA64nAA32_OFFSET for cores)
0x0C GIC_JTAG_RST_CTRL — GIC and Jtag Reset Control Register
0x10 C0_INT_EN — Cluster0 Interrupt Enable Control Register
0x14 IRQ_FIQ_STATUS
0x18 GENER_CTRL_REG2 — General Control Register2
0x1C DBG_STATE — Debug State Register
{0x20+0x10*i} CPUx_CTRL_REG[{i}] (i=0..3) — CPU0..CPU3 Control Register
{0x40+0x20*i} unnamed[{i}] (i=0..3) group
  0x00 LOW — Reset Vector Base Address Registerx_L
  0x04 HIGH — Reset Vector Base Address Registerx_H

## DMAC
Base 0x03002000
0x00 DMAC_IRQ_EN_REG0 — DMAC IRQ Enable Register 0
0x04 DMAC_IRQ_EN_REG1 — DMAC IRQ Enable Register 1
0x10 DMAC_IRQ_PEND_REG0 — DMAC IRQ Pending Register 0
0x14 DMAC_IRQ_PEND_REG1 — DMAC IRQ Pending Register 1
0x20 DMAC_SEC_REG — DMA Security Register
0x28 DMAC_AUTO_GATE_REG — DMAC Auto Gating Register
0x30 DMAC_STA_REG — DMAC Status Register
{0x100+0x400*i} unnamed[{i}] (i=0..15) group
  0x00 DMAC_EN_REGN — DMAC Channel Enable Register N (N = 0 to 15) 0x0100 + N*0x0040
  0x04 DMAC_PAU_REGN — DMAC Channel Pause Register N (N = 0 to 15) 0x0104 + N*0x0040
  0x08 DMAC_DESC_ADDR_REGN — DMAC Channel Start Address Register N (N = 0 to 15) 0x0108 + N*0x0040
  0x0C DMAC_CFG_REGN — DMAC Channel Configuration Register N (N = 0 to 15) 0x010C + N*0x0040
  0x10 DMAC_CUR_SRC_REGN — DMAC Channel Current Source Register N (N = 0 to 15) 0x0110 + N*0x0040
  0x14 DMAC_CUR_DEST_REGN — DMAC Channel Current Destination Register N (N = 0 to 15) 0x0114 + N*0x0040
  0x18 DMAC_BCNT_LEFT_REGN — DMAC Channel Byte Counter Left Register N (N = 0 to 15) 0x0118 + N*0x0040
  0x1C DMAC_PARA_REGN — DMAC Channel Parameter Register N (N = 0 to 15) 0x011C + N*0x0040
  0x28 DMAC_MODE_REGN — DMAC Mode Register N (N = 0 to 15) 0x0128 + N*0x0040
  0x2C DMAC_FDESC_ADDR_REGN — DMAC Former Descriptor Address Register N (N = 0 to 15) 0x012C + N*0x0040
  0x30 DMAC_PKG_NUM_REGN — DMAC Package Number Register N (N = 0 to 15) 0x0130 + N*0x0040

## DSI0 — MIPI DSI System (A133/R818)
Base 0x06504000
0x00 DSI_CTL_REG — DSI Control Register
0x04 DSI_GINT0_REG — DSI Global Interrupt Register0
0x08 DSI_GINT1_REG — DSI Global Interrupt Register1
0x0C DSI_BASIC_CTL_REG — DSI Basic Control Register
0x10 DSI_BASIC_CTL0_REG — DSI Basic Control Register0
0x14 DSI_BASIC_CTL1_REG — DSI Basic Control Register1
0x18 DSI_BASIC_SIZE0_REG — DSI Basic Timing Register0
0x1C DSI_BASIC_SIZE1_REG — DSI Basic Timing Register1
{0x20+0x20*i} DSI_BASIC_INST0_REG[{i}] (i=0..7) — DSI Basic Instruction Register0 (N=0,1,2,3,4,5,6,7)
{0x3C+4i} DSI_BASIC_INST{i}_REG (i=1..6) — DSI Basic Instruction Register{i}
0x60 DSI_BASIC_TRAN0_REG — DSI Basic Transmission Register0
0x78 DSI_BASIC_TRAN4_REG — DSI Basic Transmission Register4
0x7C DSI_BASIC_TRAN5_REG — DSI Basic Transmission Register5
0x80 DSI_PIXEL_CTL0_REG — DSI Pixel Control Register0
0x90 DSI_PIXEL_PH_REG — DSI Pixel Packet Header Register
0x94 DSI_PIXEL_PD_REG — DSI Pixel Packet Data Register
0x98 DSI_PIXEL_PF0_REG — DSI Pixel Packet Footer Register0
0x9C DSI_PIXEL_PF1_REG — DSI Pixel Packet Footer Register1
0xB0 DSI_SYNC_HSS_REG — DSI H Sync Start Register
0xB4 DSI_SYNC_HSE_REG — DSI H Sync End Register
0xB8 DSI_SYNC_VSS_REG — DSI V Sync Start Register
0xBC DSI_SYNC_VSE_REG — DSI V Sync End Register
0xC0 DSI_BLK_HSA0_REG — DSI Blanking H Sync Active Register0
0xC4 DSI_BLK_HSA1_REG — DSI Blanking H Sync Active Register1
0xC8 DSI_BLK_HBP0_REG — DSI Blanking H Back Porch Register0
0xCC DSI_BLK_HBP1_REG — DSI Blanking H Back Porch Register0
0xD0 DSI_BLK_HFP0_REG — DSI Blanking H Front Porch Register0
0xD4 DSI_BLK_HFP1_REG — DSI Blanking H Front Porch Register1
0xE0 DSI_BLK_HBLK0_REG — DSI H Blanking Register0
0xE4 DSI_BLK_HBLK1_REG — DSI H Blanking Register1
0xE8 DSI_BLK_VBLK0_REG — DSI V Blanking Register0
0xEC DSI_BLK_VBLK1_REG — DSI V Blanking Register1
0xF0 DSI_BURST_LINE_REG — DSI Burst Line Register
0xF4 DSI_BURST_DRQ_REG — DSI Burst DRQ Register
0xFC DSI_DEBUG_REG — DSI Debug Register
{0x120+0x1C*i} DSI_BASIC_INST10_REG[{i}] (i=0..6) — DSI Basic INST10 Register (N=0,1,2,3,4,5,6)
0x140 DSI_BASIC_INST11_REG — DSI Basic INST11 Register
0x148 DSI_BASIC_INST13_REG — DSI Basic INST13 Register
0x1F0 DSI_SAFE_PERIOD_REG
0x200 DSI_CMD_CTL_REG
{0x240+0x20*i} DSI_CMD_RX_REG[{i}] (i=0..7) — DSI Command RX Register (N=0,1,2,3,4,5,6,7)
0x2E0 DSI_DEBUG0_REG — DSI Debug Register0
0x2E4 DSI_DEBUG1_REG — DSI Debug Register1
0x2EC DSI_INST_DEBUG_REG — DSI INST Debug Register
0x2F0 DSI_DEBUG2_REG — DSI Debug Register2
0x2F4 DSI_DEBUG3_REG — DSI Debug Register3
0x2F8 DSI_DEBUG4_REG
{0x300+0x100*i} DSI_CMD_TX_REG[{i}] (i=0..63) — DSI Command TX Register (N=0,1,2,�,63)
0xFF8 DSI_FIFO_BIST_REG — DSI FIFO Bist Register
0x1000 DPHY_CTL_REG — DPHY Control Register
0x1004 DPHY_TX_CTL_REG — DPHY TX Control Register
{0x1010+4i} DPHY_TX_TIME{i}_REG (i=0..4) — DPHY TX Timing Parameter {i} Register
0x1030 DPHY_RX_TIME0_REG — DPHY RX Timing Parameter 0 Register
0x1034 DPHY_RX_TIME1_REG — DPHY RX Timing Parameter 1 Register
0x1040 DPHY_RX_TIME3_REG — DPHY RX Timing Parameter 3 Register
{0x104C+4i} DPHY_ANA{i}_REG (i=0..4) — DPHY Analog {i} Register
{0x1060+4i} DPHY_INT_EN{i}_REG (i=0..2) — DPHY Interrupt Enable {i} Register
0x1070 DPHY_INT_PD0_REG — DPHY Interrupt Pending 0 Register
0x1074 DPHY_INT_PD1_REG — DPHY Interrupt Pending 1 Register
{0x10E0+4i} DPHY_DBG{i}_REG (i=0..4) — DPHY Debug {i} Register
{0x10F8+4i} DPHY_TX_SKEW_REG{i} (i=0..2) — DPHY TX Skew Register{i}
0x1104 DPHY_PLL_REG0 — DPHY PLL Register0
0x1108 DPHY_PLL_REG1 — DPHY PLL Register1
0x1110 COMBO_PHY_REG0 — Combo PHY Register0
0x1114 COMBO_PHY_REG1 — Combo PHY Register1
