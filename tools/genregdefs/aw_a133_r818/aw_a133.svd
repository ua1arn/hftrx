# aw_a133 register map
File version: 1.00
Registers are 32-bit, read-write, reset 0x0 unless marked. A register's access mark holds for its fields unless they carry their own. Offsets are from the block's base; [hi:lo] are bit positions; lines under a group give offsets from that group; {n}, {i} and the like mark numbered series.

## GICVSELF
Base 0x03024000
Same registers: GICV 0x03025000
0x00 GICH_HCR — RW 0x00000000 Hypervisor Control Register
0x04 GICH_VTR — RO 0x90000003 VGIC Type Register, GICH_VTR on page 3-13
0x08 GICH_VMCR — RW 0x004C0000 Virtual Machine Control Register
0x10 GICH_MISR — RO 0x00000000 Maintenance Interrupt Status Register
0x20 GICH_EISR0 — RO 0x00000000 End of Interrupt Status Register
0x30 GICH_ELSR0 — RO 0x0000000F Empty List register Status Register
0xF0 GICH_APR0 — RW 0x00000000 Active Priority Register
{0x100+4i} GICH_LR{i} (i=0..3) — RW 0x00000000 List Register {i}

## GPIOA — Port Controller
Base 0x0300B000
Same registers: GPIOB 0x0300B024, GPIOC 0x0300B048, GPIOD 0x0300B06C, GPIOE 0x0300B090, GPIOF 0x0300B0B4, GPIOG 0x0300B0D8, GPIOH 0x0300B0FC, GPIOI 0x0300B120, R_PIO 0x07022000, GPIOL 0x07022000
{0x0+0x10*i} CFG[{i}] (i=0..3) — Configure Register
0x10 DATA
{0x14+8i} DRV[{i}] (i=0..1) — Multi_Driving Register
{0x1C+8i} PULL[{i}] (i=0..1)

## GPIOBLOCK — Port Controller
Base 0x0300B000
{0x0+0x144*i} unnamed[{i}] (i=0..8) group
  {0x0+0x10*j} CFG[{j}] (j=0..3) — Configure Register
  0x10 DATA
  {0x14+8j} DRV[{j}] (j=0..1) — Multi_Driving Register
  {0x1C+8j} PULL[{j}] (j=0..1)
{0x200+0x120*i} unnamed[{i}] (i=0..8) group
  {0x0+0x10*j} EINT_CFG[{j}] (j=0..3) — External Interrupt Configure Registers
  0x10 EINT_CTL — External Interrupt Control Register
  0x14 EINT_STATUS — External Interrupt Status Register
  0x18 EINT_DEB — External Interrupt Debounce Register
0x340 PIO_POW_MOD_SEL — PIO Group Withstand Voltage Mode Select Register
0x344 PIO_POW_MS_CTL — PIO Group Withstand Voltage Mode Select Control Register
0x348 PIO_POW_VAL — PIO Group Power Value Register

## GPIOINTA
Base 0x0300B200
Same registers: GPIOINTB 0x0300B220, GPIOINTC 0x0300B240, GPIOINTD 0x0300B260, GPIOINTE 0x0300B280, GPIOINTF 0x0300B2A0, GPIOINTG 0x0300B2C0, GPIOINTH 0x0300B2E0, GPIOINTI 0x0300B300
{0x0+0x10*i} EINT_CFG[{i}] (i=0..3) — External Interrupt Configure Registers
0x10 EINT_CTL — External Interrupt Control Register
0x14 EINT_STATUS — External Interrupt Status Register
0x18 EINT_DEB — External Interrupt Debounce Register

## I2S0
Base 0x05090000
Same registers: I2S1 0x05091000, I2S2 0x05092000, I2S3 0x05093000
0x00 I2S_PCM_CTL — I2S/PCM Control Register
0x04 I2S_PCM_FMT0 — I2S/PCM Format Register 0
0x08 I2S_PCM_FMT1 — I2S/PCM Format Register 1
0x0C I2S_PCM_ISTA — I2S/PCM Interrupt Status Register
0x10 I2S_PCM_RXFIFO
0x14 I2S_PCM_FCTL — I2S/PCM FIFO Control Register
0x18 I2S_PCM_FSTA — I2S/PCM FIFO Status Register
0x1C I2S_PCM_INT — I2S/PCM DMA & Interrupt Control Register
0x20 I2S_PCM_TXFIFO
0x24 I2S_PCM_CLKD — I2S/PCM Clock Divide Register
0x28 I2S_PCM_TXCNT — I2S/PCM TX Sample Counter Register
0x2C I2S_PCM_RXCNT — I2S/PCM RX Sample Counter Register
0x30 I2S_PCM_CHCFG — I2S/PCM Channel Configuration Register
{0x34+4i} I2S_PCM_TX{i}CHSEL (i=0..3) — I2S/PCM TX{i} Channel Select Register
{0x44+8i} I2S_PCM_TX{i}CHMAP0 (i=0..3) — I2S/PCM TX{i} Channel Mapping Register0
{0x48+8i} I2S_PCM_TX{i}CHMAP1 (i=0..3) — I2S/PCM TX{i} Channel Mapping Register1
0x64 I2S_PCM_RXCHSEL — I2S/PCM RX Channel Select Register
{0x68+0x10*i} I2S_PCM_RXCHMAP[{i}] (i=0..3) — I2S/PCM RX Channel Mapping Register0..3
0x80 MCLKCFG — ASRC MCLK Configuration Register
0x84 FsoutCFG — ASRC Out Sample Rate Configuration Register
0x88 FsinEXTCFG — ASRC Input Sample Pulse Extend Configuration Register
0x8C ASRCCFG — ASRC Enable Register
0x90 ASRCMANCFG — ASRC Manual Ratio Configuration Register
0x94 ASRCRATIOSTAT — ASRC Status Register
0x98 ASRCFIFOSTAT — ASRC FIFO Level Status Register
0x9C ASRCMBISTCFG — ASRC MBIST Test Configuration Register
0xA0 ASRCMBISTSTAT — ASRC MBIST Test Status Register
