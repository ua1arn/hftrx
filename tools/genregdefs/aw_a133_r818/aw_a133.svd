# aw_a133 register map
File version: 1.00
Registers are 32-bit, read-write, reset 0x0 unless marked. A register's access mark holds for its fields unless they carry their own. Offsets are from the block's base; [hi:lo] are bit positions; lines under a group give offsets from that group; {n}, {i} and the like mark numbered series.

## TWI0
Base 0x05002000
Same registers: TWI1 0x05002400, TWI2 0x05002800, TWI3 0x05002C00, S_TWI0 0x07081400, S_TWI1 0x07081800
0x00 TWI_ADDR — TWI Slave Address Register
0x04 TWI_XADDR — TWI Extended Slave Address Register
0x08 TWI_DATA — TWI Data Byte Register
0x0C TWI_CNTR — TWI Control Register
0x10 TWI_STAT — TWI Status Register
0x14 TWI_CCR — TWI Clock Control Register
0x18 TWI_SRST — TWI Software Reset Register
0x1C TWI_EFR — TWI Enhance Feature Register
0x20 TWI_LCR — TWI Line Control Register
0x200 TWI_DRV_CTRL — TWI_DRV Control Register
0x204 TWI_DRV_CFG — TWI_DRV Transmission Configuration Register
0x208 TWI_DRV_SLV — TWI_DRV Slave ID Register
0x20C TWI_DRV_FMT — TWI_DRV Packet Format Register
0x210 TWI_DRV_BUS_CTRL — TWI_DRV Bus Control Register
0x214 TWI_DRV_INT_CTRL — TWI_DRV Interrupt Control Register
0x218 TWI_DRV_DMA_CFG — TWI_DRV DMA Configure Register
0x21C TWI_DRV_FIFO_CON — TWI_DRV FIFO Content Register
0x300 TWI_DRV_SEND_FIFO_ACC — TWI_DRV Send Data FIFO Access Register
0x304 TWI_DRV_RECV_FIFO_ACC — TWI_DRV Receive Data FIFO Access Register

## UART0
Base 0x05000000
Same registers: UART1 0x05000400, UART2 0x05000800, UART3 0x05000C00, UART4 0x05001000, R_UART 0x07080000, R_UART 0x07080000
0x00 UART_RBR_THR_DLL — UART Receive Buffer Register/Transmit Holding Register
0x04 UART_DLH_IER
0x08 UART_IIR_FCR — UART Interrupt Identity Register/UART FIFO Control Register
0x0C UART_LCR — UART Line Control Register
0x10 UART_MCR — UART Modem Control Register
0x14 UART_LSR — UART Line Status Register
0x18 UART_MSR — UART Modem Status Register
0x1C UART_SCH — UART Scratch Register
0x7C UART_USR — UART Status Register
0x80 UART_TFL — UART Transmit FIFO Level Register
0x84 UART_RFL — UART Receive FIFO Level Register
0x88 UART_HSK — UART DMA Handshake Configuration Register
0xB0 UART_DBG_DLL — UART Debug DLL Register
0xB4 UART_DBG_DLH — UART Debug DLH Register
0xC0 UART_485_CTL — UART RS485 Control and Status Register
0xC4 RS485_ADDR_MATCH — UART RS485 Addres Match Register
0xC8 BUS_IDLE_CHECK — UART RS485 Bus Idle Check Register
0xCC TX_DLY — UART TX Delay Register

## USB20_OTG_DEVICE — USB OTG Dual-Role Device controller
Base 0x05100000
{0x0+0x40*i} USB_EPFIFO[{i}] (i=0..15) — USB_EPFIFO [0..5] USB FIFO Entry for Endpoint N
0x40 USB_GCS — USB_POWER, USB_DEVCTL, USB_EPINDEX, USB_DMACTL USB Global Control and Status Register
0x44 USB_EPINTF — USB_INTTX - lower 16, USB_INTRX - high 16, USB_EPINTF USB Endpoint Interrupt Flag Register
0x48 USB_EPINTE — USB_INTTXE - lower 16, USB_INTRXE - high 16, USB_EPINTE USB Endpoint Interrupt Enable Register
0x4C USB_INTUSB — USB_INTUSB USB_BUSINTF USB Bus Interrupt Flag Register
0x50 USB_INTUSBE — USB_INTUSBE USB_BUSINTE USB Bus Interrupt Enable Register
0x54 USB_FNUM — USB Frame Number Register
0x7C USB_TESTC — USB_TESTC USB Test Control Register
0x80 USB_TXMAXP 16-bit — USB_TXMAXP USB EP1~5 Tx Control and Status Register
0x82 USB_TXCSRHI 16-bit — [15:8]: USB_TXCSRH, [7:0]: USB_TXCSRL
0x84 USB_RXMAXP 16-bit — USB_RXMAXP USB EP1~5 Rx Control and Status Register
0x86 USB_RXCSRHI 16-bit — USB_RXCSR
0x88 USB_RXCOUNT — USB_RXCOUNT, USB_RXPKTCNT - high 16 bits
0x8C USB_EPATTR — USB_EPATTR USB EP0 Attribute Register, USB EP1~5 Attribute Register
0x90 USB_TXFIFO — USB_TXFIFO (bits 28:16 Start address of the endpoint FIFO is in units of 8 bytes)
0x94 USB_RXFIFO — USB_RXFIFO (bits 28:16 Start address of the endpoint FIFO is in units of 8 bytes)
{0x98+0x70*i} unnamed[{i}] (i=0..15) group
  0x00 USB_TXFADDR 16-bit
  0x02 USB_TXHADDR 8-bit
  0x03 USB_TXHUBPORT 8-bit
  0x04 USB_RXFADDR 8-bit
  0x06 USB_RXHADDR 8-bit
  0x07 USB_RXHUBPORT 8-bit
0x400 USB_ISCR — HCI Interface Register (HCI_Interface)
0x404 USBPHY_PHYCTL
0x408 HCI_CTRL3 — HCI Control 3 Register (bist)
0x410 PHY_CTRL — PHY Control Register (PHY_Control)
0x420 PHY_OTGCTL — Control PHY routing to EHCI or OTG
0x424 PHY_STATUS
0x428 USB_SPDCR — HCI SIE Port Disable Control Register
0x500 USB_DMA_INTE — USB DMA Interrupt Enable Register
0x504 USB_DMA_INTS — USB DMA Interrupt Status Register
{0x540+0x100*i} unnamed[{i}] (i=0..15) group
  0x00 CHAN_CFG — USB DMA Channel Configuration Register
  0x04 SDRAM_ADD — USB DMA SDRAM Start Address Register
  0x08 BC — USB DMA Byte Counter Register
  0x0C RESIDUAL_BC — USB DMA RESIDUAL Byte Counter Register

## USB20_OTG_PHYC — HCI Contgroller and PHY Interface Description
Base 0x05100400
Same registers: USBPHYC0 0x05101800, USBPHYC1 0x05200800
0x00 USB_CTRL — HCI Interface Register - REG_ISCR 0x00
0x08 HCI_CTRL3 — HCI Control 3 Register
0x10 PHY_CTRL — PHY Control Register
0x1C HSIC_PHY_tune1
0x20 HSIC_PHY_tune2 — HSIC PHY Tune2 Register - REG_PHY_OTGCTL 0x20
0x24 HSIC_PHY_tune3
0x28 USB_SPDCR — HCI SIE Port Disable Control Register

## USB20_HOST0_EHCI
Base 0x05101000
Same registers: USB20_HOST1_EHCI 0x05200000
0x00 HCCAPBASE — EHCI Capability Register (HCIVERSION and CAPLENGTH) register
0x04 HCSPARAMS — EHCI Host Control Structural Parameter Register
0x08 HCCPARAMS — EHCI Host Control Capability Parameter Register
0x0C HCSPPORTROUTE — EHCI Companion Port Route Description
0x10 USBCMD — EHCI USB Command Register
0x14 USBSTS — EHCI USB Status Register
0x18 USBINTR — EHCI USB Interrupt Enable Register
0x1C FRINDEX — EHCI USB Frame Index Register
0x20 CTRLDSSEGMENT — EHCI 4G Segment Selector Register
0x24 PERIODICLISTBASE — EHCI Frame List Base Address Register
0x28 ASYNCLISTADDR — EHCI Next Asynchronous List Address Register

## USB20_HOST0_OHCI
Base 0x05101400
Same registers: USB20_HOST1_OHCI 0x05200400
0x00 O_HcRevision — OHCI Revision Register (not documented)
0x04 O_HcControl — OHCI Control Register
0x08 O_HcCommandStatus — OHCI Command Status Register
0x0C O_HcInterruptStatus — OHCI Interrupt Status Register
0x10 O_HcInterruptEnable — OHCI Interrupt Enable Register
0x14 O_HcInterruptDisable — OHCI Interrupt Disable Register
0x18 O_HcHCCA — OHCI HCCA Base
0x1C O_HcPeriodCurrentED — OHCI Period Current ED Base
0x20 O_HcControlHeadED — OHCI Control Head ED Base
0x24 O_HcControlCurrentED — OHCI Control Current ED Base
0x28 O_HcBulkHeadED — OHCI Bulk Head ED Base
0x2C O_HcBulkCurrentED — OHCI Bulk Current ED Base
0x30 O_HcDoneHead — OHCI Done Head Base
0x34 O_HcFmInterval — OHCI Frame Interval Register
0x38 O_HcFmRemaining — OHCI Frame Remaining Register
0x3C O_HcFmNumber — OHCI Frame Number Register
0x40 O_HcPerioddicStart — OHCI Periodic Start Register
0x44 O_HcLSThreshold — OHCI LS Threshold Register
0x48 O_HcRhDescriptorA — OHCI Root Hub Descriptor Register A
0x4C O_HcRhDesriptorB — OHCI Root Hub Descriptor Register B
0x50 O_HcRhStatus — OHCI Root Hub Status Register
{0x54+4i} O_HcRhPortStatus[{i}] (i=0..0) — OHCI Root Hub Port Status Register
