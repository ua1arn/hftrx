# aw_a133 register map
File version: 1.00
Registers are 32-bit, read-write, reset 0x0 unless marked. A register's access mark holds for its fields unless they carry their own. Offsets are from the block's base; [hi:lo] are bit positions; lines under a group give offsets from that group; {n}, {i} and the like mark numbered series.

## PRCM — Power Reset Clock Management module
Base 0x07010000
0x00 CPUS_CFG_REG — CPUS Configuration Register
0x0C APBS1_CFG_REG — APBS1 Configuration Register
0x12C R_TWD_BGR_REG — R_TWD Bus Gating Reset Register
0x19C R_TWI_BGR_REG — R_TWI Bus Gating Reset Register
0x1AC R_CAN_BGR_REG — R_CAN Bus Gating Reset Register
0x1BC R_RSB_BGR_REG — R_RSB Bus Gating Reset Register
0x1C0 R_IR_RX_CLK_REG — R_IR_RX Clock Register
0x1CC R_IR_RX_BGR_REG — R_IR_RX Bus Gating Reset Register
0x20C RTC_BGR_REG — RTC Bus Gating Reset Register
0x240 PLL_CTRL_REG0 — PLL Control Register 0
0x244 PLL_CTRL_REG1 — PLL Control Register 1
0x250 VDD_SYS_PWROFF_GATING_REG — VDD_SYS Power Off Gating Register
0x254 GPU_PWROFF_GATING — GPU Power Off Gating Register
0x258 VE_PWROFF_GATING — VE Power Off Gating Register
0x270 RAM_CFG_REG — RAM Configuration Register
0x274 RAM_TEST_CTRL_REG — RAM Test Control Register
0x290 PRCM_SEC_SWITCH_REG — PRCM Security Switch Register
0x310 RES_CAL_CTRL_REG — Resistor Calibration Control Register
0x314 RES200_CTRL_REG — 200ohms Resistor Manual Control Register
0x318 RES240_CTRL_REG — 240ohms Resistor Manual Control Register
0x31C RES_CAL_STATUS_REG — Resistor Calibration Status Register
0x320 NMI_IRQ_CTRL_REG — NMI Interrupt Control Register
0x324 NMI_IRQ_ENABLE_REG — NMI Interrupt Enable Register
0x328 NMI_IRQ_PEND_REG — NMI Interrupt Pending Register
0x3F0 PRCM_VERSION_REG — PRCM Version Register

## R_CPUCFG
Base 0x07000400
{0x1C4+0x10*i} SOFTENTRY[{i}] (i=0..3) — The Soft Entry Address Register of CPUx (x=0..1)

## SPI0 — Serial Peripheral Interface
Base 0x05010000
Same registers: SPI1 0x05011000, SPI2 0x05012000
0x04 SPI_GCR — SPI Global Control Register
0x08 SPI_TCR — SPI Transfer Control Register
0x10 SPI_IER — SPI Interrupt Control Register
0x14 SPI_ISR — SPI Interrupt Status Register
0x18 SPI_FCR — SPI FIFO Control Register
0x1C SPI_FSR — SPI FIFO Status Register
0x20 SPI_WCR — SPI Wait Clock Register
0x24 SPI_CCR — SPI Clock Control Register
0x28 SPI_SAMP_DL — SPI Sample Delay Control Register
0x30 SPI_MBC — SPI Master Burst Counter Register
0x34 SPI_MTC — SPI Master Transmit Counter Register
0x38 SPI_BCC — SPI Master Burst Control Register
0x40 SPI_BATCR — SPI Bit-Aligned Transfer Configure Register
0x44 SPI_3W_CCR — SPI Bit-Aligned Clock Configuration Register
0x48 SPI_TBR — SPI TX Bit Register
0x4C SPI_RBR — SPI RX Bit Register
0x88 SPI_NDMA_MODE_CTL — SPI Normal DMA Mode Control Register
0x200 SPI_TXD — SPI TX Data Register
0x300 SPI_RXD — SPI RX Data Register

## TIMER
Base 0x03009000
Same registers: R_WDG 0x07020400, R_TWDG 0x07020800, R_TIMER 0x07029000
0x00 TMR_IRQ_EN_REG — Timer IRQ Enable Register
0x04 TMR_IRQ_STA_REG — Timer Status Register
{0x10+0x20*i} unnamed[{i}] (i=0..1) group
  0x00 CTRL_REG — Timer n Control Register
  0x04 INTV_VALUE_REG — Timer n Interval Value Register
  0x08 CUR_VALUE_REG — Timer n Current Value Register
0xA0 WDOG_IRQ_EN_REG — Watchdog IRQ Enable Register
0xA4 WDOG_IRQ_STA_REG — Watchdog Status Register
0xB0 WDOG_CTRL_REG — Watchdog Control Register
0xB4 WDOG_CFG_REG — Watchdog Configuration Register
0xB8 WDOG_MODE_REG — Watchdog Mode Register
0xC0 AVS_CNT_CTL_REG — AVS Control Register
0xC4 AVS_CNT0_REG — AVS Counter 0 Register
0xC8 AVS_CNT1_REG — AVS Counter 1 Register
0xCC AVS_CNT_DIV_REG — AVS Divisor Register

## TIMESTAMP_CTRL
Base 0x08120000
0x00 TSTAMP_CTRL_REG — Timestamp Control Register
0x08 CNT_CTRL_LOW_REG — Counter Low Register
0x0C CNT_CTRL_HI_REG — Counter High Register
0x20 CNT_FREQID_REG — Counter Base Frequency ID Register

## TIMESTAMP_STA
Base 0x08110000
0x00 CNT_LOW_REG — Counter Low Register
0x04 CNT_HI_REG — Counter High Register
