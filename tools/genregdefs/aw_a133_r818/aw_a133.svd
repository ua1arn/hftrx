# aw_a133 register map
File version: 1.00
Registers are 32-bit, read-write, reset 0x0 unless marked. A register's access mark holds for its fields unless they carry their own. Offsets are from the block's base; [hi:lo] are bit positions; {n}, {i} and the like mark numbered series.

## CCU
Base 0x03001000
0x00 PLL_CPUX_CTRL_REG — PLL_CPUX Control Register
0x10 PLL_DDR_CTRL_REG — PLL_DDR Control Register
0x20 PLL_PERI0_CTRL_REG — PLL_PERI0 Control Register
0x28 PLL_PERI1_CTRL_REG — PLL_PERI1 Control Register
0x30 PLL_GPU_CTRL_REG — PLL_GPU Control Register
{0x40+8i} PLL_VIDEO{i}_CTRL_REG (i=0..2) — PLL_VIDEO{i} Control Register
0x58 PLL_VE_CTRL_REG — PLL_VE Control Register
0x60 PLL_COM_CTRL_REG — PLL_COM Control Register
0x68 PLL_VIDEO3_CTRL_REG — PLL_VIDEO3 Control Register
0x78 PLL_AUDIO_CTRL_REG — PLL_AUDIO Control Register
0x110 PLL_DDR_PAT0_CTRL_REG — PLL_DDR Pattern0 Control Register
0x114 PLL_DDR_PAT1_CTRL_REG — PLL_DDR Pattern1 Control Register
0x120 PLL_PERI0_PAT0_CTRL_REG — PLL_PERI0 Pattern0 Control Register
0x124 PLL_PERI0_PAT1_CTRL_REG — PLL_PERI0 Pattern1 Control Register
0x128 PLL_PERI1_PAT0_CTRL_REG — PLL_PERI1 Pattern0 Control Register
0x12C PLL_PERI1_PAT1_CTRL_REG — PLL_PERI1 Pattern1 Control Register
0x130 PLL_GPU0_PAT0_CTRL_REG — PLL_GPU0 Pattern0 Control Register
0x134 PLL_GPU0_PAT1_CTRL_REG — PLL_GPU0 Pattern1 Control Register
{0x140+8i} PLL_VIDEO{i}_PAT0_CTRL_REG (i=0..2) — PLL_VIDEO{i} Pattern0 Control Register
{0x144+8i} PLL_VIDEO{i}_PAT1_CTRL_REG (i=0..2) — PLL_VIDEO{i} Pattern1 Control Register
0x158 PLL_VE_PAT0_CTRL_REG — PLL_VE Pattern0 Control Register
0x15C PLL_VE_PAT1_CTRL_REG — PLL_VE Pattern1 Control Register
0x160 PLL_COM_PAT0_CTRL_REG — PLL_COM Pattern0 Control Register
0x164 PLL_COM_PAT1_CTRL_REG — PLL_COM Pattern1 Control Register
0x168 PLL_VIDEO3_PAT0_CTRL_REG — PLL_VIDEO3 Pattern0 Control Register
0x16C PLL_VIDEO3_PAT1_CTRL_REG — PLL_VIDEO3 Pattern1 Control Register
0x178 PLL_AUDIO_PAT0_CTRL_REG — PLL_AUDIO Pattern0 Control Register
0x17C PLL_AUDIO_PAT1_CTRL_REG — PLL_AUDIO Pattern1 Control Register
0x300 PLL_CPUX_BIAS_REG — PLL_CPUX Bias Register
0x310 PLL_DDR_BIAS_REG — PLL_DDR Bias Register
0x320 PLL_PERI0_BIAS_REG — PLL_PERI0 Bias Register
0x328 PLL_PERI1_BIAS_REG — PLL_PERI1 Bias Register
0x330 PLL_GPU0_BIAS_REG — PLL_GPU0 Bias Register
{0x340+8i} PLL_VIDEO{i}_BIAS_REG (i=0..2) — PLL_VIDEO{i} Bias Register
0x358 PLL_VE_BIAS_REG — PLL_VE Bias Register
0x360 PLL_COM_BIAS_REG — PLL_COM Bias Register
0x368 PLL_VIDEO3_BIAS_REG — PLL_VIDEO3 Bias Register
0x378 PLL_AUDIO_BIAS_REG — PLL_AUDIO Bias Register
0x400 PLL_CPUX_TUN_REG — PLL_CPUX Tuning Register
0x500 C0_CPUX_AXI_CFG_REG — CPUX_AXI Configuration Register
0x510 PSI_AHB1_AHB2_CFG_REG — PSI_AHB1_AHB2 Configuration Register
0x51C AHB3_CFG_REG — AHB3 Configuration Register
0x520 APB1_CFG_REG — APB1 Configuration Register
0x524 APB2_CFG_REG — APB2 Configuration Register
0x540 MBUS_CFG_REG — MBUS Configuration Register
0x600 DE_CLK_REG — DE Clock Register
0x60C DE_BGR_REG — DE Bus Gating Reset Register
0x630 G2D_CLK_REG — G2D Clock Register
0x63C G2D_BGR_REG — G2D Bus Gating Reset Register
0x670 GPU_CORE_CLK_REG — GPU Clock Register
0x67C GPU_BGR_REG — GPU Bus Gating Reset Register
0x680 CE_CLK_REG — CE Clock Register
0x68C CE_BGR_REG — CE Bus Gating Reset Register
0x690 VE_CLK_REG — VE Clock Register
0x69C VE_BGR_REG — VE Bus Gating Reset Register
0x70C DMA_BGR_REG — DMA Bus Gating Reset Register
0x71C MSGBOX_BGR_REG — MSGBOX Bus Gating Reset Register
0x72C SPINLOCK_BGR_REG — SPINLOCK Bus Gating Reset Register
0x73C HSTIMER_BGR_REG — HSTIMER Bus Gating Reset Register
0x740 AVS_CLK_REG — AVS Clock Register
0x78C DBGSYS_BGR_REG — DBGSYS Bus Gating Reset Register
0x79C PSI_BGR_REG — PSI Bus Gating Reset Register
0x7AC PWM_BGR_REG — PWM Bus Gating Reset Register
0x7BC IOMMU_BGR_REG — IOMMU Bus Gating Reset Register
0x800 DRAM_CLK_REG — DRAM Clock Register
0x804 MBUS_MAT_CLK_GATING_REG — MBUS Master Clock Gating Register
0x80C DRAM_BGR_REG — DRAM Bus Gating Reset Register
0x810 NAND0_0_CLK_REG — NAND0_0 Clock Register
0x814 NAND0_1_CLK_REG — NAND0_1 Clock Register
0x82C NAND_BGR_REG — NAND Bus Gating Reset Register
{0x830+4i} SMHC{i}_CLK_REG (i=0..2) — SMHC{i} Clock Register
0x84C SMHC_BGR_REG — SMHC Bus Gating Reset Register
0x90C UART_BGR_REG — UART Bus Gating Reset Register
0x91C TWI_BGR_REG — TWI Bus Gating Reset Register
{0x940+4i} SPI{i}_CLK_REG (i=0..2) — SPI{i} Clock Register
0x96C SPI_BGR_REG — SPI Bus Gating Reset Register
0x970 EMAC0_25M_CLK_REG — EMAC0_25M Clock Register
0x97C EMAC_BGR_REG — EMAC Bus Gating Reset Register
0x990 IRRX_CLK_REG — IRRX Clock Register
0x99C IRRX_BGR_REG — IRRX Bus Gating Reset Register
0x9C0 IRTX_CLK_REG — IRTX Clock Register
0x9CC IRTX_BGR_REG — IRTX Bus Gating Reset Register
0x9EC GPADC_BGR_REG — GPADC Bus Gating Reset Register
0x9FC THS_BGR_REG — THS Bus Gating Reset Register
{0xA10+4i} I2SPCM{i}_CLK_REG (i=0..3) — I2S/PCM{i} Clock Register
0xA20 I2SPCM_BGR_REG — I2S/PCM Bus Gating Reset Register
0xA24 OWA_CLK_REG — OWA Clock Register
0xA2C OWA_BGR_REG — OWA Bus Gating Reset Register
0xA40 DMIC_CLK_REG — DMIC Clock Register
0xA4C DMIC_BGR_REG — DMIC Bus Gating Reset Register
0xA50 AUDIO_CODEC_DAC_1X_CLK_REG — AUDIO CODEC DAC 1X Clock Register
0xA54 AUDIO_CODEC_ADC_1X_CLK_REG — AUDIO CODEC ADC 1X Clock Register
0xA58 AUDIO_CODEC_4X_CLK_REG — AUDIO CODEC 4X Clock Register
0xA5C AUDIO_CODEC_BGR_REG — AUDIO CODEC Bus Gating Reset Register
0xA70 USB0_CLK_REG — USB0 Clock Register
0xA74 USB1_CLK_REG — USB1 Clock Register
0xA8C USB_BGR_REG — USB Bus Gating Reset Register
0xA9C LRADC_BGR_REG — LRADC Bus Gating Reset Register
0xABC DPSS_TOP0_BGR_REG — DPSS_TOP0 Bus Gating Reset Register
0xACC DPSS_TOP1_BGR_REG — DPSS_TOP1 Bus Gating Reset Register
0xB24 MIPI_DSI_HOST0_CLK_REG — MIPI DSI Host0 Clock Register
0xB4C MIPI_BGR_REG — MIPI DSI Bus Gating Reset Register
0xB5C DISPLAY_IF_TOP_BGR_REG — DISPLAY_IF_TOP Bus Gating Reset Register
0xB60 TCON_LCD0_CLK_REG — TCON LCD0 Clock Register
0xB7C TCON_LCD_BGR_REG — TCON LCD Bus Gating Reset Register
0xBAC LVDS_BGR_REG — LVDS Bus Gating Reset Register
0xBF0 LEDC_CLK_REG — LEDC Clock Register
0xBFC LEDC_BGR_REG — LEDC Bus Gating Reset Register
0xC04 CSI0_TOP_CLK_REG — CSI0 TOP Clock Register
0xC08 CSI0_0_MST_CLK_REG — CSI0_0 Master Clock Register
0xC0C CSI0_1_MST_CLK_REG — CSI0_1 Master Clock Register
0xC1C CSI_BGR_REG — CSI Bus Gating Reset Register
0xC20 CSI_ISP_CLK_REG — CSI ISP Clock Register
0xC2C CSI_ISP_BGR_REG — CSI ISP Bus Gating Reset Register
0xF00 CCU_SEC_SWITCH_REG — CCU Security Switch Register
0xF04 PLL_LOCK_DBG_CTRL_REG — PLL Lock Debug Control Register
0xF20 PLL_CPUX_HW_FM_REG — PLL_CPUX Hardware FM Register
