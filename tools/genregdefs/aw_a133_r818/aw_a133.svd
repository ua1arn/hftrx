# aw_a133 register map
File version: 1.00
for test
Registers are 32-bit, read-write, reset 0x0 unless marked. A register's access mark holds for its fields unless they carry their own. Offsets are from the block's base; lines under a group give offsets from that group; [hi:lo] are bit positions; {n}, {i} and the like mark numbered series; 'fields as' and 'values as' point back to an identical list; <NAME> marks a mode.

## Memory map
0x03001000 CCU
0x03002000 DMAC
0x03009000 TIMER
0x0300B000 GPIOA — Port Controller
0x0300B000 GPIOBLOCK — Port Controller
0x0300B024 GPIOB
0x0300B048 GPIOC
0x0300B06C GPIOD
0x0300B090 GPIOE
0x0300B0B4 GPIOF
0x0300B0D8 GPIOG
0x0300B0FC GPIOH
0x0300B120 GPIOI
0x0300B200 GPIOINTA
0x0300B220 GPIOINTB
0x0300B240 GPIOINTC
0x0300B260 GPIOINTD
0x0300B280 GPIOINTE
0x0300B2A0 GPIOINTF
0x0300B2C0 GPIOINTG
0x0300B2E0 GPIOINTH
0x0300B300 GPIOINTI
0x03024000 GICVSELF
0x03025000 GICV
0x05000000 UART0
0x05000400 UART1
0x05000800 UART2
0x05000C00 UART3
0x05001000 UART4
0x05002000 TWI0
0x05002400 TWI1
0x05002800 TWI2
0x05002C00 TWI3
0x05010000 SPI0 — Serial Peripheral Interface
0x05011000 SPI1
0x05012000 SPI2
0x05090000 I2S0
0x05091000 I2S1
0x05092000 I2S2
0x05093000 I2S3
0x05100000 USB20_OTG_DEVICE — USB OTG Dual-Role Device controller
0x05100400 USB20_OTG_PHYC — HCI Contgroller and PHY Interface Description
0x05101000 USB20_HOST0_EHCI
0x05101400 USB20_HOST0_OHCI
0x05101800 USBPHYC0
0x05200000 USB20_HOST1_EHCI
0x05200400 USB20_HOST1_OHCI
0x05200800 USBPHYC1
0x06504000 DSI0 — MIPI DSI System (A133/R818)
0x07000400 R_CPUCFG
0x07010000 PRCM — Power Reset Clock Management module
0x07020400 R_WDG
0x07020800 R_TWDG
0x07022000 R_PIO
0x07022000 GPIOL
0x07029000 R_TIMER
0x07080000 R_UART
0x07080000 R_UART
0x07081400 S_TWI0
0x07081800 S_TWI1
0x08100000 CPU_SUBSYS_CTRL — A133 CPU Subsystem Control Register List
0x08110000 TIMESTAMP_STA
0x08120000 TIMESTAMP_CTRL
0x09010000 C0_CPUX_CFG — A133 Cluster 0 Configuration Register List

## Interrupts
32 UART0 (UART{n} (n=0..4), R_UART)
33 UART1 (UART{n} (n=0..4), R_UART)
34 UART2 (UART{n} (n=0..4), R_UART)
35 UART3 (UART{n} (n=0..4), R_UART)
36 UART4 (UART{n} (n=0..4), R_UART)
39 TWI0 (TWI{n} (n=0..3), S_TWI0, S_TWI1)
40 TWI1 (TWI{n} (n=0..3), S_TWI0, S_TWI1)
41 TWI2 (TWI{n} (n=0..3), S_TWI0, S_TWI1)
42 TWI3 (TWI{n} (n=0..3), S_TWI0, S_TWI1)
45 SPI0 (SPI{n} (n=0..2))
46 SPI1 (SPI{n} (n=0..2))
47 SPI2 (SPI{n} (n=0..2))
58 I2S0 (I2S{n} (n=0..3))
59 I2S1 (I2S{n} (n=0..3))
60 I2S2 (I2S{n} (n=0..3))
62 I2S3 (I2S{n} (n=0..3))
62 USB20_HOST0_EHCI (USB20_HOST0_EHCI, USB20_HOST1_EHCI)
63 USB20_HOST0_OHCI (USB20_HOST0_OHCI, USB20_HOST1_OHCI)
64 USB20_OTG_DEVICE
65 USB20_HOST1_EHCI (USB20_HOST0_EHCI, USB20_HOST1_EHCI)
66 USB20_HOST1_OHCI (USB20_HOST0_OHCI, USB20_HOST1_OHCI)
77 DMA_NS (DMAC)
83 TIMER0 (TIMER, R_TIMER, R_WDG, R_TWDG)
84 TIMER1 (TIMER, R_TIMER, R_WDG, R_TWDG)
86 GPIOB (GPIOINTA, GPIOINTB, GPIOINTC, GPIOINTD, GPIOINTE, GPIOINTF, GPIOINTG, GPIOINTH, GPIOINTI)
87 GPIOC (GPIOINTA, GPIOINTB, GPIOINTC, GPIOINTD, GPIOINTE, GPIOINTF, GPIOINTG, GPIOINTH, GPIOINTI)
88 GPIOD (GPIOINTA, GPIOINTB, GPIOINTC, GPIOINTD, GPIOINTE, GPIOINTF, GPIOINTG, GPIOINTH, GPIOINTI)
89 GPIOE (GPIOINTA, GPIOINTB, GPIOINTC, GPIOINTD, GPIOINTE, GPIOINTF, GPIOINTG, GPIOINTH, GPIOINTI)
90 GPIOF (GPIOINTA, GPIOINTB, GPIOINTC, GPIOINTD, GPIOINTE, GPIOINTF, GPIOINTG, GPIOINTH, GPIOINTI)
91 GPIOG (GPIOINTA, GPIOINTB, GPIOINTC, GPIOINTD, GPIOINTE, GPIOINTF, GPIOINTG, GPIOINTH, GPIOINTI)
92 GPIOH (GPIOINTA, GPIOINTB, GPIOINTC, GPIOINTD, GPIOINTE, GPIOINTF, GPIOINTG, GPIOINTH, GPIOINTI)
93 GPIOI (GPIOINTA, GPIOINTB, GPIOINTC, GPIOINTD, GPIOINTE, GPIOINTF, GPIOINTG, GPIOINTH, GPIOINTI)
100 DSI0
136 R_TIMER0 (TIMER, R_TIMER, R_WDG, R_TWDG)
137 R_TIMER1 (TIMER, R_TIMER, R_WDG, R_TWDG)
138 R_TIMER2 (TIMER, R_TIMER, R_WDG, R_TWDG)
139 R_TIMER3 (TIMER, R_TIMER, R_WDG, R_TWDG)
141 R_WDOG (TIMER, R_TIMER, R_WDG, R_TWDG)
142 R_TWD (TIMER, R_TIMER, R_WDG, R_TWDG)
143 R_GPIOL (GPIOINTA, GPIOINTB, GPIOINTC, GPIOINTD, GPIOINTE, GPIOINTF, GPIOINTG, GPIOINTH, GPIOINTI)
144 R_UART (UART{n} (n=0..4), R_UART)
145 S_TWI0 (TWI{n} (n=0..3), S_TWI0, S_TWI1)
146 S_TWI1 (TWI{n} (n=0..3), S_TWI0, S_TWI1)

## Notices in the file
Copyright (c) 2024 by Genadi V. Zawidowski. All rights reserved.
