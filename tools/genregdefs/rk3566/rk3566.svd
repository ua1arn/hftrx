# rk3566 register map
File version: 1.00
for test
Registers are 32-bit, read-write, reset 0x0 unless marked. A register's access mark holds for its fields unless they carry their own. Offsets are from the block's base; lines under a group give offsets from that group; [hi:lo] are bit positions; {n}, {i} and the like mark numbered series; 'fields as' and 'values as' point back to an identical list; <NAME> marks a mode.

## Memory map
0xFD404000 GICVSELF
0xFD405000 GICV
0xFDD50000 UART0
{0xFE640000+0x10000*n} UART{n} (n=1..9)

## GICVSELF
Base 0xFD404000
Same registers: GICV 0xFD405000
0x00 GICH_HCR — RW 0x00000000 Hypervisor Control Register
0x04 GICH_VTR — RO 0x90000003 VGIC Type Register, GICH_VTR on page 3-13
0x08 GICH_VMCR — RW 0x004C0000 Virtual Machine Control Register
0x10 GICH_MISR — RO 0x00000000 Maintenance Interrupt Status Register
0x20 GICH_EISR0 — RO 0x00000000 End of Interrupt Status Register
0x30 GICH_ELSR0 — RO 0x0000000F Empty List register Status Register
0xF0 GICH_APR0 — RW 0x00000000 Active Priority Register
{0x100+4i} GICH_LR{i} (i=0..3) — RW 0x00000000 List Register {i}

## UART0
Base 0xFDD50000
Same registers: UART{n} {0xFE640000+0x10000*n} (n=1..9)
0x00 UART_RBR_THR_DLL — UART Receive Buffer Register/Transmit Holding Register
0x04 UART_DLH_IER
0x08 UART_IIR_FCR — UART Interrupt Identity Register/UART FIFO Control Register
0x0C UART_LCR — UART Line Control Register
0x10 UART_MCR — UART Modem Control Register
0x14 UART_LSR — UART Line Status Register
0x18 UART_MSR — UART Modem Status Register
0x1C UART_SCH — UART Scratch Register
0x30 UART_SRBR_STHR — W 0x00000000 Shadow Receive Buffer Register, Shadow Transmit Holding Register
0x70 UART_FAR — W 0x00000000 FIFO Access Register
0x74 UART_TFR — W 0x00000000 Transmit FIFO Read
0x78 UART_RFW — W 0x00000000 Receive FIFO write
0x7C UART_USR — W 0x00000006 UART Status Register
0x80 UART_TFL — W 0x00000000 Transmit FIFO level
0x84 UART_RFL — W 0x00000000 Receive FIFO level
0x88 UART_SRR — W 0x00000000 Software Reset Register
0x8C UART_SRTS — W 0x00000000 Shadow Request to Send
0x90 UART_SBCR — W 0x00000000 Shadow Break Control Register
0x94 UART_SDMAM — W 0x00000000 Shadow DMA Mode
0x98 UART_SFE — W 0x00000000 Shadow FIFO enable
0x9C UART_SRT — W 0x00000000 Shadow RCVR Trigger
0xA0 UART_STET — W 0x00000000 Shadow TX Empty Trigger
0xA4 UART_HTX — W 0x00000000 Halt TX
0xA8 UART_DMASA — W 0x00000000 DMA Software Acknowledge
0xF4 UART_CPR — W 0x00043FF2 Component Parameter Register
0xF8 UART_UCV — W 0x3330382A UART Component Version
0xFC UART_CTR — W 0x44570110 Component Type Register

## Notices in the file
Copyright (c) 2024 by Genadi V. Zawidowski. All rights reserved.
