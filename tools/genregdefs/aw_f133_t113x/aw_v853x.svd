# aw_v853x register map
File version: 1.00
Registers are 32-bit, read-write, reset 0x0 unless marked. A register's access mark holds for its fields unless they carry their own. Offsets are from the block's base; [hi:lo] are bit positions; lines under a group give offsets from that group; {n}, {i} and the like mark numbered series.

## TWI0
Base 0x02502000
Same registers: TWI1 0x02502400, TWI2 0x02502800, TWI3 0x02502C00
0x00 TWI_ADDR — TWI Slave Address Register
0x04 TWI_XADDR — TWI Extended Slave Address Register
0x08 TWI_DATA — TWI Data Byte Register
0x0C TWI_CNTR — TWI Control Register
0x10 TWI_STAT — TWI Status Register
0x14 TWI_CCR — TWI Clock Control Register
0x18 TWI_SRST — TWI Software Reset Register
0x1C TWI_EFR — TWI Enhance Feature Register
0x20 TWI_LCR — TWI Line Control Register
0x200 TWI_DRV_CTRL — TWI_DRV Control Register
0x204 TWI_DRV_CFG — TWI_DRV Transmission Configuration Register
0x208 TWI_DRV_SLV — TWI_DRV Slave ID Register
0x20C TWI_DRV_FMT — TWI_DRV Packet Format Register
0x210 TWI_DRV_BUS_CTRL — TWI_DRV Bus Control Register
0x214 TWI_DRV_INT_CTRL — TWI_DRV Interrupt Control Register
0x218 TWI_DRV_DMA_CFG — TWI_DRV DMA Configure Register
0x21C TWI_DRV_FIFO_CON — TWI_DRV FIFO Content Register
0x300 TWI_DRV_SEND_FIFO_ACC — TWI_DRV Send Data FIFO Access Register
0x304 TWI_DRV_RECV_FIFO_ACC — TWI_DRV Receive Data FIFO Access Register

## UART0
Base 0x02500000
Same registers: UART1 0x02500400, UART2 0x02500800, UART3 0x02500C00, UART4 0x02501000, UART5 0x02501400
0x00 UART_RBR_THR_DLL — UART Receive Buffer Register/Transmit Holding Register
0x04 UART_DLH_IER
0x08 UART_IIR_FCR — UART Interrupt Identity Register/UART FIFO Control Register
0x0C UART_LCR — UART Line Control Register
0x10 UART_MCR — UART Modem Control Register
0x14 UART_LSR — UART Line Status Register
0x18 UART_MSR — UART Modem Status Register
0x1C UART_SCH — UART Scratch Register
0x7C UART_USR — UART Status Register
0x80 UART_TFL — UART Transmit FIFO Level Register
0x84 UART_RFL — UART Receive FIFO Level Register
0x88 UART_HSK — UART DMA Handshake Configuration Register
0x8C UART_DMA_REQ_EN — UART DMA Request Enable Register
0xA4 UART_HALT — UART Halt TX Register
0xB0 UART_DBG_DLL — UART Debug DLL Register
0xB4 UART_DBG_DLH — UART Debug DLH Register
0xF0 UART_A_FCC — UART FIFO Clock Control Register
0x100 UART_A_RXDMA_CTRL — UART RXDMA Control Register
0x104 UART_A_RXDMA_STR — UART RXDMA Start Register
0x108 UART_A_RXDMA_STA — UART RXDMA Status Register
0x10C UART_A_RXDMA_LMT — UART RXDMA Limit Register
0x110 UART_A_RXDMA_SADDRL — UART RXDMA Buffer Start Address Low Register
0x114 UART_A_RXDMA_SADDRH — UART RXDMA Buffer Start Address High Register
0x118 UART_A_RXDMA_BL — UART RXDMA Buffer Length Register
0x120 UART_A_RXDMA_IE — UART RXDMA Interrupt Enable Register
0x124 UART_A_RXDMA_IS — UART RXDMA Interrupt Status Register
0x128 UART_A_RXDMA_WADDRL — UART RXDMA Write Address Low Register
0x12C UART_A_RXDMA_WADDRH — UART RXDMA Write Address high Register
0x130 UART_A_RXDMA_RADDRL — UART RXDMA Read Address Low Register
0x134 UART_A_RXDMA_RADDRH — UART RXDMA Read Address high Register
0x138 UART_A_RXDMA_DCNT — UART RADMA Data Count Register

## USBOTG0
Base 0x04100000
{0x0+0x18*i} USB_EPFIFO[{i}] (i=0..5) — USB_EPFIFO [0..5] USB FIFO Entry for Endpoint N
0x40 USB_GCS — USB_POWER, USB_DEVCTL, USB_EPINDEX, USB_DMACTL USB Global Control and Status Register
0x44 USB_INTTX 16-bit — USB_INTTX USB_EPINTF USB Endpoint Interrupt Flag Register
0x46 USB_INTRX 16-bit — USB_INTRX USB_EPINTF
0x48 USB_INTTXE 16-bit — USB_INTTXE USB_EPINTE USB Endpoint Interrupt Enable Register
0x4A USB_INTRXE 16-bit — USB_INTRXE USB_EPINTE
0x4C USB_INTUSB — USB_INTUSB USB_BUSINTF USB Bus Interrupt Flag Register
0x50 USB_INTUSBE — USB_INTUSBE USB_BUSINTE USB Bus Interrupt Enable Register
0x54 USB_FNUM — USB Frame Number Register
0x7C USB_TESTC — USB_TESTC USB Test Control Register
0x80 USB_TXMAXP 16-bit — USB_TXMAXP USB EP1~5 Tx Control and Status Register
0x82 USB_TXCSRHI 16-bit — [15:8]: USB_TXCSRH, [7:0]: USB_TXCSRL
0x84 USB_RXMAXP 16-bit — USB_RXMAXP USB EP1~5 Rx Control and Status Register
0x86 USB_RXCSRHI 16-bit — USB_RXCSR
0x88 USB_RXCOUNT 16-bit
0x8A USB_RXPKTCNT 16-bit
0x8C USB_EPATTR — USB_EPATTR USB EP0 Attribute Register, USB EP1~5 Attribute Register
0x90 USB_TXFIFO — USB_TXFIFO (bits 28:16 Start address of the endpoint FIFO is in units of 8 bytes)
0x94 USB_RXFIFO — USB_RXFIFO (bits 28:16 Start address of the endpoint FIFO is in units of 8 bytes)
{0x98+0x70*i} unnamed[{i}] (i=0..15) group
  0x00 USB_TXFADDR 16-bit
  0x02 USB_TXHADDR 8-bit
  0x03 USB_TXHUBPORT 8-bit
  0x04 USB_RXFADDR 8-bit
  0x06 USB_RXHADDR 8-bit
  0x07 USB_RXHUBPORT 8-bit
0x400 USB_ISCR — HCI Interface Register (HCI_Interface)
0x404 USBPHY_PHYCTL
0x408 HCI_CTRL3 — HCI Control 3 Register (bist)
0x410 PHY_CTRL — PHY Control Register (PHY_Control)
0x420 PHY_OTGCTL — Control PHY routing to EHCI or OTG
0x424 PHY_STATUS
0x428 USB_SPDCR — HCI SIE Port Disable Control Register
0x500 USB_DMA_INTE — USB DMA Interrupt Enable Register
0x504 USB_DMA_INTS — USB DMA Interrupt Status Register
{0x540+0x80*i} unnamed[{i}] (i=0..7) group
  0x00 CHAN_CFG — USB DMA Channel Configuration Register
  0x04 SDRAM_ADD — USB DMA Channel Configuration Register
  0x08 BC — USB DMA Byte Counter Register/USB DMA RESIDUAL Byte Counter Register

## USBPHY0
Base 0x04100400
Same registers: USBPHY1 0x04200800
0x00 USB_CTRL — HCI Interface Register (HCI_Interface)
0x04 USBPHY_PHYCTL
0x08 HCI_CTRL3 — HCI Control 3 Register (bist)
0x10 PHY_CTRL — PHY Control Register (PHY_Control)
0x20 PHY_OTGCTL — Control PHY routing to EHCI or OTG
0x24 PHY_STATUS
0x28 USB_SPDCR — HCI SIE Port Disable Control Register

## USBEHCI0
Base 0x04101000
Same registers: USBEHCI1 0x04200000
0x00 HCCAPBASE — EHCI Capability Register (HCIVERSION and CAPLENGTH) register
0x04 HCSPARAMS — EHCI Host Control Structural Parameter Register
0x08 HCCPARAMS — EHCI Host Control Capability Parameter Register
0x0C HCSPPORTROUTE — EHCI Companion Port Route Description
0x10 USBCMD — EHCI USB Command Register
0x14 USBSTS — EHCI USB Status Register
0x18 USBINTR — EHCI USB Interrupt Enable Register
0x1C FRINDEX — EHCI USB Frame Index Register
0x20 CTRLDSSEGMENT — EHCI 4G Segment Selector Register
0x24 PERIODICLISTBASE — EHCI Frame List Base Address Register
0x28 ASYNCLISTADDR — EHCI Next Asynchronous List Address Register

## USBOHCI0
Base 0x04101400
Same registers: USBOHCI1 0x04200400
0x00 O_HcRevision — OHCI Revision Register (not documented)
0x04 O_HcControl — OHCI Control Register
0x08 O_HcCommandStatus — OHCI Command Status Register
0x0C O_HcInterruptStatus — OHCI Interrupt Status Register
0x10 O_HcInterruptEnable — OHCI Interrupt Enable Register
0x14 O_HcInterruptDisable — OHCI Interrupt Disable Register
0x18 O_HcHCCA — OHCI HCCA Base
0x1C O_HcPeriodCurrentED — OHCI Period Current ED Base
0x20 O_HcControlHeadED — OHCI Control Head ED Base
0x24 O_HcControlCurrentED — OHCI Control Current ED Base
0x28 O_HcBulkHeadED — OHCI Bulk Head ED Base
0x2C O_HcBulkCurrentED — OHCI Bulk Current ED Base
0x30 O_HcDoneHead — OHCI Done Head Base
0x34 O_HcFmInterval — OHCI Frame Interval Register
0x38 O_HcFmRemaining — OHCI Frame Remaining Register
0x3C O_HcFmNumber — OHCI Frame Number Register
0x40 O_HcPerioddicStart — OHCI Periodic Start Register
0x44 O_HcLSThreshold — OHCI LS Threshold Register
0x48 O_HcRhDescriptorA — OHCI Root Hub Descriptor Register A
0x4C O_HcRhDesriptorB — OHCI Root Hub Descriptor Register B
0x50 O_HcRhStatus — OHCI Root Hub Status Register
{0x54+4i} O_HcRhPortStatus[{i}] (i=0..0) — OHCI Root Hub Port Status Register
