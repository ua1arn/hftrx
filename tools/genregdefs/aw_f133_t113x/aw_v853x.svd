# aw_v853x register map
File version: 1.00
Registers are 32-bit, read-write, reset 0x0 unless marked. A register's access mark holds for its fields unless they carry their own. Offsets are from the block's base; [hi:lo] are bit positions; lines under a group give offsets from that group; {n}, {i} and the like mark numbered series.

## DE_MIXER0_VSU1 — Video Scaler Unit (VSU), VS
Base 0x05120000
Same registers: DE_MIXER0_VSU2 0x05140000, DE_MIXER1_VSU1 0x05220000
0x00 VSU_CTRL_REG — VSU Module Control Register
0x08 VSU_STATUS_REG — VSU Status Register
0x0C VSU_FIELD_CTRL_REG — VSU Field Control Register
0x10 VSU_SCALE_MODE_REG — VSU Scale Mode Setting Register
0x20 VSU_DIRECTION_THR_REG — VSU Direction Detection Threshold Register
0x24 VSU_EDGE_THR_REG — VSU Edge Detection Setting Register
0x28 VSU_EDSCALER_CTRL_REG — VSU Edge-Direction Scaler Control Register
0x2C VSU_ANGLE_THR_REG — VSU Angle Reliability Setting Register
0x30 VSU_SHARP_EN_REG — VSU Sharpness Control Enable Register
0x34 VSU_SHARP_CORING_REG — VSU Sharpness Control Coring Setting Register
0x38 VSU_SHARP_GAIN0_REG — VSU Sharpness Control Gain Setting 0 Register
0x3C VSU_SHARP_GAIN1_REG — VSU Sharpness Control Gain Setting 1 Register
0x40 VSU_OUT_SIZE_REG — VSU Output Size Register
0x44 VSU_GLOBAL_ALPHA_REG
0x80 VSU_Y_SIZE_REG — VSU Y Channel Size Register
0x88 VSU_Y_HSTEP_REG — VSU Y Channel Horizontal Step Register
0x8C VSU_Y_VSTEP_REG — VSU Y Channel Vertical Step Register
0x90 VSU_Y_HPHASE_REG — VSU Y Channel Horizontal Initial Phase Register
0x98 VSU_Y_VPHASE0_REG — VSU Y Channel Vertical Initial Phase 0 Register
0x9C VSU_Y_VPHASE1_REG — VSU Y Channel Vertical Initial Phase 1 Register
0xC0 VSU_C_SIZE_REG — VSU C Channel Size Register
0xC8 VSU_C_HSTEP_REG — VSU C Channel Horizontal Step Register
0xCC VSU_C_VSTEP_REG — VSU C Channel Vertical Step Register
0xD0 VSU_C_HPHASE_REG — VSU C Channel Horizontal Initial Phase Register
0xD8 VSU_C_VPHASE0_REG — VSU C Channel Vertical Initial Phase 0 Register
0xDC VSU_C_VPHASE1_REG — VSU C Channel Vertical Initial Phase 1 Register
{0x200+0x80*i} VSU_Y_HCOEF0_REGN[{i}] (i=0..31) — 0x200+N*4 VSU Y Channel Horizontal Filter Coefficient0 Register N N = M 1))
{0x300+0x80*i} VSU_Y_HCOEF1_REGN[{i}] (i=0..31) — 0x300+N*4 VSU Y Channel Horizontal Filter Coefficient1 Register N N = M 1
{0x400+0x80*i} VSU_Y_VCOEF_REGN[{i}] (i=0..31) — 0x400+N*4 VSU Y Channel Vertical Filter Coefficient Register N N = M 1))
{0x600+0x80*i} VSU_C_HCOEF0_REGN[{i}] (i=0..31) — 0x600+N*4 VSU C Channel Horizontal Filter Coefficient0 Register N N = M 1))
{0x700+0x80*i} VSU_C_HCOEF1_REGN[{i}] (i=0..31) — 0x700+N*4 VSU C Channel Horizontal Filter Co efficient1 Register N N = M 1))
{0x800+0x80*i} VSU_C_VCOEF_REGN[{i}] (i=0..31) — 0x800+N*4 VSU C Channel Vertical Filter Coefficient Register N N = M 1))

## DISPLAY_TOP — display interface top (DISPLAY_TOP)
Base 0x05460000
0x00 TV_CLK_SRC_RGB_SRC — TCON_TV Clock Select and RGB Source Select Register
0x1C DE_PORT_PERH_SEL — DE Source Select TCON R Register
0x20 MODULE_GATING — TCON Output to LVDS/DSI/TVE/HDMI Gating Register

## DMAC
Base 0x03002000
0x00 DMAC_IRQ_EN_REG0 — DMAC IRQ Enable Register 0
0x04 DMAC_IRQ_EN_REG1 — DMAC IRQ Enable Register 1
0x10 DMAC_IRQ_PEND_REG0 — DMAC IRQ Pending Register 0
0x14 DMAC_IRQ_PEND_REG1 — DMAC IRQ Pending Register 1
0x28 DMAC_AUTO_GATE_REG — DMAC Auto Gating Register
0x30 DMAC_STA_REG — DMAC Status Register
{0x100+0x400*i} unnamed[{i}] (i=0..15) group
  0x00 DMAC_EN_REGN — DMAC Channel Enable Register N (N = 0 to 15) 0x0100 + N*0x0040
  0x04 DMAC_PAU_REGN — DMAC Channel Pause Register N (N = 0 to 15) 0x0104 + N*0x0040
  0x08 DMAC_DESC_ADDR_REGN — DMAC Channel Start Address Register N (N = 0 to 15) 0x0108 + N*0x0040
  0x0C DMAC_CFG_REGN — DMAC Channel Configuration Register N (N = 0 to 15) 0x010C + N*0x0040
  0x10 DMAC_CUR_SRC_REGN — DMAC Channel Current Source Register N (N = 0 to 15) 0x0110 + N*0x0040
  0x14 DMAC_CUR_DEST_REGN — DMAC Channel Current Destination Register N (N = 0 to 15) 0x0114 + N*0x0040
  0x18 DMAC_BCNT_LEFT_REGN — DMAC Channel Byte Counter Left Register N (N = 0 to 15) 0x0118 + N*0x0040
  0x1C DMAC_PARA_REGN — DMAC Channel Parameter Register N (N = 0 to 15) 0x011C + N*0x0040
  0x28 DMAC_MODE_REGN — DMAC Mode Register N (N = 0 to 15) 0x0128 + N*0x0040
  0x2C DMAC_FDESC_ADDR_REGN — DMAC Former Descriptor Address Register N (N = 0 to 15) 0x012C + N*0x0040
  0x30 DMAC_PKG_NUM_REGN — DMAC Package Number Register N (N = 0 to 15) 0x0130 + N*0x0040
