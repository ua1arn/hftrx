# aw_v853x register map
File version: 1.00
for test
Registers are 32-bit, read-write, reset 0x0 unless marked. A register's access mark holds for its fields unless they carry their own. Offsets are from the block's base; lines under a group give offsets from that group; [hi:lo] are bit positions; {n}, {i} and the like mark numbered series; 'fields as' and 'values as' point back to an identical list; <NAME> marks a mode.

## Memory map
0x01701000 DSP_MSGBOX
0x01C0E000 VENCODER — Video Encoding
0x02000000 GPIOBLOCK
0x02000030 GPIOB
0x02000060 GPIOC
0x02000090 GPIOD
0x020000C0 GPIOE
0x020000F0 GPIOF
0x02000120 GPIOG
0x02000220 GPIOINTB
0x02000240 GPIOINTC
0x02000260 GPIOINTD
0x02000280 GPIOINTE
0x020002A0 GPIOINTF
0x020002C0 GPIOINTG
0x02000800 SPC — Secure Peripherals Control (SPC) - Sets secure property of peripherals
0x02000C00 PWM — Pulse Width Modulation module
0x02001000 CCU — Clock Controller Unit (CCU)
0x02003000 CIR_TX
0x02008000 LEDC — LED Lamp Controller
0x02009000 GPADC
0x02009400 THS — Thermal Sensor
0x02009C00 TPADC
0x02010000 IOMMU
0x02030000 AUDIO_CODEC
0x02031000 DMIC
0x02033000 I2S1
0x02034000 I2S2
0x02050000 TIMER
0x02500000 UART0
0x02500400 UART1
0x02500800 UART2
0x02500C00 UART3
0x02501000 UART4
0x02501400 UART5
0x02502000 TWI0
0x02502400 TWI1
0x02502800 TWI2
0x02502C00 TWI3
0x02504000 CAN0 — CAN (see Allwinner_T3_User_Manual_V1.0_cleaned.pdf as part of documentation)
0x02504400 CAN1
0x03000000 SYS_CFG
0x03002000 DMAC
0x03003000 CPUX_MSGBOX — Message Box
0x03005000 SPINLOCK — Spin Lock module
0x03006000 SID — Security ID
0x03007000 SMC — Secure Memory Control (SMC) - Sets secure area of DRAM
0x03008000 HSTIMER — High Speed Timer (HSTimer)
0x03024000 GICVSELF
0x03025000 GICV
0x03040000 CE_NS — Crypto Engine (CE)
0x03040800 CE_S
0x03102000 MCTL_COM
0x03103000 DDRPHYC
0x03103000 MCTL_PHY
0x04020000 SMHC0 — SD-MMC Host Controller
0x04021000 SMHC1
0x04022000 SMHC2
0x04025000 SPI0 — Serial Peripheral Interface
0x04026000 SPI1
0x04026000 SPI_DBI
0x04100000 USBOTG0
0x04100400 USBPHY0
0x04101000 USBEHCI0
0x04101400 USBOHCI0
0x04200000 USBEHCI1
0x04200400 USBOHCI1
0x04200800 USBPHY1
0x04500000 EMAC
0x05000000 DE_TOP — Display Engine (DE) TOP
0x05100000 DE_MIXER0_GLB — Display Engine (DE) - Global Control
0x05101000 DE_MIXER0_BLD — Display Engine (DE) - Blender
0x05102000 DE_MIXER0_VI1 — Display Engine (DE) - VI surface
0x05103000 DE_MIXER0_UI1 — Display Engine (DE) - UI surface
0x05120000 DE_MIXER0_VEP0 — Fresh and Contrast Enhancement (FCE), Peak, Chrominance transient improvement (CTI) LCTI, Blue Level Stretch (BLS), ancy color curvature (FCC), VEP_TOP blocks
0x05120000 DE_MIXER0_VSU1 — Video Scaler Unit (VSU), VS
0x05140000 DE_MIXER0_UIS1 — UI Scaler(UIS) provides RGB format image resizing function
0x05140000 DE_MIXER0_VEP1
0x05140000 DE_MIXER0_VSU2
0x05150000 DE_MIXER0_UIS2
0x05160000 DE_MIXER0_UIS3
0x051A0000 DE_MIXER0_DEP — DRC (dynamic range controller)
0x05200000 DE_MIXER1_GLB
0x05201000 DE_MIXER1_BLD
0x05202000 DE_MIXER1_VI1
0x05220000 DE_MIXER1_VEP0
0x05220000 DE_MIXER1_VSU1
0x05240000 DE_MIXER1_UIS1
0x05410000 G2D_TOP — Graphic 2D top
0x05410100 G2D_MIXER — Graphic 2D (G2D) Engine Video Mixer
0x05410400 G2D_BLD — Graphic 2D (G2D) Engine Blender
0x05410800 G2D_V0 — Graphic 2D VI surface
0x05411000 G2D_UI0 — Graphic 2D UI surface
0x05411800 G2D_UI1
0x05412000 G2D_UI2
0x05413000 G2D_WB — Graphic 2D (G2D) Engine Write Back
0x05418000 G2D_VSU — Graphic 2D Video Scaler
0x05438000 G2D_ROT — Graphic 2D Rotate
0x05450000 DSI0 — MIPI DSI Display Interface
0x05451000 DSI_DPHY — MIPI DSI Physical Interface
0x05460000 DISPLAY_TOP — display interface top (DISPLAY_TOP)
0x05461000 TCON_LCD0 — Timing Controller_LCD (TCON_LCD)
0x05470000 TCON_TV0
0x05500000 HDMI_TX0
0x05510000 HDMI_PHY
0x05600000 TVE_TOP — TV Output TV Encoder (display out interface = CVBS OUT)
0x05604000 TVE0 — TV Encoder (display out interface = CVBS OUT)
0x05800800 CSIC_TOP
0x05820000 CSIC_PARSER0
0x05821000 CSIC_PARSER1
0x05822000 CSIC_PARSER2
0x05830000 CSIC_DMA0
0x05831000 CSIC_DMA1
0x05832000 CSIC_DMA2
0x05833000 CSIC_DMA3
0x05C00000 TVD_TOP — Video Decoding
0x05C01000 TVD0 — Video Decoding
0x06010000 RISC_CFG — RISC-V core configuration register
0x07000400 R_CPUCFG
0x07010000 R_PRCM
0x07010000 R_CCU
0x07040000 CIR_RX
0x07090000 RTC — Real Time Clock
0x08100000 CPU_SUBSYS_CTRL
0x09010000 C0_CPUX_CFG

## Interrupts
18 UART0 (UART{n} (n=0..5))
19 UART1 (UART{n} (n=0..5))
20 UART2 (UART{n} (n=0..5))
21 UART3 (UART{n} (n=0..5))
22 UART4 (UART{n} (n=0..5))
23 UART5 (UART{n} (n=0..5))
25 TWI0 (TWI{n} (n=0..3))
26 TWI1 (TWI{n} (n=0..3))
27 TWI2 (TWI{n} (n=0..3))
28 TWI3 (TWI{n} (n=0..3))
31 SPI0 (SPI0, SPI1, SPI_DBI)
32 SPI1 (SPI0, SPI1, SPI_DBI)
36 LEDC
37 CAN0 (CAN0, CAN1)
38 CAN1 (CAN0, CAN1)
41 AUDIO_CODEC
43 I2S_PCM1 (I2S1, I2S2)
44 I2S_PCM2 (I2S1, I2S2)
45 USB0_DEVICE (USBOTG0)
46 USB0_EHCI (USBEHCI0, USBEHCI1)
47 USB0_OHCI (USBOHCI0, USBOHCI1)
49 USB1_EHCI (USBEHCI0, USBEHCI1)
50 USB1_OHCI (USBOHCI0, USBOHCI1)
56 SMHC0 (SMHC{n} (n=0..2))
57 SMHC1 (SMHC{n} (n=0..2))
58 SMHC2 (SMHC{n} (n=0..2))
59 MCTL (MCTL_COM)
62 EMAC
64 CCU_FERR (CCU)
65 AHB_HREADY_TIME_OUT (CCU)
66 DMAC_NS (DMAC)
68 CE_NS (CE_NS, CE_S)
71 HSTIMER0 (HSTIMER)
72 HSTIMER1 (HSTIMER)
73 GPADC
74 THS
75 TIMER0 (TIMER)
76 TIMER1 (TIMER)
78 TPADC
79 WATCHDOG (TIMER)
80 IOMMU
82 VE (VENCODER)
85 GPIOB_NS (GPIOINTB, GPIOINTC, GPIOINTD, GPIOINTE, GPIOINTF, GPIOINTG)
87 GPIOC_NS (GPIOINTB, GPIOINTC, GPIOINTD, GPIOINTE, GPIOINTF, GPIOINTG)
89 GPIOD_NS (GPIOINTB, GPIOINTC, GPIOINTD, GPIOINTE, GPIOINTF, GPIOINTG)
91 GPIOE_NS (GPIOINTB, GPIOINTC, GPIOINTD, GPIOINTE, GPIOINTF, GPIOINTG)
93 GPIOF_NS (GPIOINTB, GPIOINTC, GPIOINTD, GPIOINTE, GPIOINTF, GPIOINTG)
95 GPIOG_NS (GPIOINTB, GPIOINTC, GPIOINTD, GPIOINTE, GPIOINTF, GPIOINTG)
103 DE (DE_TOP)
105 G2D (G2D_TOP)
106 TCON_LCD0
107 TCON_TV0
108 DSI0
109 HDMI_TX0
110 TVE (TVE_TOP)
111 CSIC_DMA0 (CSIC_DMA{n} (n=0..3))
112 CSIC_DMA1 (CSIC_DMA{n} (n=0..3))
113 CSIC_DMA2 (CSIC_DMA{n} (n=0..3))
114 CSIC_DMA3 (CSIC_DMA{n} (n=0..3))
116 CSIC_PARSER0 (CSIC_PARSER{n} (n=0..2))
117 CSIC_PARSER1 (CSIC_PARSER{n} (n=0..2))
118 CSIC_PARSER2 (CSIC_PARSER{n} (n=0..2))
120 CSI_CMB (CSIC_TOP)
121 CSI_TDM (CSIC_TOP)
122 CSI_TOP_PKT (CSIC_TOP)
123 TVD (TVD_TOP)
160 ALARM0 (RTC)
176 C0_CTI0 (C0_CPUX_CFG)
177 C0_CTI1 (C0_CPUX_CFG)
180 C0_COMMTX0 (C0_CPUX_CFG)
181 C0_COMMTX1 (C0_CPUX_CFG)
184 C0_COMMRX0 (C0_CPUX_CFG)
185 C0_COMMRX1 (C0_CPUX_CFG)
188 C0_PMU0 (C0_CPUX_CFG)
189 C0_PMU1 (C0_CPUX_CFG)
192 C0_AXI_ERROR (C0_CPUX_CFG)
194 AXI_WR_IRQ (C0_CPUX_CFG)
195 AXI_RD_IRQ (C0_CPUX_CFG)
196 DBGPWRUPREQ_out_0 (C0_CPUX_CFG)
197 DBGPWRUPREQ_out_1 (C0_CPUX_CFG)

## Notices in the file
Copyright (c) 2024 by Genadi V. Zawidowski. All rights reserved.
