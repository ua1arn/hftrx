# aw_v853x register map
File version: 1.00
Registers are 32-bit, read-write, reset 0x0 unless marked. A register's access mark holds for its fields unless they carry their own. Offsets are from the block's base; [hi:lo] are bit positions; lines under a group give offsets from that group; {n}, {i} and the like mark numbered series.

## DE_MIXER0_BLD — Display Engine (DE) - Blender
Base 0x05101000
Same registers: DE_MIXER1_BLD 0x05201000
0x00 BLD_EN_COLOR_CTL — BLD_FILL_COLOR_CTL Offset 0x000 BLD fill color control register
{0x4+0x60*i} unnamed[{i}] (i=0..5) group
  0x00 BLD_FILL_COLOR
  0x04 BLD_CH_ISIZE — BLD input memory size register
  0x08 BLD_CH_OFFSET — BLD input memory offset register
0x80 ROUTE — BLD_CH_RTCTL BLD routing control register (default value 0x00543210)
0x84 PREMULTIPLY — BLD pre-multiply control register
0x88 BKCOLOR
0x8C OUTPUT_SIZE
{0x90+0x18*i} BLD_MODE[{i}] (i=0..5) — BLD_CTL SUN8I_MIXER_BLEND_MODE
0xB0 CK_CTL
0xB4 CK_CFG
{0xC0+0x10*i} CK_MAX[{i}] (i=0..3)
{0xE0+0x10*i} CK_MIN[{i}] (i=0..3)
0xFC OUT_CTL

## DE_MIXER0_DEP — DRC (dynamic range controller)
Base 0x051A0000
{0x0+0x8000*i} CFG[{i}] (i=0..0)

## DE_MIXER0_GLB — Display Engine (DE) - Global Control
Base 0x05100000
Same registers: DE_MIXER1_GLB 0x05200000
0x00 GLB_CTL — Global control register
0x04 GLB_STS — Global status register
0x08 GLB_DBUFFER — Global double buffer control register
0x0C GLB_SIZE — Global size register

## DE_TOP — Display Engine (DE) TOP
Base 0x05000000
0x00 GATE_CFG — SCLK_GATE DE SCLK Gating Register
0x04 BUS_CFG — ? HCLK_GATE ? DE HCLK Gating Register
0x08 RST_CFG — AHB_RESET DE AHB Reset register
0x0C DIV_CFG — SCLK_DIV DE SCLK Division register
0x10 SEL_CFG — ? DE2TCON ? MUX register - lower bit swap DE outputs
0x24 DE_IP_CFG — DE IP Configure Register

## DE_MIXER0_UI1 — Display Engine (DE) - UI surface
Base 0x05103000
{0x0+0x80*i} unnamed[{i}] (i=0..3) group
  0x00 ATTR
  0x04 SIZE
  0x08 COORD
  0x0C PITCH
  0x10 TOP_LADDR
  0x14 BOT_LADDR
  0x18 FCOLOR
0x80 TOP_HADDR
0x84 BOT_HADDR
0x88 OVL_SIZE

## DE_MIXER0_UIS1 — UI Scaler(UIS) provides RGB format image resizing function
Base 0x05140000
Same registers: DE_MIXER0_UIS2 0x05150000, DE_MIXER0_UIS3 0x05160000, DE_MIXER1_UIS1 0x05240000
0x00 UIS_CTRL_REG — Control register
0x08 UIS_STATUS_REG — Status register
0x0C UIS_FIELD_CTRL_REG — Field control register
0x10 UIS_BIST_REG — BIST control register
0x40 UIS_OUTSIZE_REG — Output size register
0x80 UIS_INSIZE_REG — Input size register
0x88 UIS_HSTEP_REG — Horizontal step register
0x8C UIS_VSTEP_REG — Vertical step register
0x90 UIS_HPHASE_REG — Horizontal initial phase register
0x98 UIS_VPHASE0_REG — Vertical initial phase 0 register
0x9C UIS_VPHASE1_REG — Vertical initial phase 1 register
{0x200+0x40*i} UIS_HCOEF_REGN[{i}] (i=0..15) — Horizontal filter coefficient register N (N=0:15)#typeend

## DE_MIXER0_VEP0 — Fresh and Contrast Enhancement (FCE), Peak, Chrominance transient improvement (CTI) LCTI, Blue Level Stretch (BLS), ancy color curvature (FCC), VEP_TOP blocks
Base 0x05120000
Same registers: DE_MIXER0_VEP1 0x05140000, DE_MIXER1_VEP0 0x05220000
{0x0+0x800*i} CFG[{i}] (i=0..0)
{0x800+0x800*i} CFG[{i}] (i=0..0)
{0x1000+0x800*i} CFG[{i}] (i=0..0)
{0x1800+0x800*i} CFG[{i}] (i=0..0)
{0x2000+0x800*i} CFG[{i}] (i=0..0)
{0x7000+0x1000*i} CFG[{i}] (i=0..0)

## DE_MIXER0_VI1 — Display Engine (DE) - VI surface
Base 0x05102000
Same registers: DE_MIXER1_VI1 0x05202000
{0x0+0xC0*i} unnamed[{i}] (i=0..3) group
  0x00 ATTR
  0x04 SIZE
  0x08 COORD
  {0xC+0xC*j} PITCH[{j}] (j=0..2) — ix=0: Y, ix=1: U/UV channel, ix=3: V channel
  {0x18+0xC*j} TOP_LADDR[{j}] (j=0..2)
  {0x24+0xC*j} BOT_LADDR[{j}] (j=0..2)
{0xC0+0x10*i} FCOLOR[{i}] (i=0..3)
{0xD0+0xC*i} TOP_HADDR[{i}] (i=0..2)
{0xDC+0xC*i} BOT_HADDR[{i}] (i=0..2)
{0xE8+8i} OVL_SIZE[{i}] (i=0..1) — OVL_Y, OVL_UV overlay window size register
{0xF0+8i} HORI[{i}] (i=0..1) — OVL_V horizontal down sample control register
{0xF8+8i} VERT[{i}] (i=0..1) — OVL_V vertical down sample control register
