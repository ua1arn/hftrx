# aw_v853x register map
File version: 1.00
Registers are 32-bit, read-write, reset 0x0 unless marked. A register's access mark holds for its fields unless they carry their own. Offsets are from the block's base; [hi:lo] are bit positions; {n}, {i} and the like mark numbered series.

## HSTIMER — High Speed Timer (HSTimer)
Base 0x03008000
0x00 HS_TMR_IRQ_EN_REG — HS Timer IRQ Enable Register
0x04 HS_TMR_IRQ_STAS_REG — HS Timer Status Register
0x20 HS_TMR0_CTRL_REG — HS Timer0 Control Register
0x24 HS_TMR0_INTV_LO_REG — HS Timer0 Interval Value Low Register
0x28 HS_TMR0_INTV_HI_REG — HS Timer0 Interval Value High Register
0x2C HS_TMR0_CURNT_LO_REG — HS Timer0 Current Value Low Register
0x30 HS_TMR0_CURNT_HI_REG — HS Timer0 Current Value High Register
0x40 HS_TMR1_CTRL_REG — HS Timer1 Control Register
0x44 HS_TMR1_INTV_LO_REG — HS Timer1 Interval Value Low Register
0x48 HS_TMR1_INTV_HI_REG — HS Timer1 Interval Value High Register
0x4C HS_TMR1_CURNT_LO_REG — HS Timer1 Current Value Low Register
0x50 HS_TMR1_CURNT_HI_REG — HS Timer1 Current Value High Register

## I2S1
Base 0x02033000
Same registers: I2S2 0x02034000
0x00 I2S_PCM_CTL — I2S/PCM Control Register
0x04 I2S_PCM_FMT0 — I2S/PCM Format Register 0
0x08 I2S_PCM_FMT1 — I2S/PCM Format Register 1
0x0C I2S_PCM_ISTA — I2S/PCM Interrupt Status Register
0x10 I2S_PCM_RXFIFO
0x14 I2S_PCM_FCTL — I2S/PCM FIFO Control Register
0x18 I2S_PCM_FSTA — I2S/PCM FIFO Status Register
0x1C I2S_PCM_INT — I2S/PCM DMA & Interrupt Control Register
0x20 I2S_PCM_TXFIFO
0x24 I2S_PCM_CLKD — I2S/PCM Clock Divide Register
0x28 I2S_PCM_TXCNT — I2S/PCM TX Sample Counter Register
0x2C I2S_PCM_RXCNT — I2S/PCM RX Sample Counter Register
0x30 I2S_PCM_CHCFG — I2S/PCM Channel Configuration Register
{0x34+4i} I2S_PCM_TX{i}CHSEL (i=0..3) — I2S/PCM TX{i} Channel Select Register
{0x44+8i} I2S_PCM_TX{i}CHMAP0 (i=0..3) — I2S/PCM TX{i} Channel Mapping Register0
{0x48+8i} I2S_PCM_TX{i}CHMAP1 (i=0..3) — I2S/PCM TX{i} Channel Mapping Register1
0x64 I2S_PCM_RXCHSEL — I2S/PCM RX Channel Select Register
{0x68+0x10*i} I2S_PCM_RXCHMAP[{i}] (i=0..3) — I2S/PCM RX Channel Mapping Register0..3
0x80 MCLKCFG — ASRC MCLK Configuration Register
0x84 FsoutCFG — ASRC Out Sample Rate Configuration Register
0x88 FsinEXTCFG — ASRC Input Sample Pulse Extend Configuration Register
0x8C ASRCCFG — ASRC Enable Register
0x90 ASRCMANCFG — ASRC Manual Ratio Configuration Register
0x94 ASRCRATIOSTAT — ASRC Status Register
0x98 ASRCFIFOSTAT — ASRC FIFO Level Status Register
0x9C ASRCMBISTCFG — ASRC MBIST Test Configuration Register
0xA0 ASRCMBISTSTAT — ASRC MBIST Test Status Register

## LEDC — LED Lamp Controller
Base 0x02008000
0x00 LEDC_CTRL_REG — LEDC Control Register
0x04 LED_T01_TIMING_CTRL_REG — LEDC T0 & T1 Timing Control Register
0x08 LEDC_DATA_FINISH_CNT_REG — LEDC Data Finish Counter Register
0x0C LED_RESET_TIMING_CTRL_REG — LEDC Reset Timing Control Register
0x10 LEDC_WAIT_TIME0_CTRL_REG — LEDC Wait Time0 Control Register
0x14 LEDC_DATA_REG — LEDC Data Register
0x18 LEDC_DMA_CTRL_REG — LEDC DMA Control Register
0x1C LEDC_INT_CTRL_REG — LEDC Interrupt Control Register
0x20 LEDC_INT_STS_REG — LEDC Interrupt Status Register
0x28 LEDC_WAIT_TIME1_CTRL_REG — LEDC Wait Time1 Control Register
{0x30+0x80*i} LEDC_FIFO_DATA_REG[{i}] (i=0..31) — LEDC FIFO Data Registers array

## MCTL_COM
Base 0x03102000
0x00 MCTL_COM_WORK_MODE0 — Reg_000
0x04 MCTL_COM_WORK_MODE1 — Reg_004
0x08 MCTL_COM_DBGCR — Reg_008
0x0C MCTL_COM_TMR — Reg_00C
0x14 MCTL_COM_CCCR — Reg_014
{0x20+4i} MCTL_COM_MAER{i} (i=0..2) — Reg_{4i+20:03}
{0x500+4i} MCTL_COM_REMAP{i} (i=0..3) — REMAP{i}

## MCTL_PHY
Base 0x03103000
0x00 MCTL_PHY_PIR
0x04 MCTL_PHY_PWRCTL
0x08 MCTL_PHY_MRCTRL0
0x0C MCTL_PHY_CLKEN
0x10 MCTL_PHY_PGSR0
0x14 MCTL_PHY_PGSR1
0x18 MCTL_PHY_STATR
0x2C MCTL_PHY_LP3MR11
{0x30+4i} MCTL_PHY_DRAM_MR{i} (i=0..3)
0x44 MCTL_PHY_PTR0
{0x44+4i} MCTL_PHY_PTR{i} (i=2..4)
{0x58+4i} MCTL_PHY_DRAMTMG{i} (i=0..8)
0x7C MCTL_PHY_ODTCFG
0x80 MCTL_PHY_PITMG0
0x84 MCTL_PHY_PITMG1
0x88 MCTL_PHY_LPTPR
0x8C MCTL_PHY_RFSHCTL0
0x90 MCTL_PHY_RFSHTMG
0x94 MCTL_PHY_RFSHCTL1
0x98 MCTL_PHY_PWRTMG
0x9C MCTL_PHY_ASRC
0xA0 MCTL_PHY_ASRTC
0xB8 MCTL_PHY_VTFCR
0xBC MCTL_PHY_DQSGMR
0xC0 MCTL_PHY_DTCR
0xC4 MCTL_PHY_DTAR0
{0x100+4i} MCTL_PHY_PGCR{i} (i=0..3)
0x110 MCTL_PHY_IOVCR0
0x114 MCTL_PHY_IOVCR1
0x11C MCTL_PHY_DXCCR
0x120 MCTL_PHY_ODTMAP
0x124 MCTL_PHY_ZQCTL0
0x128 MCTL_PHY_ZQCTL1
0x140 MCTL_PHY_ZQCR
0x144 MCTL_PHY_ZQSR
{0x148+4i} MCTL_PHY_ZQDR{i} (i=0..2)
0x1C0 MCTL_PHY_SCHED
0x1C4 MCTL_PHY_PERFHPR0
0x1C8 MCTL_PHY_PERFHPR1
0x1CC MCTL_PHY_PERFLPR0
0x1D0 MCTL_PHY_PERFLPR1
0x1D4 MCTL_PHY_PERFWR0
0x1D8 MCTL_PHY_PERFWR1
0x200 MCTL_PHY_ACMDLR
0x204 MCTL_PHY_ACLDLR
0x208 MCTL_PHY_ACIOCR0
{0x210+0x40*i} MCTL_PHY_ACIOCR1[{i}] (i=0..15) — 0x210 + 0x4 * x
