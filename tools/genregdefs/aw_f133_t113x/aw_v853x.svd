# aw_v853x register map
File version: 1.00
Registers are 32-bit, read-write, reset 0x0 unless marked. A register's access mark holds for its fields unless they carry their own. Offsets are from the block's base; [hi:lo] are bit positions; lines under a group give offsets from that group; {n}, {i} and the like mark numbered series.

## THS — Thermal Sensor
Base 0x02009400
0x00 THS_CTRL — THS Control Register
0x04 THS_EN — THS Enable Register
0x08 THS_PER — THS Period Control Register
0x10 THS_DATA_INTC — THS Data Interrupt Control Register
0x14 THS_SHUT_INTC — THS Shut Interrupt Control Register
0x18 THS_ALARM_INTC — THS Alarm Interrupt Control Register
0x20 THS_DATA_INTS — THS Data Interrupt Status Register
0x24 THS_SHUT_INTS — THS Shut Interrupt Status Register
0x28 THS_ALARMO_INTS — THS Alarm off Interrupt Status Register
0x2C THS_ALARM_INTS — THS Alarm Interrupt Status Register
0x30 THS_FILTER — THS Median Filter Control Register
0x40 THS_ALARM_CTRL — THS Alarm Threshold Control Register
0x80 THS_SHUTDOWN_CTRL — THS Shutdown Threshold Control Register
0xA0 THS_CDATA — THS Calibration Data
0xC0 THS_DATA

## TIMER
Base 0x02050000
0x00 TMR_IRQ_EN_REG — Timer IRQ Enable Register
0x04 TMR_IRQ_STA_REG — Timer Status Register
{0x10+0x20*i} unnamed[{i}] (i=0..1) group
  0x00 CTRL_REG — Timer n Control Register
  0x04 INTV_VALUE_REG — Timer n Interval Value Register
  0x08 CUR_VALUE_REG — Timer n Current Value Register
0xA0 WDOG_IRQ_EN_REG — Watchdog IRQ Enable Register
0xA4 WDOG_IRQ_STA_REG — Watchdog Status Register
0xA8 WDOG_SOFT_RST_REG — Watchdog Software Reset Register
0xB0 WDOG_CTRL_REG — Watchdog Control Register
0xB4 WDOG_CFG_REG — Watchdog Configuration Register
0xB8 WDOG_MODE_REG — Watchdog Mode Register
0xBC WDOG_OUTPUT_CFG_REG — Watchdog Output Configuration Register
0xC0 AVS_CNT_CTL_REG — AVS Control Register
0xC4 AVS_CNT0_REG — AVS Counter 0 Register
0xC8 AVS_CNT1_REG — AVS Counter 1 Register
0xCC AVS_CNT_DIV_REG — AVS Divisor Register

## TPADC
Base 0x02009C00
{0x0+4i} TP_CTRL_REG{i} (i=0..3) — TP Control Register {i}
0x10 TP_INT_FIFO_CTRL_REG — TP Interrupt FIFO Control Register
0x14 TP_INT_FIFO_STAT_REG — TP Interrupt FIFO Status Register
0x1C TP_CALI_DATA_REG — TP Calibration Data Register
0x24 TP_DATA_REG — TP Data Register

## TVD0 — Video Decoding
Base 0x05C01000
0x00 TVD_EN — TVD MODULE CONTROL Register
0x04 TVD_MODE — TVD MODE CONTROL Register
0x08 TVD_CLAMP_AGC1 — TVD CLAMP & AGC CONTROL Register1
0x0C TVD_CLAMP_AGC2 — TVD CLAMP & AGC CONTROL Register2
{0xC+4i} TVD_HLOCK{i} (i=1..5) — TVD HLOCK CONTROL Register{i}
0x24 TVD_VLOCK1 — TVD VLOCK CONTROL Register1
0x28 TVD_VLOCK2 — TVD VLOCK CONTROL Register2
0x30 TVD_CLOCK1 — TVD CHROMA LOCK CONTROL Register1
0x34 TVD_CLOCK2 — TVD CHROMA LOCK CONTROL Register2
0x40 TVD_YC_SEP1 — TVD YC SEPERATION CONROL Register1
0x44 TVD_YC_SEP2 — TVD YC SEPERATION CONROL Register2
{0x4C+4i} TVD_ENHANCE{i} (i=1..3) — TVD ENHANCEMENT CONTROL Register{i}
{0x5C+4i} TVD_WB{i} (i=1..4) — TVD WB DMA CONTROL Register{i}
0x80 TVD_IRQ_CTL — TVD DMA Interrupt Control Register
0x90 TVD_IRQ_STATUS — TVD DMA Interrupt Status Register
0x100 TVD_DEBUG1 — TVD DEBUG CONTROL Register1
{0x17C+4i} TVD_STATUS{i} (i=1..6) — TVD DEBUG STATUS Register{i}

## TVD_TOP — Video Decoding
Base 0x05C00000
0x00 TVD_TOP_MAP
{0x4+4i} TVD_3D_CTL{i} (i=1..5) — TVD 3D DMA CONTROL Register{i}
{0x20+0x80*i} unnamed[{i}] (i=0..3) group
  0x04 TVD_TOP_CTL — TVD TOP CONTROL Register
  0x08 TVD_ADC_CTL — TVD ADC CONTROL Register
  0x0C TVD_ADC_CFG — TVD ADC CONFIGURATION Register

## TVE_TOP — TV Output TV Encoder (display out interface = CVBS OUT)
Base 0x05600000
0x20 TVE_DAC_MAP — TV Encoder DAC MAP Register
0x24 TVE_DAC_STATUS — TV Encoder DAC STAUTS Register
{0x28+0x20*i} unnamed[{i}] (i=0..0) group
  {0x0+4j} TVE_DAC_CFG{j} (j=0..3) — TV Encoder DAC CFG{j} Register
0xF0 TVE_DAC_TEST — TV Encoder DAC TEST Register

## TVE0 — TV Encoder (display out interface = CVBS OUT)
Base 0x05604000
0x00 TVE_000_REG — TV Encoder Clock Gating Register
0x04 TVE_004_REG — TV Encoder Configuration Register
0x08 TVE_008_REG — TV Encoder DAC Register1
0x0C TVE_00C_REG — TV Encoder Notch and DAC Delay Register
0x10 TVE_010_REG — TV Encoder Chroma Frequency Register
0x14 TVE_014_REG — TV Encoder Front/Back Porch Register
0x18 TVE_018_REG — TV Encoder HD Mode VSYNC Register
0x1C TVE_01C_REG — TV Encoder Line Number Register
0x20 TVE_020_REG — TV Encoder Level Register
0x24 TVE_024_REG — TV Encoder DAC Register2
0x30 TVE_030_REG — TV Encoder Auto Detection Enable Register
0x34 TVE_034_REG — TV Encoder Auto Detection Interrupt Status Register
0x38 TVE_038_REG — TV Encoder Auto Detection Status Register
0x3C TVE_03C_REG — TV Encoder Auto Detection De-bounce Setting Register
0xF8 TVE_0F8_REG — TV Encoder Auto Detect Configuration Register0
0xFC TVE_0FC_REG — TV Encoder Auto Detect Configuration Register1
0x100 TVE_100_REG — TV Encoder Color Burst Phase Reset Configuration Register
0x104 TVE_104_REG — TV Encoder VSYNC Number Register
0x108 TVE_108_REG — TV Encoder Notch Filter Frequency Register
0x10C TVE_10C_REG — TV Encoder Cb/Cr Level/Gain Register
0x110 TVE_110_REG — TV Encoder Tint and Color Burst Phase Register
0x114 TVE_114_REG — TV Encoder Burst Width Register
0x118 TVE_118_REG — TV Encoder Cb/Cr Gain Register
0x11C TVE_11C_REG — TV Encoder Sync and VBI Level Register
0x120 TVE_120_REG — TV Encoder White Level Register
0x124 TVE_124_REG — TV Encoder Video Active Line Register
0x128 TVE_128_REG — TV Encoder Video Chroma BW and CompGain Register
0x12C TVE_12C_REG — TV Encoder Register
0x130 TVE_130_REG — TV Encoder Re-sync Parameters Register
0x134 TVE_134_REG — TV Encoder Slave Parameter Register
0x138 TVE_138_REG — TV Encoder Configuration Register0
0x13C TVE_13C_REG — TV Encoder Configuration Register1
0x380 TVE_380_REG — TV Encoder Low Pass Control Register
0x384 TVE_384_REG — TV Encoder Low Pass Filter Control Register
0x388 TVE_388_REG — TV Encoder Low Pass Gain Register
0x38C TVE_38C_REG — TV Encoder Low Pass Gain Control Register
0x390 TVE_390_REG — TV Encoder Low Pass Shoot Control Register
0x394 TVE_394_REG — TV Encoder Low Pass Coring Register
0x3A0 TVE_3A0_REG — TV Encoder Noise Reduction Register
