# aw_v853x register map
File version: 1.00
Registers are 32-bit, read-write, reset 0x0 unless marked. A register's access mark holds for its fields unless they carry their own. Offsets are from the block's base; [hi:lo] are bit positions; lines under a group give offsets from that group; {n}, {i} and the like mark numbered series.

## DMIC
Base 0x02031000
0x00 DMIC_EN — DMIC Enable Control Register
0x04 DMIC_SR — DMIC Sample Rate Register
0x08 DMIC_CTR — DMIC Control Register
0x10 DMIC_DATA
0x14 DMIC_INTC — MIC Interrupt Control Register
0x18 DMIC_INTS — DMIC Interrupt Status Register
0x1C DMIC_RXFIFO_CTR — DMIC RXFIFO Control Register
0x20 DMIC_RXFIFO_STA — DMIC RXFIFO Status Register
0x24 DMIC_CH_NUM — DMIC Channel Numbers Register
0x28 DMIC_CH_MAP — DMIC Channel Mapping Register
0x2C DMIC_CNT — DMIC Counter Register
0x30 DATA0_DATA1_VOL_CTR — Data0 and Data1 Volume Control Register
0x34 DATA2_DATA3_VOL_CTR — Data2 And Data3 Volume Control Register
0x38 HPF_EN_CTR — High Pass Filter Enable Control Register
0x3C HPF_COEF_REG — High Pass Filter Coefficient Register
0x40 HPF_GAIN_REG — High Pass Filter Gain Register

## DSI0 — MIPI DSI Display Interface
Base 0x05450000
0x00 DSI_CTL — dsi_gctl 0x00 - 0x0c
0x04 DSI_GINT0
0x08 DSI_GINT1
0x0C DSI_BASIC_CTL
0x10 DSI_BASIC_CTL0 — dsi_basic_ctl0 0x10 - 0x1c
0x14 DSI_BASIC_CTL1
0x18 DSI_BASIC_SIZE0
0x1C DSI_BASIC_SIZE1
{0x20+0x20*i} DSI_BASIC_INST0[{i}] (i=0..7) — dsi_inst_func[8] 0x20 - 0x3c
0x40 DSI_INST_LOOP_SEL — dsi_inst_loop_sel 0x40 - 0x5c
0x44 DSI_INST_LOOP_NUM
0x48 DSI_INST_JUMP_SEL
{0x4C+8i} DSI_INST_JUMP_CFG[{i}] (i=0..1) — dsi_inst_jump_cfg[2]
0x54 DSI_INST_LOOP_NUM2
0x60 DSI_TRANS_START — dsi_trans_start 0x60 - 0x6c
0x78 DSI_TRANS_ZERO
0x7C DSI_TCON_DRQ
0x80 DSI_PIXEL_CTL0 — dsi_pixel_ctl0 0x80 - 0x8c
0x84 DSI_PIXEL_CTL1
0x90 DSI_PIXEL_PH — dsi_pixel_ph 0x90 - 0x9c
0x94 DSI_PIXEL_PD
0x98 DSI_PIXEL_PF0
0x9C DSI_PIXEL_PF1
0xB0 DSI_SYNC_HSS — dsi_sync_hss 0xb0 - 0xbc
0xB4 DSI_SYNC_HSE
0xB8 DSI_SYNC_VSS
0xBC DSI_SYNC_VSE
0xC0 DSI_BLK_HSA0 — dsi_blk_hsa0 0xc0 - 0xcc
0xC4 DSI_BLK_HSA1
0xC8 DSI_BLK_HBP0
0xCC DSI_BLK_HBP1
0xD0 DSI_BLK_HFP0 — dsi_blk_hfp0 0xd0 - 0xdc
0xD4 DSI_BLK_HFP1
0xE0 DSI_BLK_HBLK0 — dsi_blk_hblk0 0xe0 - 0xec
0xE4 DSI_BLK_HBLK1
0xE8 DSI_BLK_VBLK0
0xEC DSI_BLK_VBLK1
0xF0 DSI_BURST_LINE — dsi_burst_line 0xf0 - 0x1fc
0xF4 DSI_BURST_DRQ
0x200 DSI_CMD_CTL — dsi_cmd_ctl 0x200 - 0x23c
{0x240+0x20*i} DSI_CMD_RX[{i}] (i=0..7) — dsi_cmd_rx[8] 0x240 - 0x2dc
0x2E0 DSI_DEBUG_VIDEO0 — dsi_debug_video0 0x2e0 - 0x2ec
0x2E4 DSI_DEBUG_VIDEO1
0x2F0 DSI_DEBUG_INST — dsi_debug_inst 0x2f0 - 0x2fc
0x2F4 DSI_DEBUG_FIFO
0x2F8 DSI_DEBUG_DATA
{0x300+0x100*i} DSI_CMD_TX[{i}] (i=0..63) — dsi_cmd_tx[64] 0x300 - 0x3fc

## DSI_DPHY — MIPI DSI Physical Interface
Base 0x05451000
0x00 DPHY_GCTL
0x04 DPHY_TX_CTL
0x08 DPHY_RX_CTL
{0x10+4i} DPHY_TX_TIME{i} (i=0..4)
{0x30+4i} DPHY_RX_TIME{i} (i=0..2)
0x40 DPHY_RX_TIME3
{0x4C+4i} DPHY_ANA{i} (i=0..4)
{0x60+4i} DPHY_INT_EN{i} (i=0..2)
{0x70+4i} DPHY_INT_PD{i} (i=0..2)
{0xE0+4i} DPHY_DBG{i} (i=0..5)
{0xF8+4i} DPHY_TX_SKEW_REG{i} (i=0..2)
{0x104+4i} DPHY_PLL_REG{i} (i=0..2)
0x110 COMBO_PHY_REG0 — The TCON LCD0 PHY0 is controlled by COMBO_PHY_REG (reg0x1110, reg0x1114)
0x114 COMBO_PHY_REG1 — The TCON LCD0 PHY0 is controlled by COMBO_PHY_REG (reg0x1110, reg0x1114)
0x118 COMBO_PHY_REG2

## EMAC
Base 0x04500000
0x00 EMAC_BASIC_CTL0 — EMAC Basic Control Register0
0x04 EMAC_BASIC_CTL1 — EMAC Basic Control Register1
0x08 EMAC_INT_STA — EMAC Interrupt Status Register
0x0C EMAC_INT_EN — EMAC Interrupt Enable Register
0x10 EMAC_TX_CTL0 — EMAC Transmit Control Register0
0x14 EMAC_TX_CTL1 — EMAC Transmit Control Register1
0x1C EMAC_TX_FLOW_CTL — EMAC Transmit Flow Control Register
0x20 EMAC_TX_DMA_DESC_LIST — EMAC Transmit Descriptor List Address Register
0x24 EMAC_RX_CTL0 — EMAC Receive Control Register0
0x28 EMAC_RX_CTL1 — EMAC Receive Control Register1
0x34 EMAC_RX_DMA_DESC_LIST — EMAC Receive Descriptor List Address Register
0x38 EMAC_RX_FRM_FLT — EMAC Receive Frame Filter Register
0x40 EMAC_RX_HASH0 — EMAC Hash Table Register0
0x44 EMAC_RX_HASH1 — EMAC Hash Table Register1
0x48 EMAC_MII_CMD — EMAC Management Interface Command Register
0x4C EMAC_MII_DATA — EMAC Management Interface Data Register
{0x50+0x40*i} unnamed[{i}] (i=0..7) group
  0x00 HIGH — EMAC MAC Address High Register
  0x04 LOW — EMAC MAC Address Low Register
0xB0 EMAC_TX_DMA_STA — EMAC Transmit DMA Status Register
0xB4 EMAC_TX_CUR_DESC — EMAC Current Transmit Descriptor Register
0xB8 EMAC_TX_CUR_BUF — EMAC Current Transmit Buffer Address Register
0xC0 EMAC_RX_DMA_STA — EMAC Receive DMA Status Register
0xC4 EMAC_RX_CUR_DESC — EMAC Current Receive Descriptor Register
0xC8 EMAC_RX_CUR_BUF — EMAC Current Receive Buffer Address Register
0xD0 EMAC_RGMII_STA — EMAC RGMII Status Register
