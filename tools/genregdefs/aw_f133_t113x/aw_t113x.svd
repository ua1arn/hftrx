# aw_t113x register map
File version: 1.00
Registers are 32-bit, read-write, reset 0x0 unless marked. A register's access mark holds for its fields unless they carry their own. Offsets are from the block's base; [hi:lo] are bit positions; lines under a group give offsets from that group; {n}, {i} and the like mark numbered series.

## DSI_DPHY — MIPI DSI Physical Interface
Base 0x05451000
0x00 DPHY_GCTL_REG
0x04 DPHY_TX_CTL_REG
0x08 DPHY_RX_CTL_REG
{0x10+4i} DPHY_TX_TIME{i}_REG (i=0..4)
{0x30+4i} DPHY_RX_TIME{i}_REG (i=0..2)
0x40 DPHY_RX_TIME3_REG
{0x4C+4i} DPHY_ANA{i}_REG (i=0..4)
{0x60+4i} DPHY_INT_EN{i}_REG (i=0..2)
{0x70+4i} DPHY_INT_PD{i}_REG (i=0..2)
{0xE0+4i} DPHY_DBG{i}_REG (i=0..5)
{0xF8+4i} DPHY_TX_SKEW_REG{i} (i=0..2)
{0x104+4i} DPHY_PLL_REG{i} (i=0..2)
0x110 COMBO_PHY_REG0 — The TCON LCD0 PHY0 is controlled by COMBO_PHY_REG (reg0x1110, reg0x1114)
0x114 COMBO_PHY_REG1 — The TCON LCD0 PHY0 is controlled by COMBO_PHY_REG (reg0x1110, reg0x1114)
0x118 COMBO_PHY_REG2

## DSP0_CFG
Base 0x01700000
0x00 DSP_ALT_RESET_VEC_REG — DSP Reset Control Register
0x04 DSP_CTRL_REG0 — DSP Control Register0
0x0C DSP_PRID_REG — DSP PRID Register
0x10 DSP_STAT_REG — DSP STAT Register
0x14 DSP_BIST_CTRL_REG — DSP BIST CTRL Register
0x1C DSP_JTRST_REG — DSP JTAG CONFIG RESET Register
0x20 DSP_VER_REG — DSP Version Register

## DSP_INTC — XTensa HiFi4 Interrupt Controller
Base 0x01700800
0x00 VECTOR
0x04 BASE_ADDR
0x0C CONTROL
{0x14+0xC*i} PENDING[{i}] (i=0..2)
{0x40+0xC*i} ENABLE[{i}] (i=0..2)
{0x50+0xC*i} MASK[{i}] (i=0..2)
0x70 FAST_FORCING
{0x80+8i} PRIORITY[{i}] (i=0..1)
{0xC0+0x10*i} GROUP_CONFIG[{i}] (i=0..3)

## EMAC
Base 0x04500000
0x00 EMAC_BASIC_CTL0 — EMAC Basic Control Register0
0x04 EMAC_BASIC_CTL1 — EMAC Basic Control Register1
0x08 EMAC_INT_STA — EMAC Interrupt Status Register
0x0C EMAC_INT_EN — EMAC Interrupt Enable Register
0x10 EMAC_TX_CTL0 — EMAC Transmit Control Register0
0x14 EMAC_TX_CTL1 — EMAC Transmit Control Register1
0x1C EMAC_TX_FLOW_CTL — EMAC Transmit Flow Control Register
0x20 EMAC_TX_DMA_DESC_LIST — EMAC Transmit Descriptor List Address Register
0x24 EMAC_RX_CTL0 — EMAC Receive Control Register0
0x28 EMAC_RX_CTL1 — EMAC Receive Control Register1
0x34 EMAC_RX_DMA_DESC_LIST — EMAC Receive Descriptor List Address Register
0x38 EMAC_RX_FRM_FLT — EMAC Receive Frame Filter Register
0x40 EMAC_RX_HASH0 — EMAC Hash Table Register0
0x44 EMAC_RX_HASH1 — EMAC Hash Table Register1
0x48 EMAC_MII_CMD — EMAC Management Interface Command Register
0x4C EMAC_MII_DATA — EMAC Management Interface Data Register
{0x50+0x40*i} unnamed[{i}] (i=0..7) group
  0x00 HIGH — EMAC MAC Address High Register
  0x04 LOW — EMAC MAC Address Low Register
0xB0 EMAC_TX_DMA_STA — EMAC Transmit DMA Status Register
0xB4 EMAC_TX_CUR_DESC — EMAC Current Transmit Descriptor Register
0xB8 EMAC_TX_CUR_BUF — EMAC Current Transmit Buffer Address Register
0xC0 EMAC_RX_DMA_STA — EMAC Receive DMA Status Register
0xC4 EMAC_RX_CUR_DESC — EMAC Current Receive Descriptor Register
0xC8 EMAC_RX_CUR_BUF — EMAC Current Receive Buffer Address Register
0xD0 EMAC_RGMII_STA — EMAC RGMII Status Register

## G2D_BLD — Graphic 2D (G2D) Engine Blender
Base 0x05410400
0x00 BLD_FILL_COLOR_CTL — BLD_EN_CTL BLD_FILL_COLOR_CTL Allwinner_DE2.0_Spec_V1.0.pdf page 106
{0x10+8i} BLD_FILL_COLOR[{i}] (i=0..1) — BLD_FILLC N=0..1
{0x20+8i} BLD_CH_ISIZE[{i}] (i=0..1) — BLD_CH_ISIZE N=0..1
{0x30+8i} BLD_CH_OFFSET[{i}] (i=0..1) — BLD_CH_OFFSET N=0..1
0x40 BLD_PREMUL_CTL
0x44 BLD_BK_COLOR
0x48 BLD_SIZE
0x4C BLD_CTL
0x50 BLD_KEY_CTL
0x54 BLD_KEY_CON
0x58 BLD_KEY_MAX
0x5C BLD_KEY_MIN
0x60 BLD_OUT_COLOR
0x80 ROP_CTL
{0x84+0x10*i} ROP_INDEX[{i}] (i=0..3) — ROP_INDEX N=0..1 ch3_index0 (tina linux sources has two elements)
0x100 BLD_CSC_CTL
{0x110+0x30*i} BLD_CSC{i}_COEF00 (i=0..2)
{0x114+0x30*i} BLD_CSC{i}_COEF01 (i=0..2)
{0x118+0x30*i} BLD_CSC{i}_COEF02 (i=0..2)
{0x11C+0x30*i} BLD_CSC{i}_CONST0 (i=0..2)
{0x120+0x30*i} BLD_CSC{i}_COEF10 (i=0..2)
{0x124+0x30*i} BLD_CSC{i}_COEF11 (i=0..2)
{0x128+0x30*i} BLD_CSC{i}_COEF12 (i=0..2)
{0x12C+0x30*i} BLD_CSC{i}_CONST1 (i=0..2)
{0x130+0x30*i} BLD_CSC{i}_COEF20 (i=0..2)
{0x134+0x30*i} BLD_CSC{i}_COEF21 (i=0..2)
{0x138+0x30*i} BLD_CSC{i}_COEF22 (i=0..2)
{0x13C+0x30*i} BLD_CSC{i}_CONST2 (i=0..2)
