# aw_t113x register map
File version: 1.00
Registers are 32-bit, read-write, reset 0x0 unless marked. A register's access mark holds for its fields unless they carry their own. Offsets are from the block's base; [hi:lo] are bit positions; {n}, {i} and the like mark numbered series.

## VENCODER — Video Encoding
Base 0x01C0E000
0x00 VE_CTRL — Sub-Engine Select and RAM type select
0x04 VE_RESET — Sub-Engines Reset
0x08 VE_CYCLES_COUNTER — Clock Cycles counter
0x0C VE_TIMEOUT — VE Timeout value
0x10 VE_MMCREQ_WNUM
0x14 VE_CACHEREG_WNUM
0x1C VE_STATUS — Busy status
0x20 VE_RDDATA_COUNTER — DRAM Read counter
0x24 VE_WRDATA_COUNTER — DRAM Write counter
0x28 VE_ANAGLYPH_CTRL — Anaglyph mode control
0x30 VE_MAF_CTRL — Motion adaptive filter config
0x34 VE_MAF_CLIP_TH
0x38 VE_MAFREF1_LUMA_BUF — Reference luma buffer {unsure}
0x3C VE_MAFREF1_CHROMA_BUF — Reference chroma buffer {unsure}
0x40 VE_MAFCUR_ADDR — current maf output address {unsure}
0x44 VE_MAFREF1_ADDR — reference maf input address {unsure}
0x48 VE_MAFREF2_ADDR — second reference maf input address {unsure}
0x4C VE_MAFDIFF_GROUP_MAX
0x50 VE_IPD_DBLK_BUF_CTRL — deblocking and intra prediction dram buffer config register (required for A13+ SoC for H264 decoding or on A10 for video with width >= 2048)
0x54 VE_IPD_BUF — Intra prediction buffer (needed on A13+ or (width >= 2048))
0x58 VE_DBLK_BUF — Deblocking buffer (needed on A13+ or (width >= 2048))
0x5C VE_ARGB_QUEUE_START — ARGB command queue
0x60 VE_ARGB_BLK_SRC1_ADDR — ARGB source 1 address
0x64 VE_ARGB_BLK_SRC2_ADDR — ARGB source 2 addres
0x68 VE_ARGB_BLK_DST_ADDR — ARGB destination address
0x6C VE_ARGB_SRC_STRIDE — ARGB source strides for src1 and src2
0x70 VE_ARGB_DST_STRIDE — ARGB destination stride
0x74 VE_ARGB_BLK_SIZE — ARGB size
0x78 VE_ARGB_BLK_FILL_VALUE — ARGB fill value
0x7C VE_ARGB_BLK_CTRL — ARGB control
{0x80+0x10*i} VE_LUMA_HIST_THR[{i}] (i=0..3) — Luma histogram thresholds [0-3]
{0x90+0x40*i} VE_LUMA_HIST_VAL[{i}] (i=0..15) — Luma histogram output values [0-15]
0xD0 VE_ANGL_R_BUF — Anaglyph red output buffer
0xD4 VE_ANGL_G_BUF — Anaglyph green output buffer
0xD8 VE_ANGL_B_BUF — Anaglyph blue output buffer
0xE8 VE_EXTRA_OUT_FMT_OFFSET — Extra output format and chroma offset (not available on A10/A13/A20)
0xEC VE_OUTPUT_FORMAT — Output formats (since H3?)
0xF0 VE_VERSION — IP Version register
0xF8 VE_DBG_CTRL — Debug control
0xFC VE_DBG_OUTPUT — Debug output
0x100 MPEG_PHDR — MPEG12 Picture Header register
0x104 MPEG_VOPHDR — MPEG Video Object Plane Header register (MPEG4 Header)
0x108 MPEG_SIZE — Frame size in MPEG macroblocks (16x16)
0x10C MPEG_FRAME_SIZE — Frame size in pixels
0x110 MPEG_MBA — MPEG Macro Block Address register
0x114 MPEG_CTRL — MPEG Control Register
0x118 MPEG_TRIG — MPEG Decoding Trigger
0x11C MPEG_STATUS — MACC MPEG Status register
0x120 MPEG_FRAME_DIST — MPEG P and B Frame distance
0x124 MPEG_TRBTRDFLD — Temporal References(TRB(B-VOP) and TRD)
0x128 MPEG_VLD_ADDR — MPEG Variable Length Decoding Address
0x12C MPEG_VLD_OFFSET — MPEG Variable Length Decoding Offset
0x130 MPEG_VLD_LEN — MPEG Variable Length Decoding Length
0x134 MPEG_VBV_END — MPEG VBV end - video source buffer end
0x138 MPEG_MBH_ADDR — MBH buffer address
0x13C MPEG_DCAC_ADDR — DCAC Buffer address
0x140 MPEG_BLK_OFFSET — MPEG Block address???
0x144 MPEG_NCF_ADDR — NFC buffer address
0x148 MPEG_REC_LUMA — MPEG Luma reconstruct buffer
0x14C MPEG_REC_CHROMA — MPEG Chroma reconstruct buffer
0x150 MPEG_FWD_LUMA — MPEG Luma forward buffer
0x154 MPEG_FWD_CHROMA — MPEG forward buffer
0x158 MPEG_BACK_LUMA — MPEG Luma Back buffer
0x15C MPEG_BACK_CHROMA — MPEG Chroma Back buffer
0x160 MPEG_SOCX — MS-MPEG related
0x164 MPEG_SOCY — MS-MPEG related
0x168 MPEG_SOL — MS-MPEG related
0x16C MPEG_SDLX — MS-MPEG related
0x170 MPEG_SDLY — MS-MPEG related
0x174 MPEG_SPRITESHFT — MS-MPEG related
0x178 MPEG_SDCX — MS-MPEG related
0x17C MPEG_SDCY — MS-MPEG related
0x180 MPEG_IQ_MIN_INPUT — MPEG Inverse Quantization minimum input level
0x184 MPEG_IQ_INPUT — MPEG Inverse Quantization input level
0x188 MPEG_MSMPEG4_HDR — MPEG MS-Mpeg-4 header
0x18C MPEG_VP6_HDR — MPEG VP6 Header
0x190 MPEG_IQ_IDCT_INPUT — MPEG Inverse Quantization and Inverse Discrete Cosine Transform input
0x194 MPEG_MB_HEIGHT — MPEG Macro Block Height
{0x194+4i} MPEG_MB_V{i} (i=1..8) — MPEG Macro Block Vector {i}
0x1B8 MPEG_JPEG_SIZE — JPEG Size
0x1BC MPEG_JPEG_MCU — JPEG Minimum Coded Unit
0x1C0 MPEG_JPEG_RES_INT — JPEG Restart Interval
0x1C4 MPEG_ERROR — MPEG Error flags
0x1C8 MPEG_CTR_MB — (Macroblock Control??)
0x1CC MPEG_ROT_LUMA — MPEG Rotate-Scale Luma buffer
0x1D0 MPEG_ROT_CHROMA — MPEG Rotate-Scale Chroma buffer
0x1D4 MPEG_ROTSCALE_CTRL — Control Rotate/Scale Buffer
0x1D8 MPEG_JPEG_MCU_START — JPEG Macro Cell Unit Start
0x1DC MPEG_JPEG_MCU_END — JPEG Macro Cell Unit End
0x1E0 MPEG_SRAM_RW_OFFSET — Auto incremental pointer for read/write VE SRAM
0x1E4 MPEG_SRAM_RW_DATA — FIFO Like Data register for write/read VE SRAM
0x1F0 MPEG_START_CODE_BITOFFSET — MPEG start code search result
0x200 H264_SEQ_HDR — H264 Sequence header
0x204 H264_PIC_HDR — H264 Picture header
0x208 H264_SLICE_HDR — H264 Slice header
0x20C H264_SLICE_HDR2 — H264 Slice header
0x210 H264_PRED_WEIGHT — H264 weighted prediction parameters
0x214 H264_VP8_HDR — H264 VP8 Picture header
0x218 H264_QINDEX — H264 Quantizer settings (VP8)
0x21C H264_VP8_PART_OFFSET_H264_QP — H264 QP parameters (VP8 partition offset)
0x220 H264_CTRL — H264 Control Register
0x224 H264_TRIG — H264 Trigger Register
0x228 H264_STATUS
0x22C H264_CUR_MBNUM — H264 current Macroblock
0x230 H264_VLD_ADDR — H264 Variable Length Decoder Address
0x234 H264_VLD_OFFSET — H264 Variable Length Decoder Bit Offset
0x238 H264_VLD_LEN — H264 Variable Length Decoder Bit Length
0x23C H264_VLD_END — H264 Variable Length Decoder End Address
0x240 H264_SDROT_CTRL — H264 Scale Rotate buffer control
0x244 H264_SDROT_LUMA — H264 Scale Rotate buffer Luma color component
0x248 H264_SDROT_CHROMA — H264 Scale Rotate buffer Chroma color component
0x24C H264_OUTPUT_FRAME_INDEX — H264 output frame index in dpb
0x250 H264_FIELD_INTRA_INFO_BUF_H264_VP8_ENTROPY_PROBS — H264 field intra info buffer address (VP8 entropy brobabilities table address)
0x254 H264_NEIGHBOR_INFO_BUF_H264_VP8_FSTDATA_PARTLEN — H264 neighbor info buffer address (VP8 First partition length)
0x258 H264_PIC_MBSIZE — H264 Picture size in macroblocks
0x25C H264_PIC_BOUNDARYSIZE — H264 Picture size in pixels
0x260 H264_MB_ADDR — H264 Current macroblock position
0x264 H264_MB_NB1 — H264 ??? MbNeightbour1
0x268 H264_MB_NB2 — H264 MbNeightbour2
{0x260+4i} H264_MB_NB{i} (i=3..8) — H264 ???
0x284 H264_0x0284 — H264 ???
0x288 H264_0x0288 — H264 ???
0x28C H264_0x028c — H264 ???
0x290 H264_MB_QP — H264 ???
0x294 H264_0x0294 — H264 ???
0x298 H264_0x0298 — H264 ???
0x29C H264_0x029c — H264 ???
0x2A0 H264_0x02a0 — H264 ???
0x2A4 H264_0x02a4 — H264 ???
0x2A8 H264_0x02a8 — H264 ???
0x2AC H264_REC_LUMA — H264 Luma reconstruct buffer
0x2B0 H264_FWD_LUMA — H264 Luma forward buffer
0x2B4 H264_BACK_LUMA — H264 Luma back buffer
0x2B8 H264_ERROR
0x2BC H264_0x02bc — H264 ???
0x2C0 H264_0x02c0 — H264 ???
0x2C4 H264_0x02c4 — H264 ???
0x2C8 H264_0x02c8 — H264 ???
0x2CC H264_0x02cc — H264 ???
0x2D0 H264_REC_CHROMA — H264 Chroma reconstruct buffer
0x2D4 H264_FWD_CHROMA — H264 Chroma forward buffer
0x2D8 H264_BACK_CHROMA — H264 Chroma back buffer
0x2DC H264_BASIC_BITS_DATA
0x2E0 H264_RAM_WRITE_PTR — H264 ram write pointer
0x2E4 H264_RAM_WRITE_DATA
0x2E8 H264_ALT_LUMA — H264 Alternate Luma buffer
0x2EC H264_ALT_CHROMA — H264 Alternate Chroma buffer
0x2F0 H264_SEG_MB_LV0 — H264 ??? Segment Mb Level 0
0x2F4 H264_SEG_MB_LV1 — H264 ??? Segment Mb Level 1
0x2F8 H264_REF_LF_DELTA — H264 ??? (VP8 ref lf deltas)
0x2FC H264_MODE_LF_DELTA — H264 ??? (VP8 mode lf deltas)
0x300 VC1_EPHS — VC1 ???
0x304 VC1_PIC_CTRL — VC1 ???
0x308 VC1_PIC_QP — VC1 ???
0x30C VC1_PIC_MV — VC1 ???
0x310 VC1_PIC_INTEN_COMP — VC1 ???
0x314 VC1_PIC_INTERLANCE — VC1 ???
0x318 VC1_HDR_LEN — VC1 ???
0x31C VC1_FSIZE — VC1 ???
0x320 VC1_PIC_SIZE — VC1 ???
0x324 VC1_CTRL — VC1 Decoder Control
0x328 VC1_START_TYPE — VC1 ???
0x32C VC1_STATUS
0x330 VC1_VBV_BASE_ADDR — VC1 Source buffer address
0x334 VC1_VLD_OFFSET — VC1 Variable Length Decoder Offset
0x338 VC1_VBV_LEN — VC1 length of source video buffer
0x33C VC1_VBV_END_ADDR — VC1 last address of source video buffer
0x340 VC1_REC_FRAME_CHROMA — VC1 Chroma Reconstruct frame
0x344 VC1_REC_FRAME_LUMA — VC1 Luma Reconstruct frame
0x348 VC1_FWD_FRAME_CHROMA — VC1 Chroma Forward Frame
0x34C VC1_FWD_FRAME_LUMA — VC1 Luma Forward Frame
0x350 VC1_BACK_CHROMA — VC1 Chroma back buffer
0x354 VC1_BACK_LUMA — VC1 Luma back buffer
0x358 VC1_MBHADDR — VC1 ???
0x35C VC1_DCAPRED_ADDR — VC1 ???
0x360 VC1_BITPLANE_ADDR — VC1 ???
0x364 VC1_MBINFO_ADDR — VC1 ???(or COLMVINFOADDR)
0x368 VC1_0x0368 — VC1 ???
0x36C VC1_0x036c — VC1 ???
0x370 VC1_MBA — VC1 ???
0x374 VC1_MBHDR — VC1 ???
0x378 VC1_LUMA_TRANSFORM — VC1 ???
0x37C VC1_MBCBF — VC1 ???
{0x37C+4i} VC1_MBM_V{i} (i=1..8) — VC1 ???
0x3A0 VC1_0x03a0 — VC1 ???
0x3A4 VC1_0x03a4 — VC1 ???
0x3A8 VC1_0x03a8 — VC1 ???
0x3AC VC1_0x03ac — VC1 ???
0x3B0 VC1_0x03b0 — VC1 ???
0x3B4 VC1_0x03b4 — VC1 ???
0x3B8 VC1_ERROR — VC1 Error result code
0x3BC VC1_CRT_MB_NUM — VC1 ???
0x3C0 VC1_EXTRA_CTRL — VC1 ???
0x3C4 VC1_EXTRA_CBUF_ADDR — VC1 EXTRA Chroma DRAM address
0x3C8 VC1_EXTRA_YBUF_ADDR — VC1 EXTRA Luma DRAM address
0x3D0 VC1_OVERLAP_UP_ADDR — VC1 ???
0x3D4 VC1_DBLK_ABOVE_ADDR — VC1 ???
0x3D8 VC1_0x03d8 — VC1 ???
0x3DC VC1_BITS_RETDATA — VC1 ???
0x3FC VC1_DEBUG_BUF_ADDR — VC1 ???
0x400 RMVB_SLC_HDR — Header
0x404 RMVB_FRM_SIZE — Framesize (in macroblocks ?)
0x408 RMVB_DIR_MODE_RATIO
0x40C RMVB_DIR_MB_ADDR
0x410 RMVB_QC_INPUT
0x414 RMVB_CTRL — RMVB IRQ Control
0x418 RMVB_TRIG — Trigger register
0x41C RMVB_STATUS
0x428 RMVB_VBV_BASE — Video source buffer base
0x42C RMVB_VLD_OFFSET — Video source buffer DRAM address
0x430 RMVB_VLD_LEN — Video source buffer length in bytes
0x434 RMVB_VBV_END — Video source buffer last DRAM address
0x43C RMVB_HUFF_TABLE_ADDR — Huffman table DRAM address
0x440 RMVB_CUR_Y_ADDR — Luma Current buffer DRAM address
0x444 RMVB_CUR_C_ADDR — Chroma Current buffer DRAM address
0x448 RMVB_FOR_Y_ADDR — Luma Forward buffer DRAM address
0x44C RMVB_FOR_C_ADDR — Chroma Forward buffer DRAM address
0x450 RMVB_BAC_Y_ADDR — Luma Back buffer DRAM address
0x454 RMVB_BAC_C_ADDR — Chroma Back buffer DRAM address
0x458 RMVB_ROT_Y_ADDR — Luma Rot buffer DRAM address
0x45C RMVB_ROT_C_ADDR — Chroma Rot Buffer DRAM address
0x460 RMVB_MBH_ADDR
0x464 RMVB_MV_ADDR
0x470 RMVB_MBH_INFO
{0x474+4i} RMVB_MV{i} (i=0..3) — Mountion vector {i}
0x490 RMVB_DBLK_COEF
0x4B0 RMVB_ERROR — Decode error result code
0x4B8 RMVB_BITS_DATA
0x4C0 RMVB_SLC_QUEUE_ADDR
0x4C4 RMVB_SLC_QUEUE_LEN
0x4C8 RMVB_SLC_QUEUE_TRIG
0x4CC RMVB_SLC_QUEUE_STATUS
0x4D0 RMVB_SCALE_ROT_CTRL
0x4E0 RMVB_SRAM_RW_OFFSET — SRAM Fifo like index register
0x4E4 RMVB_SRAM_RW_DATA — SRAM Fifo like data register
0x500 HEVC_NAL_HDR — HEVC NAL header
0x504 HEVC_SPS — HEVC sequence parameter set
0x508 HEVC_PIC_SIZE — HEVC picture size
0x50C HEVC_PCM_HDR — HEVC PCM header
0x510 HEVC_PPS0 — HEVC picture parameter set
0x514 HEVC_PPS1 — HEVC picture parameter set
0x518 HEVC_SCALING_LIST_CTRL — HEVC scaling list control register
{0x520+4i} HEVC_SLICE_HDR{i} (i=0..2) — HEVC slice header
0x52C HEVC_CTB_ADDR — HEVC CTB address
0x530 HEVC_CTRL — HEVC control register
0x534 HEVC_TRIG — HEVC trigger register
0x538 HEVC_STATUS
0x53C HEVC_CTU_NUM — HEVC current CTU number
0x540 HEVC_BITS_ADDR — HEVC bitstream address
0x544 HEVC_BITS_OFFSET — HEVC bitstream offset
0x548 HEVC_BITS_LEN — HEVC bitstream length
0x54C HEVC_BITS_END_ADDR — HEVC bitstream end address
0x550 HEVC_EXTRA_OUT_CTRL — HEVC extra output control register
0x554 HEVC_EXTRA_OUT_LUMA_ADDR — HEVC extra output luma address
0x558 HEVC_EXTRA_OUT_CHROMA_ADDR — HEVC extra output chroma address
0x55C HEVC_REC_BUF_IDX — HEVC reconstruct buffer index
0x560 HEVC_NEIGHBOR_INFO_ADDR — HEVC neighbor info buffer address
0x564 HEVC_TILE_LIST_ADDR — HEVC tile entry point list address
0x568 HEVC_TILE_START_CTB
0x56C HEVC_TILE_END_CTB
0x578 HEVC_SCALING_LIST_DC_COEF0 — HEVC scaling list DC coefficients
0x57C HEVC_SCALING_LIST_DC_COEF1 — HEVC scaling list DC coefficients
0x5DC HEVC_BITS_DATA — HEVC bitstream data
0x5E0 HEVC_SRAM_ADDR — HEVC SRAM address
0x5E4 HEVC_SRAM_DATA
0xA00 ISP_PIC_SIZE — ISP source picture size in macroblocks (16x16)
0xA04 ISP_PIC_STRIDE — ISP source picture stride
0xA08 ISP_CTRL — ISP IRQ Control
0xA0C ISP_TRIG — ISP Trigger
0xA2C ISP_SCALER_SIZE — ISP scaler frame size/16
0xA30 ISP_SCALER_OFFSET_Y — ISP scaler picture offset for luma
0xA34 ISP_SCALER_OFFSET_C — ISP scaler picture offset for chroma
0xA38 ISP_SCALER_FACTOR — ISP scaler picture scale factor
0xA44 ISP_BUF_0x0a44 — ISP PHY Buffer offset
0xA48 ISP_BUF_0x0a48 — ISP PHY Buffer offset
0xA4C ISP_BUF_0x0a4C — ISP PHY Buffer offset
0xA70 ISP_OUTPUT_LUMA — ISP Output LUMA Address
0xA74 ISP_OUTPUT_CHROMA — ISP Output CHROMA Address
0xA78 ISP_WB_THUMB_LUMA — ISP THUMB WriteBack PHY LUMA Address
0xA7C ISP_WB_THUMB_CHROMA — ISP THUMB WriteBack PHY CHROMA Adress
0xAE0 ISP_SRAM_INDEX — ISP VE SRAM Index
0xAE4 ISP_SRAM_DATA — ISP VE SRAM Data
0xB00 AVC_PICINFO — unk(not used in blob)
0xB04 AVC_JPEG_CTRL_MACC_AVC_H264_CTRL — jpeg / h264 different settings
0xB08 AVC_H264_QP — H264 quantization parameters
0xB10 AVC_H264_MOTION_EST — Motion estimation parameters
0xB14 AVC_CTRL — AVC Encoder IRQ Control
0xB18 AVC_TRIG — AVC Encoder trigger
0xB1C AVC_STATUS — AVC Encoder Busy Status
0xB20 AVC_BITS_DATA — AVC Encoder Bits Data
0xB50 AVC_H264_MAD — AVC H264 Encoder Mean Absolute Difference
0xB54 AVC_H264_RESIDUAL_BITS — AVC H264 Encoder Residual Bits
0xB58 AVC_H264_HEADER_BITS — AVC H264 Encoder Header Bits
0xB5C AVC_H264_0x0b5c — AVC H264 Encoder unknown statistical data, maybe motion vectors
0xB60 AVC_H264_0x0b60 — AVC H264 Encoder unknown buffer
0xB80 AVC_VLE_ADDR — AVC Variable Length Encoder Start Address
0xB84 AVC_VLE_END — AVC Variable Length Encoder End Address
0xB88 AVC_VLE_OFFSET — AVC Variable Length Encoder Bit Offset
0xB8C AVC_VLE_MAX — AVC Variable Length Encoder Maximum Bits
0xB90 AVC_VLE_LENGTH — AVC Variable Length Encoder Bit Length
0xBA0 AVC_REF_LUMA — Luma reference buffer
0xBA4 AVC_REF_CHROMA — Chroma reference buffer
0xBB0 AVC_REC_LUMA — Luma reconstruct buffer
0xBB4 AVC_REC_CHROMA — Chroma reconstruct buffer
0xBB8 AVC_REF_SLUMA — Smaller luma reference buffer ?
0xBBC AVC_REC_SLUMA — Smaller luma reconstruct buffer ?
0xBC0 AVC_MB_INFO — Temporary buffer with macroblock information
0xBE0 AVC_SRAM_INDEX — AVC VE SRAM Index
0xBE4 AVC_SRAM_DATA — AVC VE SRAM Data
