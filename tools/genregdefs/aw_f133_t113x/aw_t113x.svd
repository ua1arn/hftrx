# aw_t113x register map
File version: 1.00
Registers are 32-bit, read-write, reset 0x0 unless marked. A register's access mark holds for its fields unless they carry their own. Offsets are from the block's base; [hi:lo] are bit positions; lines under a group give offsets from that group; {n}, {i} and the like mark numbered series.

## PWM — Pulse Width Modulation module
Base 0x02000C00
0x00 PIER — PWM IRQ Enable Register
0x04 PISR — PWM IRQ Status Register
0x10 CIER — Capture IRQ Enable Register
0x14 CISR — Capture IRQ Status Register
{0x20+0x10*i} PCCR[{i}] (i=0..3) — PWM01, PWM23, PWM45, PWM67 Clock Configuration Register
0x40 PCGR — PWM Clock Gating Register
{0x60+0x10*i} PDZCR[{i}] (i=0..3) — PWM01, PWM23, PWM45, PWM67 Dead Zone Control Register
0x80 PER — PWM Enable Register
{0x90+0x10*i} PGR0[{i}] (i=0..3) — PWM Group0, Group1, Group2, Group3 Register
0xC0 CER — Capture Enable Register
{0x100+0x100*i} unnamed[{i}] (i=0..7) group
  0x00 PCR — PWM Control Register
  0x04 PPR — PWM Period Register
  0x08 PCNTR — PWM Count Register
  0x0C PPCNTR — PWM Pulse Count Register
  0x10 CCR — Capture Control Register
  0x14 CRLR — Capture Rise Lock Register
  0x18 CFLR — Capture Fall Lock Register

## RISC_CFG — RISC-V core configuration register
Base 0x06010000
0x04 RISC_STA_ADD0_REG — RISC Start Address0 Register
0x08 RISC_STA_ADD1_REG — RISC Start Address1 Register
0x10 RF1P_CFG_REG — RF1P Configuration Register
0x1C ROM_CFG_REG — ROM Configuration Register
0x20 WAKEUP_EN_REG — Wakeup Enable Register
{0x24+0x14*i} WAKEUP_MASK_REG[{i}] (i=0..4) — Wakeup Mask0..Mask4 Register
0x40 TS_TMODE_SEL_REG — Timestamp Test Mode Select Register
0x44 SRAM_ADDR_TWIST_REG — SRAM Address Twist Register
0x48 WORK_MODE_REG — Work Mode Register
0x50 RETITE_PC0_REG — Retire PC0 Register
0x54 RETITE_PC1_REG — Retire PC1 Register
{0x60+0x14*i} IRQ_MODE_REG[{i}] (i=0..4) — IRQ Mode0..Mode4 Register
0x104 RISC_AXI_PMU_CTRL — RISC AXI PMU Control Register
0x108 RISC_AXI_PMU_PRD — RISC AXI PMU Period Register
0x10C RISC_AXI_PMU_LAT_RD — RISC AXI PMU Read Latency Register
0x110 RISC_AXI_PMU_LAT_WR — RISC AXI PMU Write Latency Register
0x114 RISC_AXI_PMU_REQ_RD — RISC AXI PMU Read Request Register
0x118 RISC_AXI_PMU_REQ_WR — RISC AXI PMU Write Request Register
0x11C RISC_AXI_PMU_BW_RD — RISC AXI PMU Read Bandwidth Register
0x120 RISC_AXI_PMU_BW_WR — RISC AXI PMU Write Bandwidth Register

## RTC — Real Time Clock
Base 0x07090000
0x00 LOSC_CTRL_REG — Low Oscillator Control Register
0x04 LOSC_AUTO_SWT_STA_REG — Low Oscillator Auto Switch Status Register
0x08 INTOSC_CLK_PRESCAL_REG — Internal OSC Clock Pre-scaler Register
0x10 RTC_DAY_REG — RTC Year-Month-Day Register
0x14 RTC_HH_MM_SS_REG — RTC Hour-Minute-Second Register
0x20 ALARM0_DAY_SET_REG — Alarm 0 Day Setting Register
0x24 ALARM0_CUR_VLU_REG — Alarm 0 Counter Current Value Register
0x28 ALARM0_ENABLE_REG — Alarm 0 Enable Register
0x2C ALARM0_IRQ_EN — Alarm 0 IRQ Enable Register
0x30 ALARM0_IRQ_STA_REG — Alarm 0 IRQ Status Register
0x50 ALARM_CONFIG_REG — Alarm Configuration Register
0x60 F32K_FOUT_CTRL_GATING_REG — 32K Fanout Control Gating Register
{0x100+0x20*i} GP_DATA_REG[{i}] (i=0..7) — General Purpose Register (N=0 to 7)
0x120 FBOOT_INFO_REG0 — Fast Boot Information Register0
0x124 FBOOT_INFO_REG1 — Fast Boot Information Register1
0x160 DCXO_CTRL_REG — DCXO Control Register
0x190 RTC_VIO_REG — RTC_VIO Regulation Register
0x1F0 IC_CHARA_REG — IC Characteristic Register
0x1F4 VDD_OFF_GATING_CTRL_REG — VDD Off Gating Control Register
0x204 EFUSE_HV_PWRSWT_CTRL_REG — Efuse High Voltage Power Switch Control Register
0x310 RTC_SPI_CLK_CTRL_REG — RTC SPI Clock Control Register

## R_CPUCFG
Base 0x07000400
0x00 REGxx — Bit 31 and bit 0 R/W, bit 0 can be related to RISC-C vore
0x1C0 HOTPLUGFLAG — The Hotplug Flag Register is 0x070005C0.
{0x1C4+0x10*i} SOFTENTRY[{i}] (i=0..3) — The Soft Entry Address Register of CPUx (x=0..1)
0x1D4 SUP_STAN_FLAG — Super Standby Flag (bit 16)
0x1DC RV_HOTPLUGFLAG — RV The Hotplug Flag Register (key value 0xFA50392F)
{0x1E0+0x10*i} RC_SOFTENTRY[{i}] (i=0..3) — RV The Soft Entry Address Register
