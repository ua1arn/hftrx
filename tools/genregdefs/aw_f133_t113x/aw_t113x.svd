# aw_t113x register map
File version: 1.00
Registers are 32-bit, read-write, reset 0x0 unless marked. A register's access mark holds for its fields unless they carry their own. Offsets are from the block's base; [hi:lo] are bit positions; lines under a group give offsets from that group; {n}, {i} and the like mark numbered series.

## THS — Thermal Sensor
Base 0x02009400
0x00 THS_CTRL — THS Control Register
0x04 THS_EN — THS Enable Register
0x08 THS_PER — THS Period Control Register
0x10 THS_DATA_INTC — THS Data Interrupt Control Register
0x14 THS_SHUT_INTC — THS Shut Interrupt Control Register
0x18 THS_ALARM_INTC — THS Alarm Interrupt Control Register
0x20 THS_DATA_INTS — THS Data Interrupt Status Register
0x24 THS_SHUT_INTS — THS Shut Interrupt Status Register
0x28 THS_ALARMO_INTS — THS Alarm off Interrupt Status Register
0x2C THS_ALARM_INTS — THS Alarm Interrupt Status Register
0x30 THS_FILTER — THS Median Filter Control Register
0x40 THS_ALARM_CTRL — THS Alarm Threshold Control Register
0x80 THS_SHUTDOWN_CTRL — THS Shutdown Threshold Control Register
0xA0 THS_CDATA — THS Calibration Data
0xC0 THS_DATA

## TIMER
Base 0x02050000
0x00 TMR_IRQ_EN_REG — Timer IRQ Enable Register
0x04 TMR_IRQ_STA_REG — Timer Status Register
{0x10+0x20*i} unnamed[{i}] (i=0..1) group
  0x00 CTRL_REG — Timer n Control Register
  0x04 INTV_VALUE_REG — Timer n Interval Value Register
  0x08 CUR_VALUE_REG — Timer n Current Value Register
0xA0 WDOG_IRQ_EN_REG — Watchdog IRQ Enable Register
0xA4 WDOG_IRQ_STA_REG — Watchdog Status Register
0xA8 WDOG_SOFT_RST_REG — Watchdog Software Reset Register
0xB0 WDOG_CTRL_REG — Watchdog Control Register
0xB4 WDOG_CFG_REG — Watchdog Configuration Register
0xB8 WDOG_MODE_REG — Watchdog Mode Register
0xBC WDOG_OUTPUT_CFG_REG — Watchdog Output Configuration Register
0xC0 AVS_CNT_CTL_REG — AVS Control Register
0xC4 AVS_CNT0_REG — AVS Counter 0 Register
0xC8 AVS_CNT1_REG — AVS Counter 1 Register
0xCC AVS_CNT_DIV_REG — AVS Divisor Register

## TIMESTAMP_CTRL
Base 0x08120000
0x00 TSTAMP_CTRL_REG — Timestamp Control Register
0x08 CNT_CTRL_LOW_REG — Counter Low Register
0x0C CNT_CTRL_HI_REG — Counter High Register
0x20 CNT_FREQID_REG — Counter Base Frequency ID Register

## TIMESTAMP_STA
Base 0x08110000
0x00 CNT_LOW_REG — Counter Low Register
0x04 CNT_HI_REG — Counter High Register

## TPADC
Base 0x02009C00
{0x0+4i} TP_CTRL_REG{i} (i=0..3) — TP Control Register {i}
0x10 TP_INT_FIFO_CTRL_REG — TP Interrupt FIFO Control Register
0x14 TP_INT_FIFO_STAT_REG — TP Interrupt FIFO Status Register
0x1C TP_CALI_DATA_REG — TP Calibration Data Register
0x24 TP_DATA_REG — TP Data Register

## TVD0 — Video Decoding
Base 0x05C01000
0x00 TVD_EN — TVD MODULE CONTROL Register
0x04 TVD_MODE — TVD MODE CONTROL Register
0x08 TVD_CLAMP_AGC1 — TVD CLAMP & AGC CONTROL Register1
0x0C TVD_CLAMP_AGC2 — TVD CLAMP & AGC CONTROL Register2
{0xC+4i} TVD_HLOCK{i} (i=1..5) — TVD HLOCK CONTROL Register{i}
0x24 TVD_VLOCK1 — TVD VLOCK CONTROL Register1
0x28 TVD_VLOCK2 — TVD VLOCK CONTROL Register2
0x30 TVD_CLOCK1 — TVD CHROMA LOCK CONTROL Register1
0x34 TVD_CLOCK2 — TVD CHROMA LOCK CONTROL Register2
0x40 TVD_YC_SEP1 — TVD YC SEPERATION CONROL Register1
0x44 TVD_YC_SEP2 — TVD YC SEPERATION CONROL Register2
{0x4C+4i} TVD_ENHANCE{i} (i=1..3) — TVD ENHANCEMENT CONTROL Register{i}
{0x5C+4i} TVD_WB{i} (i=1..4) — TVD WB DMA CONTROL Register{i}
0x80 TVD_IRQ_CTL — TVD DMA Interrupt Control Register
0x90 TVD_IRQ_STATUS — TVD DMA Interrupt Status Register
0x100 TVD_DEBUG1 — TVD DEBUG CONTROL Register1
{0x17C+4i} TVD_STATUS{i} (i=1..6) — TVD DEBUG STATUS Register{i}

## TVD_TOP — Video Decoding
Base 0x05C00000
0x00 TVD_TOP_MAP
{0x4+4i} TVD_3D_CTL{i} (i=1..5) — TVD 3D DMA CONTROL Register{i}
{0x20+0x80*i} unnamed[{i}] (i=0..3) group
  0x04 TVD_TOP_CTL — TVD TOP CONTROL Register
  0x08 TVD_ADC_CTL — TVD ADC CONTROL Register
  0x0C TVD_ADC_CFG — TVD ADC CONFIGURATION Register

## TVE_TOP — TV Output TV Encoder (display out interface = CVBS OUT)
Base 0x05600000
0x20 TVE_DAC_MAP — TV Encoder DAC MAP Register
0x24 TVE_DAC_STATUS — TV Encoder DAC STAUTS Register
{0x28+0x20*i} unnamed[{i}] (i=0..0) group
  {0x0+4j} TVE_DAC_CFG{j} (j=0..3) — TV Encoder DAC CFG{j} Register
0xF0 TVE_DAC_TEST — TV Encoder DAC TEST Register
