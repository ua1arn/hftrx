# aw_t113x register map
File version: 1.00
Registers are 32-bit, read-write, reset 0x0 unless marked. A register's access mark holds for its fields unless they carry their own. Offsets are from the block's base; [hi:lo] are bit positions; {n}, {i} and the like mark numbered series.

## HDMI_TX0
Base 0x05500000
0x00 HDMI_DESIGN_ID 8-bit
0x01 HDMI_REVISION_ID 8-bit
0x02 HDMI_PRODUCT_ID0 8-bit
0x03 HDMI_PRODUCT_ID1 8-bit
{0x4+i} HDMI_CONFIG{i}_ID 8-bit (i=0..3)
{0x100+i} HDMI_IH_FC_STAT{i} 8-bit (i=0..2)
0x103 HDMI_IH_AS_STAT0 8-bit
0x104 HDMI_IH_PHY_STAT0 8-bit
0x105 HDMI_IH_I2CM_STAT0 8-bit
0x106 HDMI_IH_CEC_STAT0 8-bit
0x107 HDMI_IH_VP_STAT0 8-bit
0x108 HDMI_IH_I2CMPHY_STAT0 8-bit
0x109 HDMI_IH_AHBDMAAUD_STAT0 8-bit
{0x180+i} HDMI_IH_MUTE_FC_STAT{i} 8-bit (i=0..2)
0x183 HDMI_IH_MUTE_AS_STAT0 8-bit
0x184 HDMI_IH_MUTE_PHY_STAT0 8-bit
0x185 HDMI_IH_MUTE_I2CM_STAT0 8-bit
0x186 HDMI_IH_MUTE_CEC_STAT0 8-bit
0x187 HDMI_IH_MUTE_VP_STAT0 8-bit
0x188 HDMI_IH_MUTE_I2CMPHY_STAT0 8-bit
0x189 HDMI_IH_MUTE_AHBDMAAUD_STAT0 8-bit
0x1FF HDMI_IH_MUTE 8-bit
0x200 HDMI_TX_INVID0 8-bit
0x201 HDMI_TX_INSTUFFING 8-bit
0x202 HDMI_TX_GYDATA0 8-bit
0x203 HDMI_TX_GYDATA1 8-bit
0x204 HDMI_TX_RCRDATA0 8-bit
0x205 HDMI_TX_RCRDATA1 8-bit
0x206 HDMI_TX_BCBDATA0 8-bit
0x207 HDMI_TX_BCBDATA1 8-bit
0x800 HDMI_VP_STATUS 8-bit
0x801 HDMI_VP_PR_CD 8-bit
0x802 HDMI_VP_STUFF 8-bit
0x803 HDMI_VP_REMAP 8-bit
0x804 HDMI_VP_CONF 8-bit
0x805 HDMI_VP_STAT 8-bit
0x806 HDMI_VP_INT 8-bit
0x807 HDMI_VP_MASK 8-bit
0x808 HDMI_VP_POL 8-bit
0x1000 HDMI_FC_INVIDCONF 8-bit
0x1001 HDMI_FC_INHACTV0 8-bit
0x1002 HDMI_FC_INHACTV1 8-bit
0x1003 HDMI_FC_INHBLANK0 8-bit
0x1004 HDMI_FC_INHBLANK1 8-bit
0x1005 HDMI_FC_INVACTV0 8-bit
0x1006 HDMI_FC_INVACTV1 8-bit
0x1007 HDMI_FC_INVBLANK 8-bit
0x1008 HDMI_FC_HSYNCINDELAY0 8-bit
0x1009 HDMI_FC_HSYNCINDELAY1 8-bit
0x100A HDMI_FC_HSYNCINWIDTH0 8-bit
0x100B HDMI_FC_HSYNCINWIDTH1 8-bit
0x100C HDMI_FC_VSYNCINDELAY 8-bit
0x100D HDMI_FC_VSYNCINWIDTH 8-bit
{0x100E+i} HDMI_FC_INFREQ{i} 8-bit (i=0..2)
0x1011 HDMI_FC_CTRLDUR 8-bit
0x1012 HDMI_FC_EXCTRLDUR 8-bit
0x1013 HDMI_FC_EXCTRLSPAC 8-bit
{0x1014+i} HDMI_FC_CH{i}PREAM 8-bit (i=0..2)
0x1017 HDMI_FC_AVICONF3 8-bit
0x1018 HDMI_FC_GCP 8-bit
{0x1019+i} HDMI_FC_AVICONF{i} 8-bit (i=0..2)
0x101C HDMI_FC_AVIVID 8-bit
0x101D HDMI_FC_AVIETB0 8-bit
0x101E HDMI_FC_AVIETB1 8-bit
0x101F HDMI_FC_AVISBB0 8-bit
0x1020 HDMI_FC_AVISBB1 8-bit
0x1021 HDMI_FC_AVIELB0 8-bit
0x1022 HDMI_FC_AVIELB1 8-bit
0x1023 HDMI_FC_AVISRB0 8-bit
0x1024 HDMI_FC_AVISRB1 8-bit
{0x1025+i} HDMI_FC_AUDICONF{i} 8-bit (i=0..3)
0x1029 HDMI_FC_VSDIEEEID0 8-bit
0x102A HDMI_FC_VSDSIZE 8-bit
0x1030 HDMI_FC_VSDIEEEID1 8-bit
0x1031 HDMI_FC_VSDIEEEID2 8-bit
{0x1032+i} HDMI_FC_VSDPAYLOAD{i} 8-bit (i=0..23)
{0x104A+i} HDMI_FC_SPDVENDORNAME{i} 8-bit (i=0..7)
{0x1052+i} HDMI_FC_SDPPRODUCTNAME{i} 8-bit (i=0..14)
0x1061 HDMI_FC_SPDPRODUCTNAME15 8-bit
0x1062 HDMI_FC_SPDDEVICEINF 8-bit
0x1063 HDMI_FC_AUDSCONF 8-bit
0x1064 HDMI_FC_AUDSSTAT 8-bit
{0x1070+i} HDMI_FC_DATACH{i}FILL 8-bit (i=0..2)
0x1073 HDMI_FC_CTRLQHIGH 8-bit
0x1074 HDMI_FC_CTRLQLOW 8-bit
0x1075 HDMI_FC_ACP0 8-bit
0x1076 HDMI_FC_ACP28 8-bit
0x1077 HDMI_FC_ACP27 8-bit
0x1078 HDMI_FC_ACP26 8-bit
0x1079 HDMI_FC_ACP25 8-bit
0x107A HDMI_FC_ACP24 8-bit
0x107B HDMI_FC_ACP23 8-bit
0x107C HDMI_FC_ACP22 8-bit
0x107D HDMI_FC_ACP21 8-bit
0x107E HDMI_FC_ACP20 8-bit
0x107F HDMI_FC_ACP19 8-bit
0x1080 HDMI_FC_ACP18 8-bit
0x1081 HDMI_FC_ACP17 8-bit
0x1082 HDMI_FC_ACP16 8-bit
0x1083 HDMI_FC_ACP15 8-bit
0x1084 HDMI_FC_ACP14 8-bit
0x1085 HDMI_FC_ACP13 8-bit
0x1086 HDMI_FC_ACP12 8-bit
0x1087 HDMI_FC_ACP11 8-bit
0x1088 HDMI_FC_ACP10 8-bit
0x1089 HDMI_FC_ACP9 8-bit
0x108A HDMI_FC_ACP8 8-bit
0x108B HDMI_FC_ACP7 8-bit
0x108C HDMI_FC_ACP6 8-bit
0x108D HDMI_FC_ACP5 8-bit
0x108E HDMI_FC_ACP4 8-bit
0x108F HDMI_FC_ACP3 8-bit
0x1090 HDMI_FC_ACP2 8-bit
0x1091 HDMI_FC_ACP1 8-bit
0x1092 HDMI_FC_ISCR1_0 8-bit
0x1093 HDMI_FC_ISCR1_16 8-bit
0x1094 HDMI_FC_ISCR1_15 8-bit
0x1095 HDMI_FC_ISCR1_14 8-bit
0x1096 HDMI_FC_ISCR1_13 8-bit
0x1097 HDMI_FC_ISCR1_12 8-bit
0x1098 HDMI_FC_ISCR1_11 8-bit
0x1099 HDMI_FC_ISCR1_10 8-bit
0x109A HDMI_FC_ISCR1_9 8-bit
0x109B HDMI_FC_ISCR1_8 8-bit
0x109C HDMI_FC_ISCR1_7 8-bit
0x109D HDMI_FC_ISCR1_6 8-bit
0x109E HDMI_FC_ISCR1_5 8-bit
0x109F HDMI_FC_ISCR1_4 8-bit
0x10A0 HDMI_FC_ISCR1_3 8-bit
0x10A1 HDMI_FC_ISCR1_2 8-bit
0x10A2 HDMI_FC_ISCR1_1 8-bit
0x10A3 HDMI_FC_ISCR2_15 8-bit
0x10A4 HDMI_FC_ISCR2_14 8-bit
0x10A5 HDMI_FC_ISCR2_13 8-bit
0x10A6 HDMI_FC_ISCR2_12 8-bit
0x10A7 HDMI_FC_ISCR2_11 8-bit
0x10A8 HDMI_FC_ISCR2_10 8-bit
0x10A9 HDMI_FC_ISCR2_9 8-bit
0x10AA HDMI_FC_ISCR2_8 8-bit
0x10AB HDMI_FC_ISCR2_7 8-bit
0x10AC HDMI_FC_ISCR2_6 8-bit
0x10AD HDMI_FC_ISCR2_5 8-bit
0x10AE HDMI_FC_ISCR2_4 8-bit
0x10AF HDMI_FC_ISCR2_3 8-bit
0x10B0 HDMI_FC_ISCR2_2 8-bit
0x10B1 HDMI_FC_ISCR2_1 8-bit
0x10B2 HDMI_FC_ISCR2_0 8-bit
{0x10B3+i} HDMI_FC_DATAUTO{i} 8-bit (i=0..2)
0x10B6 HDMI_FC_DATMAN 8-bit
0x10B7 HDMI_FC_DATAUTO3 8-bit
{0x10B8+i} HDMI_FC_RDRB{i} 8-bit (i=0..7)
{0x10D0+4i} HDMI_FC_STAT{i} 8-bit (i=0..2)
{0x10D1+4i} HDMI_FC_INT{i} 8-bit (i=0..2)
{0x10D2+4i} HDMI_FC_MASK{i} 8-bit (i=0..2)
{0x10D3+4i} HDMI_FC_POL{i} 8-bit (i=0..2)
0x10E0 HDMI_FC_PRCONF 8-bit
0x1100 HDMI_FC_GMD_STAT 8-bit
0x1101 HDMI_FC_GMD_EN 8-bit
0x1102 HDMI_FC_GMD_UP 8-bit
0x1103 HDMI_FC_GMD_CONF 8-bit
0x1104 HDMI_FC_GMD_HB 8-bit
{0x1105+i} HDMI_FC_GMD_PB{i} 8-bit (i=0..27)
0x1200 HDMI_FC_DBGFORCE 8-bit
{0x1201+3i} HDMI_FC_DBGAUD0CH{i} 8-bit (i=0..7)
{0x1202+3i} HDMI_FC_DBGAUD1CH{i} 8-bit (i=0..7)
{0x1203+3i} HDMI_FC_DBGAUD2CH{i} 8-bit (i=0..7)
{0x1219+i} HDMI_FC_DBGTMDS{i} 8-bit (i=0..2)
0x3000 HDMI_PHY_CONF0 8-bit
{0x3001+i} HDMI_PHY_TST{i} 8-bit (i=0..2)
0x3004 HDMI_PHY_STAT0 8-bit
0x3005 HDMI_PHY_INT0 8-bit
0x3006 HDMI_PHY_MASK0 8-bit
0x3007 HDMI_PHY_POL0 8-bit
0x3020 HDMI_PHY_I2CM_SLAVE_ADDR 8-bit
0x3021 HDMI_PHY_I2CM_ADDRESS_ADDR 8-bit
0x3022 HDMI_PHY_I2CM_DATAO_1_ADDR 8-bit
0x3023 HDMI_PHY_I2CM_DATAO_0_ADDR 8-bit
0x3024 HDMI_PHY_I2CM_DATAI_1_ADDR 8-bit
0x3025 HDMI_PHY_I2CM_DATAI_0_ADDR 8-bit
0x3026 HDMI_PHY_I2CM_OPERATION_ADDR 8-bit
0x3027 HDMI_PHY_I2CM_INT_ADDR 8-bit
0x3028 HDMI_PHY_I2CM_CTLINT_ADDR 8-bit
0x3029 HDMI_PHY_I2CM_DIV_ADDR 8-bit
0x302A HDMI_PHY_I2CM_SOFTRSTZ_ADDR 8-bit
0x302B HDMI_PHY_I2CM_SS_SCL_HCNT_1_ADDR 8-bit
0x302C HDMI_PHY_I2CM_SS_SCL_HCNT_0_ADDR 8-bit
0x302D HDMI_PHY_I2CM_SS_SCL_LCNT_1_ADDR 8-bit
0x302E HDMI_PHY_I2CM_SS_SCL_LCNT_0_ADDR 8-bit
0x302F HDMI_PHY_I2CM_FS_SCL_HCNT_1_ADDR 8-bit
0x3030 HDMI_PHY_I2CM_FS_SCL_HCNT_0_ADDR 8-bit
0x3031 HDMI_PHY_I2CM_FS_SCL_LCNT_1_ADDR 8-bit
0x3032 HDMI_PHY_I2CM_FS_SCL_LCNT_0_ADDR 8-bit
0x3100 HDMI_AUD_CONF0 8-bit
0x3101 HDMI_AUD_CONF1 8-bit
0x3102 HDMI_AUD_INT 8-bit
0x3103 HDMI_AUD_CONF2 8-bit
{0x31FF+i} HDMI_AUD_N{i} 8-bit (i=1..3)
{0x3202+i} HDMI_AUD_CTS{i} 8-bit (i=1..3)
0x3206 HDMI_AUD_INPUTCLKFS 8-bit
0x3302 HDMI_AUD_SPDIFINT 8-bit
0x3400 HDMI_AUD_CONF0_HBR 8-bit
0x3401 HDMI_AUD_HBR_STATUS 8-bit
0x3402 HDMI_AUD_HBR_INT 8-bit
0x3403 HDMI_AUD_HBR_POL 8-bit
0x3404 HDMI_AUD_HBR_MASK 8-bit
{0x3500+i} HDMI_GP_CONF{i} 8-bit (i=0..2)
0x3503 HDMI_GP_STAT 8-bit
0x3504 HDMI_GP_INT 8-bit
0x3505 HDMI_GP_MASK 8-bit
0x3506 HDMI_GP_POL 8-bit
0x3600 HDMI_AHB_DMA_CONF0 8-bit
0x3601 HDMI_AHB_DMA_START 8-bit
0x3602 HDMI_AHB_DMA_STOP 8-bit
0x3603 HDMI_AHB_DMA_THRSLD 8-bit
{0x3604+i} HDMI_AHB_DMA_STRADDR{i} 8-bit (i=0..3)
{0x3608+i} HDMI_AHB_DMA_STPADDR{i} 8-bit (i=0..3)
{0x360C+i} HDMI_AHB_DMA_BSTADDR{i} 8-bit (i=0..3)
0x3610 HDMI_AHB_DMA_MBLENGTH0 8-bit
0x3611 HDMI_AHB_DMA_MBLENGTH1 8-bit
0x3612 HDMI_AHB_DMA_STAT 8-bit
0x3613 HDMI_AHB_DMA_INT 8-bit
0x3614 HDMI_AHB_DMA_MASK 8-bit
0x3615 HDMI_AHB_DMA_POL 8-bit
0x3616 HDMI_AHB_DMA_CONF1 8-bit
0x3617 HDMI_AHB_DMA_BUFFSTAT 8-bit
0x3618 HDMI_AHB_DMA_BUFFINT 8-bit
0x3619 HDMI_AHB_DMA_BUFFMASK 8-bit
0x361A HDMI_AHB_DMA_BUFFPOL 8-bit
0x4000 HDMI_MC_SFRDIV 8-bit
0x4001 HDMI_MC_CLKDIS 8-bit
0x4002 HDMI_MC_SWRSTZ 8-bit
0x4003 HDMI_MC_OPCTRL 8-bit
0x4004 HDMI_MC_FLOWCTRL 8-bit
0x4005 HDMI_MC_PHYRSTZ 8-bit
0x4006 HDMI_MC_LOCKONCLOCK 8-bit
0x4007 HDMI_MC_HEACPHY_RST 8-bit
0x4100 HDMI_CSC_CFG 8-bit
0x4101 HDMI_CSC_SCALE 8-bit
{0x4100+2i} HDMI_CSC_COEF_A{i}_MSB 8-bit (i=1..4)
{0x4101+2i} HDMI_CSC_COEF_A{i}_LSB 8-bit (i=1..4)
{0x4108+2i} HDMI_CSC_COEF_B{i}_MSB 8-bit (i=1..4)
{0x4109+2i} HDMI_CSC_COEF_B{i}_LSB 8-bit (i=1..4)
{0x4110+2i} HDMI_CSC_COEF_C{i}_MSB 8-bit (i=1..4)
{0x4111+2i} HDMI_CSC_COEF_C{i}_LSB 8-bit (i=1..4)
0x5000 HDMI_A_HDCPCFG0 8-bit
0x5001 HDMI_A_HDCPCFG1 8-bit
{0x5002+i} HDMI_A_HDCPOBS{i} 8-bit (i=0..3)
0x5006 HDMI_A_APIINTCLR 8-bit
0x5007 HDMI_A_APIINTSTAT 8-bit
0x5008 HDMI_A_APIINTMSK 8-bit
0x5009 HDMI_A_VIDPOLCFG 8-bit
0x500A HDMI_A_OESSWCFG 8-bit
0x500B HDMI_A_TIMER1SETUP0 8-bit
0x500C HDMI_A_TIMER1SETUP1 8-bit
0x500D HDMI_A_TIMER2SETUP0 8-bit
0x500E HDMI_A_TIMER2SETUP1 8-bit
0x500F HDMI_A_100MSCFG 8-bit
0x5010 HDMI_A_2SCFG0 8-bit
0x5011 HDMI_A_2SCFG1 8-bit
0x5012 HDMI_A_5SCFG0 8-bit
0x5013 HDMI_A_5SCFG1 8-bit
0x5014 HDMI_A_SRMVERLSB 8-bit
0x5015 HDMI_A_SRMVERMSB 8-bit
0x5016 HDMI_A_SRMCTRL 8-bit
0x5017 HDMI_A_SFRSETUP 8-bit
0x5018 HDMI_A_I2CHSETUP 8-bit
0x5019 HDMI_A_INTSETUP 8-bit
0x501A HDMI_A_PRESETUP 8-bit
0x5020 HDMI_A_SRM_BASE 8-bit
0x7D00 HDMI_CEC_CTRL 8-bit
0x7D01 HDMI_CEC_STAT 8-bit
0x7D02 HDMI_CEC_MASK 8-bit
0x7D03 HDMI_CEC_POLARITY 8-bit
0x7D04 HDMI_CEC_INT 8-bit
0x7D05 HDMI_CEC_ADDR_L 8-bit
0x7D06 HDMI_CEC_ADDR_H 8-bit
0x7D07 HDMI_CEC_TX_CNT 8-bit
0x7D08 HDMI_CEC_RX_CNT 8-bit
{0x7D10+i} HDMI_CEC_TX_DATA{i} 8-bit (i=0..15)
{0x7D20+i} HDMI_CEC_RX_DATA{i} 8-bit (i=0..15)
0x7D30 HDMI_CEC_LOCK 8-bit
0x7D31 HDMI_CEC_WKUPCTRL 8-bit
0x7E00 HDMI_I2CM_SLAVE 8-bit
0x7E01 HDMI_I2CM_ADDRESS 8-bit
0x7E02 HDMI_I2CM_DATAO 8-bit
0x7E03 HDMI_I2CM_DATAI 8-bit
0x7E04 HDMI_I2CM_OPERATION 8-bit
0x7E05 HDMI_I2CM_INT 8-bit
0x7E06 HDMI_I2CM_CTLINT 8-bit
0x7E07 HDMI_I2CM_DIV 8-bit
0x7E08 HDMI_I2CM_SEGADDR 8-bit
0x7E09 HDMI_I2CM_SOFTRSTZ 8-bit
0x7E0A HDMI_I2CM_SEGPTR 8-bit
0x7E0B HDMI_I2CM_SS_SCL_HCNT_1_ADDR 8-bit
0x7E0C HDMI_I2CM_SS_SCL_HCNT_0_ADDR 8-bit
0x7E0D HDMI_I2CM_SS_SCL_LCNT_1_ADDR 8-bit
0x7E0E HDMI_I2CM_SS_SCL_LCNT_0_ADDR 8-bit
0x7E0F HDMI_I2CM_FS_SCL_HCNT_1_ADDR 8-bit
0x7E10 HDMI_I2CM_FS_SCL_HCNT_0_ADDR 8-bit
0x7E11 HDMI_I2CM_FS_SCL_LCNT_1_ADDR 8-bit
0x7E12 HDMI_I2CM_FS_SCL_LCNT_0_ADDR 8-bit
