# aw_t113x register map
File version: 1.00
Registers are 32-bit, read-write, reset 0x0 unless marked. A register's access mark holds for its fields unless they carry their own. Offsets are from the block's base; [hi:lo] are bit positions; lines under a group give offsets from that group; {n}, {i} and the like mark numbered series.

## GPADC
Base 0x02009000
0x00 GP_SR_CON — GPADC Sample Rate Configure Register
0x04 GP_CTRL — GPADC Control Register
0x08 GP_CS_EN — GPADC Compare and Select Enable Register
0x0C GP_FIFO_INTC — GPADC FIFO Interrupt Control Register
0x10 GP_FIFO_INTS — GPADC FIFO Interrupt Status Register
0x14 GP_FIFO_DATA — GPADC FIFO Data Register
0x18 GP_CDATA — GPADC Calibration Data Register
0x20 GP_DATAL_INTC — GPADC Data Low Interrupt Configure Register
0x24 GP_DATAH_INTC — GPADC Data High Interrupt Configure Register
0x28 GP_DATA_INTC — GPADC Data Interrupt Configure Register
0x30 GP_DATAL_INTS — GPADC Data Low Interrupt Status Register
0x34 GP_DATAH_INTS — GPADC Data High Interrupt Status Register
0x38 GP_DATA_INTS — GPADC Data Interrupt Status Register
0x40 GP_CH0_CMP_DATA — GPADC CH0 Compare Data Register
0x80 GP_CH0_DATA — GPADC CH0 Data Register

## GPIOB
Base 0x02000030
Same registers: GPIOC 0x02000060, GPIOD 0x02000090, GPIOE 0x020000C0, GPIOF 0x020000F0, GPIOG 0x02000120
{0x0+0x10*i} CFG[{i}] (i=0..3) — Configure Register
0x10 DATA
{0x14+0x10*i} DRV[{i}] (i=0..3) — Multi_Driving Register
{0x24+8i} PULL[{i}] (i=0..1)

## GPIOBLOCK
Base 0x02000000
{0x0+0x150*i} unnamed[{i}] (i=0..6) group
  {0x0+0x10*j} CFG[{j}] (j=0..3) — Configure Register
  0x10 DATA
  {0x14+0x10*j} DRV[{j}] (j=0..3) — Multi_Driving Register
  {0x24+8j} PULL[{j}] (j=0..1)
{0x200+0xE0*i} unnamed[{i}] (i=0..6) group
  {0x0+0x10*j} EINT_CFG[{j}] (j=0..3) — External Interrupt Configure Registers
  0x10 EINT_CTL — External Interrupt Control Register
  0x14 EINT_STATUS — External Interrupt Status Register
  0x18 EINT_DEB — External Interrupt Debounce Register
0x340 PIO_POW_MOD_SEL — PIO Group Withstand Voltage Mode Select Register
0x344 PIO_POW_MS_CTL — PIO Group Withstand Voltage Mode Select Control Register
0x348 PIO_POW_VAL — PIO Group Power Value Register

## GPIOINTB
Base 0x02000220
Same registers: GPIOINTC 0x02000240, GPIOINTD 0x02000260, GPIOINTE 0x02000280, GPIOINTF 0x020002A0, GPIOINTG 0x020002C0
{0x0+0x10*i} EINT_CFG[{i}] (i=0..3) — External Interrupt Configure Registers
0x10 EINT_CTL — External Interrupt Control Register
0x14 EINT_STATUS — External Interrupt Status Register
0x18 EINT_DEB — External Interrupt Debounce Register

## HDMI_PHY
Base 0x05510000
0x00 DBG_CTRL
0x04 REXT_CTRL
0x10 READ_EN
0x14 UNSCRAMBLE
{0x1C+4i} ANA_CFG{i} (i=1..3)
0x2C PLL_CFG1 — ANA_CFG1
0x30 PLL_CFG2
0x34 PLL_CFG3
0x38 ANA_STS
0x3C CEC
0xFF8 CEC_VERSION — Controller Version Register(Default Value: 0x0100_0000)
0xFFC VERSION — PHY Version Register(Default Value: 0x0101_0000)

## HSTIMER — High Speed Timer (HSTimer)
Base 0x03008000
0x00 HS_TMR_IRQ_EN_REG — HS Timer IRQ Enable Register
0x04 HS_TMR_IRQ_STAS_REG — HS Timer Status Register
0x20 HS_TMR0_CTRL_REG — HS Timer0 Control Register
0x24 HS_TMR0_INTV_LO_REG — HS Timer0 Interval Value Low Register
0x28 HS_TMR0_INTV_HI_REG — HS Timer0 Interval Value High Register
0x2C HS_TMR0_CURNT_LO_REG — HS Timer0 Current Value Low Register
0x30 HS_TMR0_CURNT_HI_REG — HS Timer0 Current Value High Register
0x40 HS_TMR1_CTRL_REG — HS Timer1 Control Register
0x44 HS_TMR1_INTV_LO_REG — HS Timer1 Interval Value Low Register
0x48 HS_TMR1_INTV_HI_REG — HS Timer1 Interval Value High Register
0x4C HS_TMR1_CURNT_LO_REG — HS Timer1 Current Value Low Register
0x50 HS_TMR1_CURNT_HI_REG — HS Timer1 Current Value High Register

## I2S1
Base 0x02033000
Same registers: I2S2 0x02034000
0x00 I2S_PCM_CTL — I2S/PCM Control Register
0x04 I2S_PCM_FMT0 — I2S/PCM Format Register 0
0x08 I2S_PCM_FMT1 — I2S/PCM Format Register 1
0x0C I2S_PCM_ISTA — I2S/PCM Interrupt Status Register
0x10 I2S_PCM_RXFIFO
0x14 I2S_PCM_FCTL — I2S/PCM FIFO Control Register
0x18 I2S_PCM_FSTA — I2S/PCM FIFO Status Register
0x1C I2S_PCM_INT — I2S/PCM DMA & Interrupt Control Register
0x20 I2S_PCM_TXFIFO
0x24 I2S_PCM_CLKD — I2S/PCM Clock Divide Register
0x28 I2S_PCM_TXCNT — I2S/PCM TX Sample Counter Register
0x2C I2S_PCM_RXCNT — I2S/PCM RX Sample Counter Register
0x30 I2S_PCM_CHCFG — I2S/PCM Channel Configuration Register
{0x34+4i} I2S_PCM_TX{i}CHSEL (i=0..3) — I2S/PCM TX{i} Channel Select Register
{0x44+8i} I2S_PCM_TX{i}CHMAP0 (i=0..3) — I2S/PCM TX{i} Channel Mapping Register0
{0x48+8i} I2S_PCM_TX{i}CHMAP1 (i=0..3) — I2S/PCM TX{i} Channel Mapping Register1
0x64 I2S_PCM_RXCHSEL — I2S/PCM RX Channel Select Register
{0x68+0x10*i} I2S_PCM_RXCHMAP[{i}] (i=0..3) — I2S/PCM RX Channel Mapping Register0..3
0x80 MCLKCFG — ASRC MCLK Configuration Register
0x84 FsoutCFG — ASRC Out Sample Rate Configuration Register
0x88 FsinEXTCFG — ASRC Input Sample Pulse Extend Configuration Register
0x8C ASRCCFG — ASRC Enable Register
0x90 ASRCMANCFG — ASRC Manual Ratio Configuration Register
0x94 ASRCRATIOSTAT — ASRC Status Register
0x98 ASRCFIFOSTAT — ASRC FIFO Level Status Register
0x9C ASRCMBISTCFG — ASRC MBIST Test Configuration Register
0xA0 ASRCMBISTSTAT — ASRC MBIST Test Status Register
