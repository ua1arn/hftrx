# aw_t113x register map
File version: 1.00
Registers are 32-bit, read-write, reset 0x0 unless marked. A register's access mark holds for its fields unless they carry their own. Offsets are from the block's base; [hi:lo] are bit positions; {n}, {i} and the like mark numbered series.

## G2D_MIXER — Graphic 2D (G2D) Engine Video Mixer
Base 0x05410100
0x00 G2D_MIXER_CTRL — G2D mixer control
0x04 G2D_MIXER_INTERRUPT
0x08 G2D_MIXER_CLK — G2D mixer clock

## G2D_ROT — Graphic 2D Rotate
Base 0x05438000
0x00 ROT_CTL
0x04 ROT_INT
0x08 ROT_TIMEOUT
0x20 ROT_IFMT — Input data attribute register
0x24 ROT_ISIZE — Input data size register
0x30 ROT_IPITCH0 — Input Y/RGB/ARGB memory pitch register
0x34 ROT_IPITCH1 — Input U/UV memory pitch register
0x38 ROT_IPITCH2 — Input V memory pitch register
0x40 ROT_ILADD0 — Input Y/RGB/ARGB memory address register0
0x44 ROT_IHADD0 — Input Y/RGB/ARGB memory address register1
0x48 ROT_ILADD1 — Input U/UV memory address register0
0x4C ROT_IHADD1 — Input U/UV memory address register1
0x50 ROT_ILADD2 — Input V memory address register0
0x54 ROT_IHADD2 — Input V memory address register1
0x84 ROT_OSIZE — Output data size register
0x90 ROT_OPITCH0 — Output Y/RGB/ARGB memory pitch register
0x94 ROT_OPITCH1 — Output U/UV memory pitch register
0x98 ROT_OPITCH2 — Output V memory pitch register
0xA0 ROT_OLADD0 — Output Y/RGB/ARGB memory address register0
0xA4 ROT_OHADD0 — Output Y/RGB/ARGB memory address register1
0xA8 ROT_OLADD1 — Output U/UV memory address register0
0xAC ROT_OHADD1 — Output U/UV memory address register1
0xB0 ROT_OLADD2 — Output V memory address register0
0xB4 ROT_OHADD2 — Output V memory address register1
0xC8 LBC_ENC_CTL — Encode control (bit 31 - is lossy)
0xCC LBC_CTL
0xD0 LBC_DEC_CTL — Decode control (bit 31 - is lossy)

## G2D — Graphic 2D top
Base 0x05410000
Same registers: G2D_TOP 0x05410000
0x00 G2D_SCLK_GATE
0x04 G2D_HCLK_GATE
0x08 G2D_AHB_RST — G2D AHB reset
0x0C G2D_SCLK_DIV
0x10 G2D_VERSION
0x20 RCQ_IRQ_CTL
0x24 RCQ_STATUS
0x28 RCQ_CTRL
0x2C RCQ_HEADER_LOW_ADDR — Register Configuration Queue Header bits 31..0
0x30 RCQ_HEADER_HIGH_ADDR — Register Configuration Queue Header bits 39..32
0x34 RCQ_HEADER_LEN — Register Configuration Queue length bits 15..0

## G2D_UI0 — Graphic 2D UI surface
Base 0x05411000
Same registers: G2D_UI1 0x05411800, G2D_UI2 0x05412000
0x00 UI_ATTR — UIx_ATTR
0x04 UI_MBSIZE — UIx_MBSIZE
0x08 UI_COOR — UIx_COOR
0x0C UI_PITCH — UIx_PITCH
0x10 UI_LADD — UIx_LADD
0x14 UI_FILLC — UIx_FILLC
0x18 UI_HADD — UIx_HADD
0x1C UI_SIZE — UIx_SIZE

## G2D_V0 — Graphic 2D VI surface
Base 0x05410800
0x00 V0_ATTCTL
0x04 V0_MBSIZE — Source rectangle size (may be empty)
0x08 V0_COOR — Target window position
0x0C V0_PITCH0 — V0_PITCH0 Y/RGB/ARGB data memory
0x10 V0_PITCH1 — V0_PITCH1 U/UV data memory
0x14 V0_PITCH2 — V0_PITCH2 V data memory
0x18 V0_LADD0 — V0_LADD0 Y/RGB/ARGB data memory
0x1C V0_LADD1 — V0_LADD1 U/UV data memory
0x20 V0_LADD2 — V0_LADD2 V data memory
0x24 V0_FILLC
0x28 V0_HADD — [31:24]: 0, [23:16]: LADD2 bits 40..32, [15:8]: LADD1 bits 40..32, [7:0]: LADD0 bits 40..32
0x2C V0_SIZE — Source window size (may not be empty)
0x30 V0_HDS_CTL0
0x34 V0_HDS_CTL1
0x38 V0_VDS_CTL0
0x3C V0_VDS_CTL1

## G2D_VSU — Graphic 2D Video Scaler
Base 0x05418000
0x00 VS_CTRL
0x40 VS_OUT_SIZE
0x44 VS_GLB_ALPHA
0x80 VS_Y_SIZE
0x88 VS_Y_HSTEP
0x8C VS_Y_VSTEP
0x90 VS_Y_HPHASE
0x98 VS_Y_VPHASE0
0xC0 VS_C_SIZE
0xC8 VS_C_HSTEP
0xCC VS_C_VSTEP
0xD0 VS_C_HPHASE
0xD8 VS_C_VPHASE0
{0x200+0x100*i} VS_Y_HCOEF[{i}] (i=0..63) — VS_Y_HCOEF[N]. N=0..31
{0x300+0x100*i} VS_Y_VCOEF[{i}] (i=0..63) — VS_Y_VCOEF[N]. N=0..31
{0x400+0x100*i} VS_C_HCOEF[{i}] (i=0..63) — VS_C_HCOEF[N]. N=0..31

## G2D_WB — Graphic 2D (G2D) Engine Write Back
Base 0x05413000
0x00 WB_ATT
0x04 WB_SIZE
{0x8+4i} WB_PITCH{i} (i=0..2)
{0x14+8i} WB_LADD{i} (i=0..2)
{0x18+8i} WB_HADD{i} (i=0..2)

## GICVSELF
Base 0x03024000
Same registers: GICV 0x03025000
0x00 GICH_HCR — RW 0x00000000 Hypervisor Control Register
0x04 GICH_VTR — RO 0x90000003 VGIC Type Register, GICH_VTR on page 3-13
0x08 GICH_VMCR — RW 0x004C0000 Virtual Machine Control Register
0x10 GICH_MISR — RO 0x00000000 Maintenance Interrupt Status Register
0x20 GICH_EISR0 — RO 0x00000000 End of Interrupt Status Register
0x30 GICH_ELSR0 — RO 0x0000000F Empty List register Status Register
0xF0 GICH_APR0 — RW 0x00000000 Active Priority Register
{0x100+4i} GICH_LR{i} (i=0..3) — RW 0x00000000 List Register {i}
