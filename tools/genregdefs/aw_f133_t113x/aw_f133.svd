# aw_f133 register map
File version: 1.00
Registers are 32-bit, read-write, reset 0x0 unless marked. A register's access mark holds for its fields unless they carry their own. Offsets are from the block's base; [hi:lo] are bit positions; {n}, {i} and the like mark numbered series.

## C0_CPUX_CFG
Base 0x09010000
0x00 C0_RST_CTRL — Cluster 0 Reset Control Register
{0x10+4i} C0_CTRL_REG{i} (i=0..2) — Cluster 0 Control Register{i}
0x24 CACHE_CFG_REG — Cache Configuration Register
0x80 C0_CPU_STATUS — Cluster 0 CPU Status Register
0x84 L2_STATUS_REG — Cluster 0 L2 Status Register
0xC0 DBG_REG0 — Cluster 0 Debug Control Register0
0xC4 DBG_REG1 — Cluster 0 Debug Control Register1
0xD0 AXI_MNT_CTRL_REG — AXI Monitor Control Register
0xD4 AXI_MNT_PRD_REG — AXI Monitor Period Register
0xD8 AXI_MNT_RLTCY_REG — AXI Monitor Read Total Latency Register
0xDC AXI_MNT_WLTCY_REG — AXI Monitor Write Total Latency Register
0xE0 AXI_MNT_RREQ_REG — AXI Monitor Read Request Times Register
0xE4 AXI_MNT_WREQ_REG — AXI Monitor Write Request Times Register
0xE8 AXI_MNT_RBD_REG — AXI Monitor Read Bandwidth Register
0xEC AXI_MNT_WBD_REG — AXI Monitor Write Bandwidth Register

## CAN0 — CAN (see Allwinner_T3_User_Manual_V1.0_cleaned.pdf as part of documentation)
Base 0x02504000
Same registers: CAN1 0x02504400
0x00 CAN_MSEL — CAN mode select register
0x04 CAN_CMD — CAN command register
0x08 CAN_STA — CAN status register
0x0C CAN_INT — CAN interrupt register
0x10 CAN_INTEN — CAN interrupt enable register
0x14 CAN_BUSTIME — CAN bus timing register
0x18 CAN_TEWL — CAN TX error warning limit register
0x1C CAN_ERRC — CAN error counter register
0x20 CAN_RMCNT — CAN receive message counter register
0x24 CAN_RBUF_SADDR — CAN receive buffer start address register
0x28 CAN_ACPC — CAN acceptance code 0 register(reset mode)
0x2C CAN_ACPM — CAN acceptance mask 0 register(reset mode)
{0x40+0x34*i} CAN_TRBUF[{i}] (i=0..12) — CAN TX/RX message buffer N (n=0..12) register
{0x180+0xC0*i} CAN_RBUF_RBACK[{i}] (i=0..47) — CAN transmit buffer for read back register (0x0180 ~0x1b0)
0x300 CAN_VERSION

## CE_NS — Crypto Engine (CE)
Base 0x03040000
Same registers: CE_S 0x03040800
0x00 CE_TDA — Task Descriptor Address
0x08 CE_ICR — Interrupt Control Register
0x0C CE_ISR — Interrupt Status Register
0x10 CE_TLR — Task Load Register
0x14 CE_TSR — Task Status Register
0x18 CE_ESR — Error Status Register
0x24 CE_CSA — DMA Current Source Address
0x28 CE_CDA — DMA Current Destination Address
0x2C CE_TPR — Throughput Register

## CIR_RX
Base 0x07040000
0x00 CIR_CTL — CIR Control Register
0x10 CIR_RXPCFG — CIR Receiver Pulse Configure Register
0x20 CIR_RXFIFO — CIR Receiver FIFO Register
0x2C CIR_RXINT — CIR Receiver Interrupt Control Register
0x30 CIR_RXSTA — CIR Receiver Status Register
0x34 CIR_RXCFG — CIR Receiver Configure Register

## CIR_TX
Base 0x02003000
0x00 CIR_TGLR — CIR Transmit Global Register
0x04 CIR_TMCR — CIR Transmit Modulation Control Register
0x08 CIR_TCR — CIR Transmit Control Register
0x0C CIR_IDC_H — CIR Transmit Idle Duration Threshold High Bit Register
0x10 CIR_IDC_L — CIR Transmit Idle Duration Threshold Low Bit Register
0x14 CIR_TICR_H — CIR Transmit Idle Counter High Bit Register
0x18 CIR_TICR_L — CIR Transmit Idle Counter Low Bit Register
0x20 CIR_TEL — CIR TX FIFO Empty Level Register
0x24 CIR_TXINT — CIR Transmit Interrupt Control Register
0x28 CIR_TAC — CIR Transmit FIFO Available Counter Register
0x2C CIR_TXSTA — CIR Transmit Status Register
0x30 CIR_TXT — CIR Transmit Threshold Register
0x34 CIR_DMA — CIR DMA Control Register
0x80 CIR_TXFIFO — CIR Transmit FIFO Data Register

## CLINT
Base 0x14000000
0x00 msip — This register generates machine mode software interrupts when set.
0x4000 mtimecmplo — This register holds the compare value for the timer.
0x4004 mtimecmphi — This register holds the compare value for the timer.
0xBFF8 mtimelo — Provides the current timer value.
0xBFFC mtimehi — Provides the current timer value.

## Notices in the file
Copyright (c) 2024 by Genadi V. Zawidowski. All rights reserved.
