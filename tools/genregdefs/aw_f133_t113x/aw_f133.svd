# aw_f133 register map
File version: 1.00
Registers are 32-bit, read-write, reset 0x0 unless marked. A register's access mark holds for its fields unless they carry their own. Offsets are from the block's base; [hi:lo] are bit positions; {n}, {i} and the like mark numbered series.

## GPIOINTB
Base 0x02000220
Same registers: GPIOINTC 0x02000240, GPIOINTD 0x02000260, GPIOINTE 0x02000280, GPIOINTF 0x020002A0, GPIOINTG 0x020002C0
{0x0+0x10*i} EINT_CFG[{i}] (i=0..3) — External Interrupt Configure Registers
0x10 EINT_CTL — External Interrupt Control Register
0x14 EINT_STATUS — External Interrupt Status Register
0x18 EINT_DEB — External Interrupt Debounce Register

## HDMI_PHY
Base 0x05510000
0x00 DBG_CTRL
0x04 REXT_CTRL
0x10 READ_EN
0x14 UNSCRAMBLE
{0x1C+4i} ANA_CFG{i} (i=1..3)
0x2C PLL_CFG1 — ANA_CFG1
0x30 PLL_CFG2
0x34 PLL_CFG3
0x38 ANA_STS
0x3C CEC
0xFF8 CEC_VERSION — Controller Version Register(Default Value: 0x0100_0000)
0xFFC VERSION — PHY Version Register(Default Value: 0x0101_0000)

## HSTIMER — High Speed Timer (HSTimer)
Base 0x03008000
0x00 HS_TMR_IRQ_EN_REG — HS Timer IRQ Enable Register
0x04 HS_TMR_IRQ_STAS_REG — HS Timer Status Register
0x20 HS_TMR0_CTRL_REG — HS Timer0 Control Register
0x24 HS_TMR0_INTV_LO_REG — HS Timer0 Interval Value Low Register
0x28 HS_TMR0_INTV_HI_REG — HS Timer0 Interval Value High Register
0x2C HS_TMR0_CURNT_LO_REG — HS Timer0 Current Value Low Register
0x30 HS_TMR0_CURNT_HI_REG — HS Timer0 Current Value High Register
0x40 HS_TMR1_CTRL_REG — HS Timer1 Control Register
0x44 HS_TMR1_INTV_LO_REG — HS Timer1 Interval Value Low Register
0x48 HS_TMR1_INTV_HI_REG — HS Timer1 Interval Value High Register
0x4C HS_TMR1_CURNT_LO_REG — HS Timer1 Current Value Low Register
0x50 HS_TMR1_CURNT_HI_REG — HS Timer1 Current Value High Register

## I2S1
Base 0x02033000
Same registers: I2S2 0x02034000
0x00 I2S_PCM_CTL — I2S/PCM Control Register
0x04 I2S_PCM_FMT0 — I2S/PCM Format Register 0
0x08 I2S_PCM_FMT1 — I2S/PCM Format Register 1
0x0C I2S_PCM_ISTA — I2S/PCM Interrupt Status Register
0x10 I2S_PCM_RXFIFO
0x14 I2S_PCM_FCTL — I2S/PCM FIFO Control Register
0x18 I2S_PCM_FSTA — I2S/PCM FIFO Status Register
0x1C I2S_PCM_INT — I2S/PCM DMA & Interrupt Control Register
0x20 I2S_PCM_TXFIFO
0x24 I2S_PCM_CLKD — I2S/PCM Clock Divide Register
0x28 I2S_PCM_TXCNT — I2S/PCM TX Sample Counter Register
0x2C I2S_PCM_RXCNT — I2S/PCM RX Sample Counter Register
0x30 I2S_PCM_CHCFG — I2S/PCM Channel Configuration Register
{0x34+4i} I2S_PCM_TX{i}CHSEL (i=0..3) — I2S/PCM TX{i} Channel Select Register
{0x44+8i} I2S_PCM_TX{i}CHMAP0 (i=0..3) — I2S/PCM TX{i} Channel Mapping Register0
{0x48+8i} I2S_PCM_TX{i}CHMAP1 (i=0..3) — I2S/PCM TX{i} Channel Mapping Register1
0x64 I2S_PCM_RXCHSEL — I2S/PCM RX Channel Select Register
{0x68+0x10*i} I2S_PCM_RXCHMAP[{i}] (i=0..3) — I2S/PCM RX Channel Mapping Register0..3
0x80 MCLKCFG — ASRC MCLK Configuration Register
0x84 FsoutCFG — ASRC Out Sample Rate Configuration Register
0x88 FsinEXTCFG — ASRC Input Sample Pulse Extend Configuration Register
0x8C ASRCCFG — ASRC Enable Register
0x90 ASRCMANCFG — ASRC Manual Ratio Configuration Register
0x94 ASRCRATIOSTAT — ASRC Status Register
0x98 ASRCFIFOSTAT — ASRC FIFO Level Status Register
0x9C ASRCMBISTCFG — ASRC MBIST Test Configuration Register
0xA0 ASRCMBISTSTAT — ASRC MBIST Test Status Register

## LEDC — LED Lamp Controller
Base 0x02008000
0x00 LEDC_CTRL_REG — LEDC Control Register
0x04 LED_T01_TIMING_CTRL_REG — LEDC T0 & T1 Timing Control Register
0x08 LEDC_DATA_FINISH_CNT_REG — LEDC Data Finish Counter Register
0x0C LED_RESET_TIMING_CTRL_REG — LEDC Reset Timing Control Register
0x10 LEDC_WAIT_TIME0_CTRL_REG — LEDC Wait Time0 Control Register
0x14 LEDC_DATA_REG — LEDC Data Register
0x18 LEDC_DMA_CTRL_REG — LEDC DMA Control Register
0x1C LEDC_INT_CTRL_REG — LEDC Interrupt Control Register
0x20 LEDC_INT_STS_REG — LEDC Interrupt Status Register
0x28 LEDC_WAIT_TIME1_CTRL_REG — LEDC Wait Time1 Control Register
{0x30+0x80*i} LEDC_FIFO_DATA_REG[{i}] (i=0..31) — LEDC FIFO Data Registers array

## Notices in the file
Copyright (c) 2024 by Genadi V. Zawidowski. All rights reserved.
