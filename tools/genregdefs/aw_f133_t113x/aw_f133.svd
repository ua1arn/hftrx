# aw_f133 register map
File version: 1.00
Registers are 32-bit, read-write, reset 0x0 unless marked. A register's access mark holds for its fields unless they carry their own. Offsets are from the block's base; [hi:lo] are bit positions; lines under a group give offsets from that group; {n}, {i} and the like mark numbered series.

## MCTL_COM
Base 0x03102000
0x00 MCTL_COM_WORK_MODE0 — Reg_000
0x04 MCTL_COM_WORK_MODE1 — Reg_004
0x08 MCTL_COM_DBGCR — Reg_008
0x0C MCTL_COM_TMR — Reg_00C
0x14 MCTL_COM_CCCR — Reg_014
{0x20+4i} MCTL_COM_MAER{i} (i=0..2) — Reg_{4i+20:03}
{0x500+4i} MCTL_COM_REMAP{i} (i=0..3) — REMAP{i}

## MCTL_PHY
Base 0x03103000
0x00 MCTL_PHY_PIR
0x04 MCTL_PHY_PWRCTL
0x08 MCTL_PHY_MRCTRL0
0x0C MCTL_PHY_CLKEN
0x10 MCTL_PHY_PGSR0
0x14 MCTL_PHY_PGSR1
0x18 MCTL_PHY_STATR
0x2C MCTL_PHY_LP3MR11
{0x30+4i} MCTL_PHY_DRAM_MR{i} (i=0..3)
0x44 MCTL_PHY_PTR0
{0x44+4i} MCTL_PHY_PTR{i} (i=2..4)
{0x58+4i} MCTL_PHY_DRAMTMG{i} (i=0..8)
0x7C MCTL_PHY_ODTCFG
0x80 MCTL_PHY_PITMG0
0x84 MCTL_PHY_PITMG1
0x88 MCTL_PHY_LPTPR
0x8C MCTL_PHY_RFSHCTL0
0x90 MCTL_PHY_RFSHTMG
0x94 MCTL_PHY_RFSHCTL1
0x98 MCTL_PHY_PWRTMG
0x9C MCTL_PHY_ASRC
0xA0 MCTL_PHY_ASRTC
0xB8 MCTL_PHY_VTFCR
0xBC MCTL_PHY_DQSGMR
0xC0 MCTL_PHY_DTCR
0xC4 MCTL_PHY_DTAR0
{0x100+4i} MCTL_PHY_PGCR{i} (i=0..3)
0x110 MCTL_PHY_IOVCR0
0x114 MCTL_PHY_IOVCR1
0x11C MCTL_PHY_DXCCR
0x120 MCTL_PHY_ODTMAP
0x124 MCTL_PHY_ZQCTL0
0x128 MCTL_PHY_ZQCTL1
0x140 MCTL_PHY_ZQCR
0x144 MCTL_PHY_ZQSR
{0x148+4i} MCTL_PHY_ZQDR{i} (i=0..2)
0x1C0 MCTL_PHY_SCHED
0x1C4 MCTL_PHY_PERFHPR0
0x1C8 MCTL_PHY_PERFHPR1
0x1CC MCTL_PHY_PERFLPR0
0x1D0 MCTL_PHY_PERFLPR1
0x1D4 MCTL_PHY_PERFWR0
0x1D8 MCTL_PHY_PERFWR1
0x200 MCTL_PHY_ACMDLR
0x204 MCTL_PHY_ACLDLR
0x208 MCTL_PHY_ACIOCR0
{0x210+0x40*i} MCTL_PHY_ACIOCR1[{i}] (i=0..15) — 0x210 + 0x4 * x

## CPUX_MSGBOX — Message Box
Base 0x03003000
Same registers: DSP_MSGBOX 0x01701000
{0x20+0x200*i} unnamed[{i}] (i=0..1) group
  0x00 MSGBOX_RD_IRQ_EN_REG — 0x0020+N*0x0100 (N=0-1) MSGBOX Read IRQ Enable Register
  0x04 MSGBOX_RD_IRQ_STATUS_REG — 0x0024+N*0x0100 (N=0-1) MSGBOX Read IRQ Status Register
  0x10 MSGBOX_WR_IRQ_EN_REG — 0x0030+N*0x0100 (N=0-1) MSGBOX Write IRQ Enable Register
  0x14 MSGBOX_WR_IRQ_STATUS_REG — 0x0034+N*0x0100 (N=0-1) MSGBOX Write IRQ Status Register
  0x20 MSGBOX_DEBUG_REG — 0x0040+N*0x0100 (N=0-1) MSGBOX Debug Register
  {0x30+0x10*j} MSGBOX_FIFO_STATUS_REG[{j}] (j=0..3) — 0x0050+N*0x0100+P*0x0004 (N=0-1)(P=0-3) MSGBOX FIFO Status Register
  {0x40+0x10*j} MSGBOX_MSG_STATUS_REG[{j}] (j=0..3) — 0x0060+N*0x0100+P*0x0004 (N=0-1)(P=0-3) MSGBOX Message Status Register
  {0x50+0x10*j} MSGBOX_MSG_REG[{j}] (j=0..3) — 0x0070+N*0x0100+P*0x0004 (N=0-1)(P=0-3) MSGBOX Message Queue Register
  {0x60+0x10*j} MSGBOX_WR_INT_THRESHOLD_REG[{j}] (j=0..3) — 0x0080+N*0x0100+P*0x0004 (N=0-1)(P=0-3) MSGBOX Write IRQ Threshold Register

## OWA — One Wire Audio (TX only)
Base 0x02036000
0x00 OWA_GEN_CTL — OWA General Control Register
0x04 OWA_TX_CFIG — OWA TX Configuration Register
0x0C OWA_ISTA — OWA Interrupt Status Register
0x14 OWA_FCTL — OWA FIFO Control Register
0x18 OWA_FSTA — OWA FIFO Status Register
0x1C OWA_INT — OWA Interrupt Control Register
0x20 OWA_TX_FIFO
0x24 OWA_TX_CNT — OWA TX Counter Register
0x2C OWA_TX_CHSTA0 — OWA TX Channel Status Register0
0x30 OWA_TX_CHSTA1 — OWA TX Channel Status Register1

## PLIC — Platform-Level Interrupt Controller (PLIC)
Base 0x10000000
{0x0+0x1000*i} PLIC_PRIO_REGn[{i}] (i=0..1023) — (0<n<256) PLIC Priority Register n - Interrupt Source Priority
{0x1000+0x80*i} PLIC_IP_REGn[{i}] (i=0..31) — (0≤n<9) PLIC Interrupt Pending Register n - Interrupt Pending Bits
{0x2000+0x80*i} PLIC_MIE_REGn[{i}] (i=0..31) — (0≤n<9) PLIC Machine Mode Interrupt Enable Register n - Machine Interrupt Enable Bits
{0x2080+0x80*i} PLIC_SIE_REGn[{i}] (i=0..31) — (0≤n<9) PLIC Superuser Mode Interrupt Enable Register n - Superuser Interrupt Enable Bits
0x1FFFFC PLIC_CTRL_REG — PLIC Control Register
0x200000 PLIC_MTH_REG — PLIC Machine Threshold Register - Priority Threshold for context 0
0x200004 PLIC_MCLAIM_REG — PLIC Machine Claim Register (EOI) - Interrupt Claim Process for context 0
0x201000 PLIC_STH_REG — PLIC Superuser Threshold Register - Priority Threshold for context 1
0x201004 PLIC_SCLAIM_REG — PLIC Superuser Claim Register (EOI) - Interrupt Claim Process for context 1
